/dts-v1/;

/ {
	#address-cells = <0x02>;
	model = "Radxa ROCK 4C+";
	serial-number = "27f597fc673d8e92";
	#size-cells = <0x02>;
	interrupt-parent = <0x01>;
	compatible = "radxa,rock-4c-plus\0rockchip,rk3399";

	i2c@ff150000 {
		pinctrl-names = "default";
		#address-cells = <0x01>;
		pinctrl-0 = <0x41>;
		clock-names = "i2c\0pclk";
		assigned-clocks = <0x08 0x45>;
		assigned-clock-rates = <0xbebc200>;
		interrupts = <0x00 0x25 0x04 0x00>;
		clocks = <0x08 0x45 0x08 0x159>;
		#size-cells = <0x00>;
		compatible = "rockchip,rk3399-i2c";
		status = "okay";
		reg = <0x00 0xff150000 0x00 0x1000>;
		phandle = <0xfb>;
	};

	pwm@ff420020 {
		pinctrl-names = "active";
		pinctrl-0 = <0x9b>;
		clock-names = "pwm";
		clocks = <0x85 0x1e>;
		#pwm-cells = <0x03>;
		compatible = "rockchip,rk3399-pwm\0rockchip,rk3288-pwm";
		status = "disabled";
		reg = <0x00 0xff420020 0x00 0x10>;
		phandle = <0x120>;
	};

	virtual-pd {
		hpd-gpios = <0xda 0x19 0x01>;
		pinctrl-names = "default";
		pinctrl-0 = <0xdb>;
		vpd,init-flip = <0x00>;
		vpd,init-ss = <0x01>;
		compatible = "linux,extcon-pd-virtual";
		dp-pwr-supply = <0xdc>;
		phandle = <0x39>;
		vpd,init-mode = <0x02>;
	};

	phy@ff7c0000 {
		power-domains = <0x1c 0x08>;
		clock-names = "tcpdcore\0tcpdphy-ref";
		assigned-clocks = <0x08 0x7e>;
		assigned-clock-rates = <0x2faf080>;
		resets = <0x08 0x95 0x08 0x94 0x08 0x14c>;
		clocks = <0x08 0x7e 0x08 0x7d>;
		extcon = <0x39>;
		compatible = "rockchip,rk3399-typec-phy";
		status = "okay";
		rockchip,grf = <0x1d>;
		reg = <0x00 0xff7c0000 0x00 0x40000>;
		phandle = <0x137>;
		reset-names = "uphy\0uphy-pipe\0uphy-tcphy";

		dp-port {
			#phy-cells = <0x00>;
			status = "okay";
			phandle = <0x38>;
		};

		usb3-port {
			#phy-cells = <0x00>;
			phandle = <0x35>;
		};
	};

	pwm@ff420010 {
		pinctrl-names = "active";
		pinctrl-0 = <0x9a>;
		clock-names = "pwm";
		clocks = <0x85 0x1e>;
		#pwm-cells = <0x03>;
		compatible = "rockchip,rk3399-pwm\0rockchip,rk3288-pwm";
		status = "disabled";
		reg = <0x00 0xff420010 0x00 0x10>;
		phandle = <0x11f>;
	};

	iommu@ff660480 {
		power-domains = <0x1c 0x20>;
		clock-names = "aclk\0iface";
		interrupts = <0x00 0x75 0x04 0x00>;
		clocks = <0x08 0xed 0x08 0x1ec>;
		#iommu-cells = <0x00>;
		compatible = "rockchip,iommu";
		status = "okay";
		interrupt-names = "vdec_mmu";
		reg = <0x00 0xff660480 0x00 0x40 0x00 0xff6604c0 0x00 0x40>;
		phandle = <0xa4>;
	};

	opp-table-1 {
		opp-shared;
		compatible = "operating-points-v2";
		phandle = <0x0d>;

		opp04 {
			opp-microvolt = <0xf4240 0xf4240 0x1312d0>;
			opp-hz = <0x00 0x47868c00>;
		};

		opp02 {
			opp-microvolt = <0xd59f8 0xd59f8 0x1312d0>;
			opp-hz = <0x00 0x30a32c00>;
		};

		opp00 {
			opp-microvolt = <0xd59f8 0xd59f8 0x1312d0>;
			opp-hz = <0x00 0x18519600>;
			clock-latency-ns = <0x9c40>;
		};

		opp05 {
			opp-microvolt = <0x106738 0x106738 0x1312d0>;
			opp-hz = <0x00 0x54667200>;
		};

		opp03 {
			opp-microvolt = <0xe1d48 0xe1d48 0x1312d0>;
			opp-hz = <0x00 0x3c14dc00>;
		};

		opp01 {
			opp-microvolt = <0xd59f8 0xd59f8 0x1312d0>;
			opp-hz = <0x00 0x23c34600>;
		};

		opp06 {
			opp-microvolt = <0x118c30 0x118c30 0x1312d0>;
			opp-hz = <0x00 0x5a1f4a00>;
		};
	};

	spi@ff1d0000 {
		pinctrl-names = "default";
		#address-cells = <0x01>;
		pinctrl-0 = <0x53 0x54 0x55 0x56>;
		clock-names = "spiclk\0apb_pclk";
		interrupts = <0x00 0x35 0x04 0x00>;
		clocks = <0x08 0x48 0x08 0x15c>;
		#size-cells = <0x00>;
		dma-names = "tx\0rx";
		compatible = "rockchip,rk3399-spi\0rockchip,rk3066-spi";
		status = "disabled";
		max-freq = <0x989680>;
		reg = <0x00 0xff1d0000 0x00 0x1000>;
		phandle = <0x102>;
		dmas = <0x4e 0x0c 0x4e 0x0d>;

		spi-flash@0 {
			#address-cells = <0x01>;
			#size-cells = <0x01>;
			spi-max-frequency = <0x989680>;
			compatible = "jedec,spi-nor";
			status = "disabled";
			reg = <0x00>;
			phandle = <0x103>;

			partitions {
				#address-cells = <0x01>;
				#size-cells = <0x01>;
				compatible = "fixed-partitions";

				loader@0 {
					label = "loader";
					reg = <0x00 0x400000>;
				};
			};
		};
	};

	i2s@ff880000 {
		power-domains = <0x1c 0x1c>;
		pinctrl-names = "default";
		pinctrl-0 = <0xaa>;
		clock-names = "i2s_clk\0i2s_hclk";
		assigned-clocks = <0x08 0xae>;
		assigned-clock-parents = <0x08 0x05>;
		resets = <0x08 0xe0 0x08 0xc2>;
		interrupts = <0x00 0x27 0x04 0x00>;
		clocks = <0x08 0x56 0x08 0x1d4>;
		dma-names = "tx\0rx";
		#sound-dai-cells = <0x00>;
		compatible = "rockchip,rk3399-i2s\0rockchip,rk3066-i2s";
		status = "okay";
		rockchip,grf = <0x1d>;
		reg = <0x00 0xff880000 0x00 0x1000>;
		phandle = <0xdd>;
		dmas = <0x5f 0x00 0x5f 0x01>;
		reset-names = "reset-m\0reset-h";
	};

	pwm@ff420000 {
		pinctrl-names = "active";
		pinctrl-0 = <0x99>;
		clock-names = "pwm";
		clocks = <0x85 0x1e>;
		#pwm-cells = <0x03>;
		compatible = "rockchip,rk3399-pwm\0rockchip,rk3288-pwm";
		status = "disabled";
		reg = <0x00 0xff420000 0x00 0x10>;
		phandle = <0x11e>;
	};

	pinctrl {
		#address-cells = <0x02>;
		#size-cells = <0x02>;
		compatible = "rockchip,rk3399-pinctrl";
		rockchip,pmu = <0x9d>;
		ranges;
		rockchip,grf = <0x1d>;
		phandle = <0x15a>;

		i2c3 {

			i2c3_gpio {
				rockchip,pins = <0x04 0x11 0x00 0xc8 0x04 0x10 0x00 0xc8>;
				phandle = <0x166>;
			};

			i2c3-xfer {
				rockchip,pins = <0x04 0x11 0x01 0xc8 0x04 0x10 0x01 0xc8>;
				phandle = <0x3f>;
			};
		};

		clock {

			clk-32k {
				rockchip,pins = <0x00 0x00 0x02 0xc8>;
				phandle = <0x163>;
			};
		};

		spi2 {

			spi2-clk {
				rockchip,pins = <0x02 0x0b 0x01 0xcc>;
				phandle = <0x57>;
			};

			spi2-cs0 {
				rockchip,pins = <0x02 0x0c 0x01 0xcc>;
				phandle = <0x5a>;
			};

			spi2-tx {
				rockchip,pins = <0x02 0x0a 0x01 0xcc>;
				phandle = <0x58>;
			};

			spi2-rx {
				rockchip,pins = <0x02 0x09 0x01 0xcc>;
				phandle = <0x59>;
			};
		};

		pcfg-pull-none-12ma {
			drive-strength = <0x0c>;
			bias-disable;
			phandle = <0xcb>;
		};

		pcfg-pull-up-20ma {
			drive-strength = <0x14>;
			phandle = <0xcd>;
			bias-pull-up;
		};

		i2s1 {

			i2s1-2ch-bus {
				rockchip,pins = <0x04 0x03 0x01 0xc8 0x04 0x04 0x01 0xc8 0x04 0x05 0x01 0xc8 0x04 0x06 0x01 0xc8 0x04 0x07 0x01 0xc8>;
				phandle = <0xab>;
			};
		};

		i2c1 {

			i2c1-xfer {
				rockchip,pins = <0x04 0x02 0x01 0xc8 0x04 0x01 0x01 0xc8>;
				phandle = <0x3d>;
			};
		};

		gmac {

			rmii-pins {
				rockchip,pins = <0x03 0x0d 0x01 0xc8 0x03 0x0c 0x01 0xc9 0x03 0x0b 0x01 0xc8 0x03 0x0a 0x01 0xc8 0x03 0x09 0x01 0xc8 0x03 0x08 0x01 0xc8 0x03 0x07 0x01 0xc8 0x03 0x06 0x01 0xc8 0x03 0x05 0x01 0xc9 0x03 0x04 0x01 0xc9>;
				phandle = <0x165>;
			};

			rgmii-pins {
				rockchip,pins = <0x03 0x11 0x01 0xc9 0x03 0x0e 0x01 0xc8 0x03 0x0d 0x01 0xc8 0x03 0x0c 0x01 0xc9 0x03 0x0b 0x01 0xc8 0x03 0x09 0x01 0xc8 0x03 0x08 0x01 0xc8 0x03 0x07 0x01 0xc8 0x03 0x06 0x01 0xc8 0x03 0x05 0x01 0xc9 0x03 0x04 0x01 0xc9 0x03 0x03 0x01 0xc8 0x03 0x02 0x01 0xc8 0x03 0x01 0x01 0xc9 0x03 0x00 0x01 0xc9>;
				phandle = <0x21>;
			};

			rgmii-sleep-pins {
				rockchip,pins = <0x03 0x0f 0x00 0xca>;
				phandle = <0x22>;
			};
		};

		spi0 {

			spi0-tx {
				rockchip,pins = <0x03 0x05 0x02 0xcc>;
				phandle = <0x50>;
			};

			spi0-rx {
				rockchip,pins = <0x03 0x04 0x02 0xcc>;
				phandle = <0x51>;
			};

			spi0-cs1 {
				rockchip,pins = <0x03 0x08 0x02 0xcc>;
				phandle = <0x173>;
			};

			spi0-clk {
				rockchip,pins = <0x03 0x06 0x02 0xcc>;
				phandle = <0x4f>;
			};

			spi0-cs0 {
				rockchip,pins = <0x03 0x07 0x02 0xcc>;
				phandle = <0x52>;
			};
		};

		bt {

			bt-wake-l {
				rockchip,pins = <0x02 0x1b 0x00 0xc8>;
				phandle = <0x49>;
			};

			bt-host-wake-l {
				rockchip,pins = <0x00 0x04 0x00 0xc8>;
				phandle = <0x48>;
			};

			bt-enable-h {
				rockchip,pins = <0x00 0x09 0x00 0xc8>;
				phandle = <0x4a>;
			};
		};

		gpio4@ff790000 {
			gpio-controller;
			interrupts = <0x00 0x12 0x04 0x00>;
			clocks = <0x08 0x152>;
			compatible = "rockchip,gpio-bank";
			#interrupt-cells = <0x02>;
			reg = <0x00 0xff790000 0x00 0x100>;
			phandle = <0xda>;
			#gpio-cells = <0x02>;
			interrupt-controller;
		};

		pcfg-pull-down-4ma {
			drive-strength = <0x04>;
			bias-pull-down;
			phandle = <0x15d>;
		};

		wifi {

			wifi-host-wake-l {
				rockchip,pins = <0x00 0x03 0x00 0xc8>;
				phandle = <0x28>;
			};

			wifi-enable-h {
				rockchip,pins = <0x00 0x0a 0x00 0xc8>;
				phandle = <0xe0>;
			};
		};

		isp {

			isp-flash-trigger-as-gpio {
				rockchip,pins = <0x00 0x11 0x00 0xc8>;
				phandle = <0x187>;
			};

			isp-shutter {
				rockchip,pins = <0x01 0x01 0x01 0xc8 0x01 0x00 0x01 0xc8>;
				phandle = <0x185>;
			};

			isp-dvp-d0d7 {
				rockchip,pins = <0x04 0x1b 0x00 0xc8 0x02 0x0b 0x03 0xc8 0x02 0x00 0x03 0xc8 0x02 0x01 0x03 0xc8 0x02 0x02 0x03 0xc8 0x02 0x03 0x03 0xc8 0x02 0x04 0x03 0xc8 0x02 0x05 0x03 0xc8 0x02 0x06 0x03 0xc8 0x02 0x07 0x03 0xc8 0x02 0x08 0x03 0xc8 0x02 0x09 0x03 0xc8 0x02 0x0a 0x03 0xc8>;
				phandle = <0x184>;
			};

			cif-clkout {
				rockchip,pins = <0x02 0x0b 0x03 0xc8>;
				phandle = <0x183>;
			};

			isp-flash-trigger {
				rockchip,pins = <0x01 0x03 0x01 0xc8>;
				phandle = <0x186>;
			};
		};

		pcfg-pull-down {
			bias-pull-down;
			phandle = <0xd1>;
		};

		uart4 {

			uart4-xfer {
				rockchip,pins = <0x01 0x07 0x01 0xcc 0x01 0x08 0x01 0xcc>;
				phandle = <0x8a>;
			};
		};

		pcfg-pull-none-18ma {
			drive-strength = <0x12>;
			bias-disable;
			phandle = <0xd0>;
		};

		i2c8 {

			i2c8-xfer {
				rockchip,pins = <0x01 0x15 0x01 0xc8 0x01 0x14 0x01 0xc8>;
				phandle = <0x98>;
			};
		};

		vbus_typec {

			vbus-typec-en {
				rockchip,pins = <0x01 0x03 0x00 0xcc>;
				phandle = <0xd6>;
			};
		};

		pcfg-pull-none-20ma {
			drive-strength = <0x14>;
			bias-disable;
			phandle = <0xce>;
		};

		i2c6 {

			i2c6-xfer {
				rockchip,pins = <0x02 0x0a 0x02 0xc8 0x02 0x09 0x02 0xc8>;
				phandle = <0x41>;
			};
		};

		uarthdcp {

			uarthdcp-xfer {
				rockchip,pins = <0x04 0x15 0x02 0xcc 0x04 0x16 0x02 0xcc>;
				phandle = <0x17b>;
			};
		};

		pwm1 {

			pwm1-pin {
				rockchip,pins = <0x04 0x16 0x01 0xc8>;
				phandle = <0x9a>;
			};

			pwm1-pin-pull-down {
				rockchip,pins = <0x04 0x16 0x01 0xd1>;
				phandle = <0x17d>;
			};
		};

		uart2b {

			uart2b-xfer {
				rockchip,pins = <0x04 0x10 0x02 0xcc 0x04 0x11 0x02 0xcc>;
				phandle = <0x178>;
			};
		};

		edp {

			edp-hpd {
				rockchip,pins = <0x04 0x17 0x02 0xc8>;
				phandle = <0x164>;
			};
		};

		spi5 {

			spi5-cs0 {
				rockchip,pins = <0x02 0x17 0x02 0xcc>;
				phandle = <0x63>;
			};

			spi5-tx {
				rockchip,pins = <0x02 0x15 0x02 0xcc>;
				phandle = <0x61>;
			};

			spi5-rx {
				rockchip,pins = <0x02 0x14 0x02 0xcc>;
				phandle = <0x62>;
			};

			spi5-clk {
				rockchip,pins = <0x02 0x16 0x02 0xcc>;
				phandle = <0x60>;
			};
		};

		tsadc {

			otp-pin {
				rockchip,pins = <0x01 0x06 0x00 0xc8>;
				phandle = <0x69>;
			};

			otp-out {
				rockchip,pins = <0x01 0x06 0x01 0xc8>;
				phandle = <0x6a>;
			};
		};

		uart0 {

			uart0-cts {
				rockchip,pins = <0x02 0x12 0x01 0xc8>;
				phandle = <0x44>;
			};

			uart0-rts {
				rockchip,pins = <0x02 0x13 0x01 0xc8>;
				phandle = <0x45>;
			};

			uart0-xfer {
				rockchip,pins = <0x02 0x10 0x01 0xcc 0x02 0x11 0x01 0xcc>;
				phandle = <0x43>;
			};
		};

		i2c4 {

			i2c4-xfer {
				rockchip,pins = <0x01 0x0c 0x01 0xc8 0x01 0x0b 0x01 0xc8>;
				phandle = <0x97>;
			};
		};

		pcfg-pull-down-12ma {
			drive-strength = <0x0c>;
			bias-pull-down;
			phandle = <0x15f>;
		};

		gpio2@ff780000 {
			gpio-controller;
			interrupts = <0x00 0x10 0x04 0x00>;
			clocks = <0x08 0x150>;
			compatible = "rockchip,gpio-bank";
			#interrupt-cells = <0x02>;
			reg = <0x00 0xff780000 0x00 0x100>;
			phandle = <0x47>;
			#gpio-cells = <0x02>;
			interrupt-controller;
		};

		spdif {

			spdif-bus-1 {
				rockchip,pins = <0x03 0x10 0x03 0xc8>;
				phandle = <0x172>;
			};

			spdif-bus {
				rockchip,pins = <0x04 0x15 0x01 0xc8>;
				phandle = <0xa9>;
			};
		};

		gpio0@ff720000 {
			gpio-controller;
			interrupts = <0x00 0x0e 0x04 0x00>;
			clocks = <0x85 0x17>;
			compatible = "rockchip,gpio-bank";
			#interrupt-cells = <0x02>;
			reg = <0x00 0xff720000 0x00 0x100>;
			phandle = <0x27>;
			#gpio-cells = <0x02>;
			interrupt-controller;
		};

		pcfg-output-high {
			output-high;
			phandle = <0x162>;
		};

		pcie {

			pci-clkreqn-cpm {
				rockchip,pins = <0x02 0x1a 0x00 0xc8>;
				phandle = <0x182>;
			};

			pci-clkreqnb-cpm {
				rockchip,pins = <0x04 0x18 0x00 0xc8>;
				phandle = <0x1b>;
			};

			pcie-drv {
				rockchip,pins = <0x03 0x19 0x00 0xc8>;
				phandle = <0xd7>;
			};
		};

		pcfg-pull-up {
			phandle = <0xcc>;
			bias-pull-up;
		};

		spi3 {

			spi3-tx {
				rockchip,pins = <0x01 0x10 0x01 0xcc>;
				phandle = <0x87>;
			};

			spi3-rx {
				rockchip,pins = <0x01 0x0f 0x01 0xcc>;
				phandle = <0x88>;
			};

			spi3-clk {
				rockchip,pins = <0x01 0x11 0x01 0xcc>;
				phandle = <0x86>;
			};

			spi3-cs0 {
				rockchip,pins = <0x01 0x12 0x01 0xcc>;
				phandle = <0x89>;
			};
		};

		pwm3a {

			pwm3a-pin-pull-down {
				rockchip,pins = <0x00 0x06 0x01 0xd1>;
				phandle = <0x17f>;
			};

			pwm3a-pin {
				rockchip,pins = <0x00 0x06 0x01 0xc8>;
				phandle = <0x9c>;
			};
		};

		sdio0 {

			sdio0-clk {
				rockchip,pins = <0x02 0x19 0x01 0xce>;
				phandle = <0x26>;
			};

			sdio0-wp {
				rockchip,pins = <0x00 0x03 0x01 0xcc>;
				phandle = <0x16c>;
			};

			sdio0-bus4 {
				rockchip,pins = <0x02 0x14 0x01 0xcd 0x02 0x15 0x01 0xcd 0x02 0x16 0x01 0xcd 0x02 0x17 0x01 0xcd>;
				phandle = <0x24>;
			};

			sdio0-bkpwr {
				rockchip,pins = <0x02 0x1c 0x01 0xcc>;
				phandle = <0x16b>;
			};

			sdio0-cd {
				rockchip,pins = <0x02 0x1a 0x01 0xcc>;
				phandle = <0x169>;
			};

			sdio0-pwr {
				rockchip,pins = <0x02 0x1b 0x01 0xcc>;
				phandle = <0x16a>;
			};

			sdio0-int {
				rockchip,pins = <0x00 0x04 0x01 0xcc>;
				phandle = <0x16d>;
			};

			sdio0-bus1 {
				rockchip,pins = <0x02 0x14 0x01 0xcc>;
				phandle = <0x168>;
			};

			sdio0-cmd {
				rockchip,pins = <0x02 0x18 0x01 0xcd>;
				phandle = <0x25>;
			};
		};

		pcfg-pull-up-2ma {
			drive-strength = <0x02>;
			phandle = <0x15b>;
			bias-pull-up;
		};

		i2c2 {

			i2c2-xfer {
				rockchip,pins = <0x02 0x01 0x02 0xcb 0x02 0x00 0x02 0xcb>;
				phandle = <0x3e>;
			};
		};

		pmic {

			soc-slppin-slp {
				rockchip,pins = <0x01 0x05 0x01 0xd1>;
				phandle = <0x8d>;
			};

			vsel2-gpio {
				rockchip,pins = <0x01 0x0e 0x00 0xd1>;
				phandle = <0x96>;
			};

			vsel1-gpio {
				rockchip,pins = <0x01 0x11 0x00 0xd1>;
				phandle = <0x95>;
			};

			soc-slppin-rst {
				rockchip,pins = <0x01 0x05 0x02 0xc8>;
				phandle = <0x18a>;
			};

			soc-slppin-gpio {
				rockchip,pins = <0x01 0x05 0x00 0xca>;
				phandle = <0x8f>;
			};

			pmic-int-l {
				rockchip,pins = <0x01 0x15 0x00 0xcc>;
				phandle = <0x8c>;
			};
		};

		pcfg-pull-none {
			bias-disable;
			phandle = <0xc8>;
		};

		spi1 {

			spi1-cs0 {
				rockchip,pins = <0x01 0x0a 0x02 0xcc>;
				phandle = <0x56>;
			};

			spi1-clk {
				rockchip,pins = <0x01 0x09 0x02 0xcc>;
				phandle = <0x53>;
			};

			spi1-tx {
				rockchip,pins = <0x01 0x08 0x02 0xcc>;
				phandle = <0x54>;
			};

			spi1-rx {
				rockchip,pins = <0x01 0x07 0x02 0xcc>;
				phandle = <0x55>;
			};
		};

		pcfg-pull-down-18ma {
			drive-strength = <0x12>;
			bias-pull-down;
			phandle = <0x160>;
		};

		sdmmc {

			sdmmc-wp {
				rockchip,pins = <0x00 0x08 0x01 0xcc>;
				phandle = <0x16f>;
			};

			sdmmc-bus1 {
				rockchip,pins = <0x04 0x08 0x01 0xcf>;
				phandle = <0x16e>;
			};

			sdmmc-cd {
				rockchip,pins = <0x00 0x07 0x01 0xcc>;
				phandle = <0x2d>;
			};

			sdmmc-bus4 {
				rockchip,pins = <0x04 0x08 0x01 0xcf 0x04 0x09 0x01 0xcf 0x04 0x0a 0x01 0xcf 0x04 0x0b 0x01 0xcf>;
				phandle = <0x2e>;
			};

			sdmmc-cmd {
				rockchip,pins = <0x04 0x0d 0x01 0xcf>;
				phandle = <0x2c>;
			};

			sdmmc-clk {
				rockchip,pins = <0x04 0x0c 0x01 0xd0>;
				phandle = <0x2b>;
			};
		};

		i2s0 {

			i2s0-8ch-bus {
				rockchip,pins = <0x03 0x18 0x01 0xc8 0x03 0x1a 0x01 0xc8 0x03 0x1b 0x01 0xc8 0x03 0x1f 0x01 0xc8>;
				phandle = <0xaa>;
			};

			i2s-8ch-mclk {
				rockchip,pins = <0x04 0x00 0x01 0xc8>;
				phandle = <0x94>;
			};

			i2s0-2ch-bus {
				rockchip,pins = <0x03 0x18 0x01 0xc8 0x03 0x19 0x01 0xc8 0x03 0x1a 0x01 0xc8 0x03 0x1b 0x01 0xc8 0x03 0x1f 0x01 0xc8 0x04 0x00 0x01 0xc8>;
				phandle = <0x167>;
			};
		};

		i2c0 {

			i2c0-xfer {
				rockchip,pins = <0x01 0x0f 0x02 0xc8 0x01 0x10 0x02 0xc8>;
				phandle = <0x8b>;
			};
		};

		suspend {

			ap-pwroff {
				rockchip,pins = <0x01 0x05 0x01 0xc8>;
				phandle = <0x170>;
			};

			ddrio-pwroff {
				rockchip,pins = <0x00 0x01 0x01 0xc8>;
				phandle = <0x171>;
			};
		};

		cam_pins {

			cam0-default-pins {
				rockchip,pins = <0x04 0x1b 0x00 0xc8 0x02 0x0b 0x03 0xc8>;
				phandle = <0x188>;
			};

			cam0-sleep-pins {
				rockchip,pins = <0x04 0x1b 0x03 0xc8 0x02 0x0b 0x00 0xc8>;
				phandle = <0x189>;
			};
		};

		vbus_host {

			vcc5v0-host-en {
				rockchip,pins = <0x03 0x1e 0x00 0xcc>;
				phandle = <0xd4>;
			};
		};

		testclk {

			test-clkout2 {
				rockchip,pins = <0x00 0x08 0x03 0xc8>;
				phandle = <0x176>;
			};

			test-clkout0 {
				rockchip,pins = <0x00 0x00 0x01 0xc8>;
				phandle = <0x174>;
			};

			test-clkout1 {
				rockchip,pins = <0x02 0x19 0x02 0xc8>;
				phandle = <0x175>;
			};
		};

		pcfg-pull-up-8ma {
			drive-strength = <0x08>;
			phandle = <0xcf>;
			bias-pull-up;
		};

		pcfg-pull-down-20ma {
			drive-strength = <0x14>;
			bias-pull-down;
			phandle = <0x161>;
		};

		hpd {

			hpd-en {
				rockchip,pins = <0x04 0x19 0x00 0xc8>;
				phandle = <0xdb>;
			};
		};

		pcfg-pull-none-13ma {
			drive-strength = <0x0d>;
			bias-disable;
			phandle = <0xc9>;
		};

		uart3 {

			uart3-cts {
				rockchip,pins = <0x03 0x10 0x02 0xc8>;
				phandle = <0x179>;
			};

			uart3-rts {
				rockchip,pins = <0x03 0x11 0x02 0xc8>;
				phandle = <0x17a>;
			};

			uart3-xfer {
				rockchip,pins = <0x03 0x0e 0x02 0xcc 0x03 0x0f 0x02 0xcc>;
				phandle = <0x4d>;
			};
		};

		pcfg-output-low {
			phandle = <0xca>;
			output-low;
		};

		i2c7 {

			i2c7-xfer {
				rockchip,pins = <0x02 0x08 0x02 0xc8 0x02 0x07 0x02 0xc8>;
				phandle = <0x42>;
			};
		};

		pwm2 {

			pwm2-pin {
				rockchip,pins = <0x01 0x13 0x01 0xc8>;
				phandle = <0x9b>;
			};

			pwm2-pin-pull-down {
				rockchip,pins = <0x01 0x13 0x01 0xd1>;
				phandle = <0x17e>;
			};
		};

		uart2c {

			uart2c-xfer {
				rockchip,pins = <0x04 0x13 0x01 0xcc 0x04 0x14 0x01 0xcc>;
				phandle = <0x4c>;
			};
		};

		uart1 {

			uart1-xfer {
				rockchip,pins = <0x03 0x0c 0x02 0xcc 0x03 0x0d 0x02 0xcc>;
				phandle = <0x4b>;
			};
		};

		hdmi {

			hdmi-i2c-xfer {
				rockchip,pins = <0x04 0x11 0x03 0xc8 0x04 0x10 0x03 0xc8>;
				phandle = <0xbf>;
			};

			hdmi-cec {
				rockchip,pins = <0x04 0x17 0x01 0xc8>;
				phandle = <0xc0>;
			};
		};

		i2c5 {

			i2c5-xfer {
				rockchip,pins = <0x03 0x0b 0x02 0xc8 0x03 0x0a 0x02 0xc8>;
				phandle = <0x40>;
			};
		};

		pwm0 {

			pwm0-pin-pull-down {
				rockchip,pins = <0x04 0x12 0x01 0xd1>;
				phandle = <0x17c>;
			};

			vop1-pwm-pin {
				rockchip,pins = <0x04 0x12 0x03 0xc8>;
				phandle = <0xb2>;
			};

			vop0-pwm-pin {
				rockchip,pins = <0x04 0x12 0x02 0xc8>;
				phandle = <0xb9>;
			};

			pwm0-pin {
				rockchip,pins = <0x04 0x12 0x01 0xc8>;
				phandle = <0x99>;
			};
		};

		uart2a {

			uart2a-xfer {
				rockchip,pins = <0x04 0x08 0x02 0xcc 0x04 0x09 0x02 0xcc>;
				phandle = <0x177>;
			};
		};

		spi4 {

			spi4-clk {
				rockchip,pins = <0x03 0x02 0x02 0xcc>;
				phandle = <0x5b>;
			};

			spi4-tx {
				rockchip,pins = <0x03 0x01 0x02 0xcc>;
				phandle = <0x5c>;
			};

			spi4-rx {
				rockchip,pins = <0x03 0x00 0x02 0xcc>;
				phandle = <0x5d>;
			};

			spi4-cs0 {
				rockchip,pins = <0x03 0x03 0x02 0xcc>;
				phandle = <0x5e>;
			};
		};

		pcfg-pull-down-8ma {
			drive-strength = <0x08>;
			bias-pull-down;
			phandle = <0x15e>;
		};

		gpio1@ff730000 {
			gpio-controller;
			interrupts = <0x00 0x0f 0x04 0x00>;
			clocks = <0x85 0x18>;
			compatible = "rockchip,gpio-bank";
			#interrupt-cells = <0x02>;
			reg = <0x00 0xff730000 0x00 0x100>;
			phandle = <0x1a>;
			#gpio-cells = <0x02>;
			interrupt-controller;
		};

		pwm3b {

			pwm3b-pin {
				rockchip,pins = <0x01 0x0e 0x01 0xc8>;
				phandle = <0x180>;
			};

			pwm3b-pin-pull-down {
				rockchip,pins = <0x01 0x0e 0x01 0xd1>;
				phandle = <0x181>;
			};
		};

		gpio3@ff788000 {
			gpio-controller;
			interrupts = <0x00 0x11 0x04 0x00>;
			clocks = <0x08 0x151>;
			compatible = "rockchip,gpio-bank";
			#interrupt-cells = <0x02>;
			reg = <0x00 0xff788000 0x00 0x100>;
			phandle = <0x1f>;
			#gpio-cells = <0x02>;
			interrupt-controller;
		};

		pcfg-pull-up-18ma {
			drive-strength = <0x12>;
			phandle = <0x15c>;
			bias-pull-up;
		};
	};

	power-management@ff310000 {
		compatible = "rockchip,rk3399-pmu\0syscon\0simple-mfd";
		reg = <0x00 0xff310000 0x00 0x1000>;
		phandle = <0x10b>;

		power-controller {
			#address-cells = <0x01>;
			#size-cells = <0x00>;
			#power-domain-cells = <0x01>;
			compatible = "rockchip,rk3399-power-controller";
			phandle = <0x1c>;

			power-domain@9 {
				clocks = <0x08 0x80 0x08 0x7f>;
				reg = <0x09>;
			};

			power-domain@35 {
				clocks = <0x08 0xd0>;
				reg = <0x23>;
				pm_qos = <0x71>;
			};

			power-domain@25 {
				clocks = <0x08 0x16c>;
				reg = <0x19>;
			};

			power-domain@15 {
				#address-cells = <0x01>;
				#size-cells = <0x00>;
				reg = <0x0f>;

				power-domain@19 {
					clocks = <0x08 0xe5 0x08 0x1df>;
					reg = <0x13>;
					pm_qos = <0x7d 0x7e>;
				};

				power-domain@21 {
					clocks = <0x08 0xde 0x08 0x1e7 0x08 0x172>;
					reg = <0x15>;
					pm_qos = <0x7c>;
				};

				power-domain@16 {
					#address-cells = <0x01>;
					#size-cells = <0x00>;
					reg = <0x10>;

					power-domain@17 {
						clocks = <0x08 0xd9 0x08 0x1d9>;
						reg = <0x11>;
						pm_qos = <0x81 0x82>;
					};

					power-domain@18 {
						clocks = <0x08 0xdb 0x08 0x1db>;
						reg = <0x12>;
						pm_qos = <0x83>;
					};
				};

				power-domain@20 {
					clocks = <0x08 0xe6 0x08 0x1e0>;
					reg = <0x14>;
					pm_qos = <0x7f 0x80>;
				};
			};

			power-domain@33 {
				clocks = <0x08 0xdc 0x08 0x1e5>;
				reg = <0x21>;
				pm_qos = <0x6c 0x6d>;
			};

			power-domain@23 {
				clocks = <0x08 0xf0>;
				reg = <0x17>;
				pm_qos = <0x72>;
			};

			power-domain@31 {
				clocks = <0x08 0xeb 0x08 0x1ea>;
				reg = <0x1f>;
				pm_qos = <0x6e>;
			};

			power-domain@28 {
				clocks = <0x08 0x1ee>;
				reg = <0x1c>;
				pm_qos = <0x79>;
			};

			power-domain@8 {
				clocks = <0x08 0x7e 0x08 0x7d>;
				reg = <0x08>;
			};

			power-domain@34 {
				clocks = <0x08 0xe1 0x08 0x1dd>;
				reg = <0x22>;
				pm_qos = <0x6b>;
			};

			power-domain@24 {
				clocks = <0x08 0xf4>;
				reg = <0x18>;
				pm_qos = <0x7a 0x7b>;
			};

			power-domain@14 {
				#address-cells = <0x01>;
				clocks = <0x08 0xc0>;
				#size-cells = <0x00>;
				reg = <0x0e>;
				pm_qos = <0x74 0x75 0x76 0x77>;

				power-domain@27 {
					clocks = <0x08 0x1ce 0x08 0x4c>;
					reg = <0x1b>;
					pm_qos = <0x78>;
				};
			};

			power-domain@32 {
				clocks = <0x08 0xed 0x08 0x1ec>;
				reg = <0x20>;
				pm_qos = <0x6f 0x70>;
			};

			power-domain@22 {
				clocks = <0x08 0xd5 0x08 0x166>;
				reg = <0x16>;
				pm_qos = <0x73>;
			};
		};
	};

	nocp-hp-msch0@ffa86800 {
		compatible = "rockchip,rk3399-nocp";
		reg = <0x00 0xffa86800 0x00 0x400>;
		phandle = <0x14d>;
	};

	nocp-cci-msch1@ffa8e000 {
		compatible = "rockchip,rk3399-nocp";
		reg = <0x00 0xffa8e000 0x00 0x400>;
		phandle = <0x152>;
	};

	qos@ffa74000 {
		compatible = "syscon";
		reg = <0x00 0xffa74000 0x00 0x20>;
		phandle = <0x78>;
	};

	gpu@ff9a0000 {
		power-domains = <0x1c 0x23>;
		downdifferential = <0x0a>;
		mali-supply = <0xc7>;
		clock-names = "clk_mali";
		interrupts = <0x00 0x14 0x04 0x00 0x00 0x15 0x04 0x00 0x00 0x13 0x04 0x00>;
		clocks = <0x08 0xd0>;
		upthreshold = <0x28>;
		power-off-delay-ms = <0xc8>;
		compatible = "arm,malit860\0arm,malit86x\0arm,malit8xx\0arm,mali-midgard\0rockchip,rk3399-mali\0arm,mali-t860";
		status = "okay";
		interrupt-names = "job\0mmu\0gpu";
		reg = <0x00 0xff9a0000 0x00 0x10000>;
		phandle = <0x66>;
		operating-points-v2 = <0xc6>;
		#cooling-cells = <0x02>;

		power_model {
			thermal-zone = "gpu-thermal";
			dynamic-coefficient = <0x2dd>;
			compatible = "arm,mali-simple-power-model";
			ts = <0x7d00 0x125c 0xffffffb0 0x02>;
			static-coefficient = <0x64578>;
			phandle = <0x14a>;
		};
	};

	dfi@ff630000 {
		clock-names = "pclk_ddr_mon";
		clocks = <0x08 0x179>;
		compatible = "rockchip,rk3399-dfi";
		rockchip,pmu = <0x9d>;
		status = "disabled";
		reg = <0x00 0xff630000 0x00 0x4000>;
		phandle = <0x9e>;
	};

	i2c@ff3e0000 {
		pinctrl-names = "default";
		#address-cells = <0x01>;
		pinctrl-0 = <0x98>;
		clock-names = "i2c\0pclk";
		assigned-clocks = <0x85 0x0b>;
		assigned-clock-rates = <0xbebc200>;
		interrupts = <0x00 0x3a 0x04 0x00>;
		clocks = <0x85 0x0b 0x85 0x1d>;
		#size-cells = <0x00>;
		compatible = "rockchip,rk3399-i2c";
		status = "disabled";
		reg = <0x00 0xff3e0000 0x00 0x1000>;
		phandle = <0x11d>;
	};

	pcie@f8000000 {
		pinctrl-names = "default";
		#address-cells = <0x03>;
		phy-names = "pcie-phy-0\0pcie-phy-1\0pcie-phy-2\0pcie-phy-3";
		bus-range = <0x00 0x1f>;
		pinctrl-0 = <0x1b>;
		clock-names = "aclk\0aclk-perf\0hclk\0pm";
		reg-names = "axi-base\0apb-base";
		ep-gpios = <0x1a 0x01 0x00>;
		resets = <0x08 0x82 0x08 0x83 0x08 0x84 0x08 0x85 0x08 0x86 0x08 0x81 0x08 0x80>;
		interrupts = <0x00 0x31 0x04 0x00 0x00 0x32 0x04 0x00 0x00 0x33 0x04 0x00>;
		clocks = <0x08 0xc5 0x08 0xc4 0x08 0x147 0x08 0xa0>;
		interrupt-map = <0x00 0x00 0x00 0x01 0x17 0x00 0x00 0x00 0x00 0x02 0x17 0x01 0x00 0x00 0x00 0x03 0x17 0x02 0x00 0x00 0x00 0x04 0x17 0x03>;
		#size-cells = <0x02>;
		aspm-no-l0s;
		max-link-speed = <0x01>;
		device_type = "pci";
		interrupt-map-mask = <0x00 0x00 0x00 0x07>;
		num-lanes = <0x04>;
		compatible = "rockchip,rk3399-pcie";
		ranges = <0x83000000 0x00 0xfa000000 0x00 0xfa000000 0x00 0x1e00000 0x81000000 0x00 0xfbe00000 0x00 0xfbe00000 0x00 0x100000>;
		msi-map = <0x00 0x18 0x00 0x1000>;
		#interrupt-cells = <0x01>;
		status = "okay";
		interrupt-names = "sys\0legacy\0client";
		phys = <0x19 0x00 0x19 0x01 0x19 0x02 0x19 0x03>;
		reg = <0x00 0xf8000000 0x00 0x2000000 0x00 0xfd000000 0x00 0x1000000>;
		phandle = <0xe9>;
		reset-names = "core\0mgmt\0mgmt-sticky\0pipe\0pm\0pclk\0aclk";

		interrupt-controller {
			#address-cells = <0x00>;
			#interrupt-cells = <0x01>;
			phandle = <0x17>;
			interrupt-controller;
		};
	};

	qos@ffad0000 {
		compatible = "syscon";
		reg = <0x00 0xffad0000 0x00 0x20>;
		phandle = <0x83>;
	};

	rktimer@ff850000 {
		clock-names = "pclk\0timer";
		interrupts = <0x00 0x51 0x04 0x00>;
		clocks = <0x08 0x168 0x08 0x5a>;
		compatible = "rockchip,rk3399-timer";
		reg = <0x00 0xff850000 0x00 0x1000>;
		phandle = <0x13a>;
	};

	qos@ffaa0080 {
		compatible = "syscon";
		reg = <0x00 0xffaa0080 0x00 0x20>;
		phandle = <0x7e>;
	};

	dmc {
		system-status-freq = <0x01 0xa2990 0x08 0xa2990 0x02 0x50140 0x20 0xa2990 0x10 0xa2990 0x10000 0xa2990 0x2000 0xa2990 0x1000 0xa2990 0xc00 0xa2990 0x4000 0xa2990>;
		downdifferential = <0x14>;
		auto-min-freq = <0x50140>;
		clock-names = "dmc_clk";
		interrupts = <0x00 0x01 0x04 0x00>;
		clocks = <0x08 0xaa>;
		upthreshold = <0x28>;
		center-supply = <0xa1>;
		ddr_timing = <0x9f>;
		devfreq-events = <0x9e>;
		compatible = "rockchip,rk3399-dmc";
		vop-pn-msch-readlatency = <0x00 0x20 0x04 0x20>;
		status = "okay";
		phandle = <0xba>;
		vop-bw-dmc-freq = <0x00 0x2fa 0x65900 0x2fb 0x1869f 0xa2990>;
		operating-points-v2 = <0xa0>;
		auto-freq-en = <0x00>;
	};

	serial@ff1a0000 {
		reg-io-width = <0x04>;
		pinctrl-names = "default";
		pinctrl-0 = <0x4c>;
		clock-names = "baudclk\0apb_pclk";
		assigned-clocks = <0x08 0xad>;
		assigned-clock-parents = <0x08 0x05>;
		interrupts = <0x00 0x64 0x04 0x00>;
		clocks = <0x08 0x53 0x08 0x162>;
		compatible = "rockchip,rk3399-uart\0snps,dw-apb-uart";
		status = "disabled";
		reg = <0x00 0xff1a0000 0x00 0x100>;
		phandle = <0xff>;
		reg-shift = <0x02>;
	};

	qos@ffac8000 {
		compatible = "syscon";
		reg = <0x00 0xffac8000 0x00 0x20>;
		phandle = <0x81>;
	};

	vdpu@ff650400 {
		power-domains = <0x1c 0x1f>;
		iommus = <0xa2>;
		clock-names = "aclk_vcodec\0hclk_vcodec";
		resets = <0x08 0x53 0x08 0x51>;
		interrupts = <0x00 0x71 0x04 0x00>;
		clocks = <0x08 0xeb 0x08 0x1ea>;
		rockchip,srv = <0xa3>;
		rockchip,taskqueue-node = <0x00>;
		compatible = "rockchip,vpu-decoder-v2";
		rockchip,resetgroup-node = <0x00>;
		status = "okay";
		interrupt-names = "irq_dec";
		reg = <0x00 0xff650400 0x00 0x400>;
		phandle = <0x123>;
		reset-names = "shared_video_h\0shared_video_a";
	};

	usb@fe3a0000 {
		phy-names = "usb";
		interrupts = <0x00 0x1c 0x04 0x00>;
		clocks = <0x08 0x1c8 0x08 0x1c9 0x30>;
		compatible = "generic-ohci";
		status = "okay";
		phys = <0x31>;
		reg = <0x00 0xfe3a0000 0x00 0x20000>;
		phandle = <0xef>;
	};

	saradc@ff100000 {
		vref-supply = <0x3c>;
		clock-names = "saradc\0apb_pclk";
		resets = <0x08 0xd4>;
		interrupts = <0x00 0x3e 0x04 0x00>;
		clocks = <0x08 0x50 0x08 0x165>;
		#io-channel-cells = <0x01>;
		compatible = "rockchip,rk3399-saradc";
		status = "okay";
		reg = <0x00 0xff100000 0x00 0x100>;
		phandle = <0xdf>;
		reset-names = "saradc-apb";
	};

	dp0-sound {
		rockchip,jack-det;
		rockchip,cpu = <0xd8>;
		rockchip,codec = <0xd9 0x01>;
		rockchip,card-name = "rockchip-hdmi1";
		compatible = "rockchip,hdmi";
		status = "okay";
		phandle = <0x192>;
		rockchip,mclk-fs = <0x200>;
	};

	rkvdec@ff660000 {
		power-domains = <0x1c 0x20>;
		iommus = <0xa4>;
		clock-names = "aclk_vcodec\0hclk_vcodec\0clk_cabac\0clk_core";
		resets = <0x08 0x5b 0x08 0x59 0x08 0x5a 0x08 0x58 0x08 0x5d 0x08 0x5c>;
		interrupts = <0x00 0x74 0x04 0x00>;
		clocks = <0x08 0xed 0x08 0x1ec 0x08 0x9f 0x08 0x9e>;
		rockchip,srv = <0xa3>;
		rockchip,taskqueue-node = <0x01>;
		compatible = "rockchip,rkv-decoder-rk3399";
		rockchip,resetgroup-node = <0x01>;
		status = "okay";
		interrupt-names = "irq_dec";
		reg = <0x00 0xff660000 0x00 0x400>;
		phandle = <0x125>;
		reset-names = "video_h\0video_a\0niu_h\0niu_a\0video_cabac\0video_core";
	};

	qos@ffad8080 {
		compatible = "syscon";
		reg = <0x00 0xffad8080 0x00 0x20>;
		phandle = <0x74>;
	};

	usb@fe3e0000 {
		phy-names = "usb";
		interrupts = <0x00 0x20 0x04 0x00>;
		clocks = <0x08 0x1ca 0x08 0x1cb 0x32>;
		compatible = "generic-ohci";
		status = "okay";
		phys = <0x33>;
		reg = <0x00 0xfe3e0000 0x00 0x20000>;
		phandle = <0xf1>;
	};

	iep@ff670000 {
		power-domains = <0x1c 0x22>;
		iommus = <0xa5>;
		clock-names = "aclk_iep\0hclk_iep";
		allocator = <0x01>;
		interrupts = <0x00 0x2a 0x04 0x00>;
		clocks = <0x08 0xe1 0x08 0x1dd>;
		compatible = "rockchip,iep";
		status = "okay";
		iommu_enabled = <0x01>;
		reg = <0x00 0xff670000 0x00 0x800>;
		phandle = <0x126>;
		version = <0x02>;
	};

	i2c@ff120000 {
		pinctrl-names = "default";
		#address-cells = <0x01>;
		pinctrl-0 = <0x3e>;
		clock-names = "i2c\0pclk";
		assigned-clocks = <0x08 0x42>;
		assigned-clock-rates = <0xbebc200>;
		interrupts = <0x00 0x23 0x04 0x00>;
		clocks = <0x08 0x42 0x08 0x156>;
		#size-cells = <0x00>;
		compatible = "rockchip,rk3399-i2c";
		status = "okay";
		reg = <0x00 0xff120000 0x00 0x1000>;
		phandle = <0xf8>;
	};

	qos@ffa58000 {
		compatible = "syscon";
		reg = <0x00 0xffa58000 0x00 0x20>;
		phandle = <0x72>;
	};

	mmc@fe320000 {
		power-domains = <0x1c 0x1b>;
		fifo-depth = <0x100>;
		clock-freq-min-max = <0x186a0 0x8f0d180>;
		pinctrl-names = "default";
		pinctrl-0 = <0x2b 0x2c 0x2d 0x2e>;
		clock-names = "biu\0ciu\0ciu-drive\0ciu-sample";
		cap-sd-highspeed;
		vqmmc-supply = <0x2a>;
		assigned-clocks = <0x08 0x1cd>;
		no-mmc;
		bus-width = <0x04>;
		no-sdio;
		assigned-clock-rates = <0xbebc200>;
		resets = <0x08 0x7a>;
		interrupts = <0x00 0x41 0x04 0x00>;
		clocks = <0x08 0x1ce 0x08 0x4c 0x08 0x9a 0x08 0x9b>;
		num-slots = <0x01>;
		vmmc-supply = <0x29>;
		clock-frequency = <0x8f0d180>;
		compatible = "rockchip,rk3399-dw-mshc\0rockchip,rk3288-dw-mshc";
		status = "okay";
		disable-wp;
		reg = <0x00 0xfe320000 0x00 0x4000>;
		phandle = <0xed>;
		sd-uhs-sdr104;
		max-frequency = <0x8f0d180>;
		cap-mmc-highspeed;
		reset-names = "reset";
	};

	hdmi-sound {
		simple-audio-card,name = "hdmi-sound";
		rockchip,jack-det;
		rockchip,cpu = <0xbd>;
		simple-audio-card,format = "i2s";
		rockchip,codec = <0xbe>;
		rockchip,card-name = "rockchip-hdmi0";
		compatible = "rockchip,hdmi";
		status = "okay";
		phandle = <0x143>;
		simple-audio-card,mclk-fs = <0x100>;
		rockchip,mclk-fs = <0x100>;

		simple-audio-card,cpu {
			sound-dai = <0xbd>;
		};

		simple-audio-card,codec {
			sound-dai = <0xbe>;
		};
	};

	syscon@ff770000 {
		#address-cells = <0x01>;
		#size-cells = <0x01>;
		compatible = "rockchip,rk3399-grf\0syscon\0simple-mfd";
		reg = <0x00 0xff770000 0x00 0x10000>;
		phandle = <0x1d>;

		mipi-dphy-rx0 {
			power-domains = <0x1c 0x0f>;
			clock-names = "dphy-ref\0dphy-cfg\0grf";
			clocks = <0x08 0x77 0x08 0xa5 0x08 0x16f>;
			#phy-cells = <0x00>;
			compatible = "rockchip,rk3399-mipi-dphy";
			status = "disabled";
			phandle = <0x135>;
		};

		pcie-phy {
			clock-names = "refclk";
			resets = <0x08 0x87>;
			clocks = <0x08 0x8a>;
			drive-impedance-ohm = <0x32>;
			#phy-cells = <0x01>;
			compatible = "rockchip,rk3399-pcie-phy";
			status = "okay";
			phandle = <0x19>;
			reset-names = "phy";
		};

		pvtm {
			#address-cells = <0x01>;
			#size-cells = <0x00>;
			compatible = "rockchip,rk3399-pvtm";
			status = "okay";
			phandle = <0x136>;

			pvtm@2 {
				clock-names = "clk";
				resets = <0x08 0x4f>;
				clocks = <0x08 0x76>;
				reg = <0x02>;
				reset-names = "rst";
			};

			pvtm@0 {
				clock-names = "clk";
				resets = <0x08 0x1f>;
				clocks = <0x08 0x73>;
				reg = <0x00>;
				reset-names = "rst";
			};

			pvtm@3 {
				clock-names = "clk";
				resets = <0x08 0x123>;
				clocks = <0x08 0x75>;
				reg = <0x03>;
				reset-names = "rst";
			};

			pvtm@1 {
				clock-names = "clk";
				resets = <0x08 0x2f>;
				clocks = <0x08 0x74>;
				reg = <0x01>;
				reset-names = "rst";
			};
		};

		io-domains {
			sdmmc-supply = <0x2a>;
			audio-supply = <0xa6>;
			gpio1830-supply = <0x84>;
			compatible = "rockchip,rk3399-io-voltage-domain";
			status = "okay";
			phandle = <0x134>;
			bt656-supply = <0x84>;
		};

		usb2-phy@e460 {
			clock-output-names = "clk_usbphy1_480m";
			clock-names = "phyclk";
			wakeup-source;
			clocks = <0x08 0x7c>;
			#clock-cells = <0x00>;
			compatible = "rockchip,rk3399-usb2phy";
			status = "okay";
			reg = <0xe460 0x10>;
			phandle = <0x32>;

			host-port {
				phy-supply = <0xa7>;
				interrupts = <0x00 0x1f 0x04 0x00>;
				#phy-cells = <0x00>;
				status = "okay";
				interrupt-names = "linestate";
				phandle = <0x33>;
			};

			otg-port {
				interrupts = <0x00 0x6c 0x04 0x00 0x00 0x6d 0x04 0x00 0x00 0x6f 0x04 0x00>;
				#phy-cells = <0x00>;
				status = "okay";
				interrupt-names = "otg-bvalid\0otg-id\0linestate";
				phandle = <0x36>;
			};
		};

		usb2-phy@e450 {
			clock-output-names = "clk_usbphy0_480m";
			clock-names = "phyclk";
			wakeup-source;
			clocks = <0x08 0x7b>;
			#clock-cells = <0x00>;
			compatible = "rockchip,rk3399-usb2phy";
			status = "okay";
			reg = <0xe450 0x10>;
			phandle = <0x30>;

			host-port {
				phy-supply = <0xa7>;
				interrupts = <0x00 0x1b 0x04 0x00>;
				#phy-cells = <0x00>;
				status = "okay";
				interrupt-names = "linestate";
				phandle = <0x31>;
			};

			otg-port {
				interrupts = <0x00 0x67 0x04 0x00 0x00 0x68 0x04 0x00 0x00 0x6a 0x04 0x00>;
				#phy-cells = <0x00>;
				status = "okay";
				interrupt-names = "otg-bvalid\0otg-id\0linestate";
				phandle = <0x34>;
			};
		};

		phy@f780 {
			clock-names = "emmcclk";
			clocks = <0xa8>;
			#phy-cells = <0x00>;
			compatible = "rockchip,rk3399-emmc-phy";
			status = "okay";
			reg = <0xf780 0x24>;
			phandle = <0x2f>;
		};
	};

	efuse@ff690000 {
		#address-cells = <0x01>;
		clock-names = "pclk_efuse";
		clocks = <0x08 0x17d>;
		#size-cells = <0x01>;
		compatible = "rockchip,rk3399-efuse";
		reg = <0x00 0xff690000 0x00 0x80>;
		phandle = <0x128>;

		cpu-leakage@1a {
			reg = <0x1a 0x01>;
			phandle = <0x12e>;
		};

		center-leakage@19 {
			reg = <0x19 0x01>;
			phandle = <0x12d>;
		};

		logic-leakage@1b {
			reg = <0x1b 0x01>;
			phandle = <0x12f>;
		};

		customer-demand@22 {
			bits = <0x04 0x04>;
			reg = <0x22 0x01>;
			phandle = <0x133>;
		};

		gpu-performance@1e {
			bits = <0x06 0x02>;
			reg = <0x1e 0x01>;
			phandle = <0x132>;
		};

		cpu-performance@1e {
			bits = <0x03 0x03>;
			reg = <0x1e 0x01>;
			phandle = <0x131>;
		};

		cpu-id@7 {
			reg = <0x07 0x10>;
			phandle = <0x12a>;
		};

		gpu-leakage@18 {
			reg = <0x18 0x01>;
			phandle = <0x12c>;
		};

		wafer-info@1c {
			reg = <0x1c 0x01>;
			phandle = <0x130>;
		};

		specification-serial-number@6 {
			bits = <0x00 0x05>;
			reg = <0x06 0x01>;
			phandle = <0x129>;
		};

		cpu-leakage@17 {
			reg = <0x17 0x01>;
			phandle = <0x12b>;
		};
	};

	qos@ffa70080 {
		compatible = "syscon";
		reg = <0x00 0xffa70080 0x00 0x20>;
		phandle = <0x7b>;
	};

	interrupt-controller@fee00000 {
		#address-cells = <0x02>;
		interrupts = <0x01 0x09 0x04 0x00>;
		#size-cells = <0x02>;
		compatible = "arm,gic-v3";
		ranges;
		#interrupt-cells = <0x04>;
		reg = <0x00 0xfee00000 0x00 0x10000 0x00 0xfef00000 0x00 0xc0000 0x00 0xfff00000 0x00 0x10000 0x00 0xfff10000 0x00 0x10000 0x00 0xfff20000 0x00 0x10000>;
		phandle = <0x01>;
		interrupt-controller;

		interrupt-controller@fee20000 {
			msi-controller;
			compatible = "arm,gic-v3-its";
			reg = <0x00 0xfee20000 0x00 0x20000>;
			phandle = <0x18>;
			#msi-cells = <0x01>;
		};

		ppi-partitions {

			interrupt-partition-0 {
				affinity = <0x02 0x03 0x04 0x05>;
				phandle = <0x15>;
			};

			interrupt-partition-1 {
				affinity = <0x06 0x07>;
				phandle = <0x16>;
			};
		};
	};

	i2c@ff160000 {
		pinctrl-names = "default";
		#address-cells = <0x01>;
		pinctrl-0 = <0x42>;
		clock-names = "i2c\0pclk";
		assigned-clocks = <0x08 0x46>;
		assigned-clock-rates = <0xbebc200>;
		interrupts = <0x00 0x24 0x04 0x00>;
		clocks = <0x08 0x46 0x08 0x15a>;
		#size-cells = <0x00>;
		compatible = "rockchip,rk3399-i2c";
		status = "okay";
		reg = <0x00 0xff160000 0x00 0x1000>;
		phandle = <0xfc>;
	};

	qos@ffa98000 {
		compatible = "syscon";
		reg = <0x00 0xffa98000 0x00 0x20>;
		phandle = <0x6b>;
	};

	display-subsystem {
		logo-memory-region = <0x11>;
		clock-names = "hdmi-tmds-pll\0default-vop-pll";
		ports = <0x0f 0x10>;
		clocks = <0x08 0x07 0x08 0x04>;
		compatible = "rockchip,display-subsystem";
		status = "okay";
		phandle = <0xe1>;

		route {

			route-hdmi {
				logo,kernel = "logo_kernel.bmp";
				logo,uboot = "logo.bmp";
				charge_logo,mode = "center";
				connect = <0x12>;
				logo,mode = "center";
				status = "okay";
				phandle = <0xe2>;
			};

			route-dsi {
				logo,kernel = "logo_kernel.bmp";
				logo,uboot = "logo.bmp";
				charge_logo,mode = "center";
				connect = <0x13>;
				logo,mode = "center";
				status = "disabled";
				phandle = <0xe3>;
			};

			route-edp {
				logo,kernel = "logo_kernel.bmp";
				logo,uboot = "logo.bmp";
				charge_logo,mode = "center";
				connect = <0x14>;
				logo,mode = "center";
				status = "disabled";
				phandle = <0xe4>;
			};
		};
	};

	dp@fec00000 {
		power-domains = <0x1c 0x15>;
		clock-names = "core-clk\0pclk\0spdif\0grf";
		assigned-clocks = <0x08 0x72 0x08 0xa1>;
		assigned-clock-rates = <0x5f5e100 0xbebc200>;
		resets = <0x08 0x103 0x08 0x148 0x08 0x14a 0x08 0xfd>;
		interrupts = <0x00 0x09 0x04 0x00>;
		clocks = <0x08 0x72 0x08 0x175 0x08 0xa1 0x08 0x16f>;
		extcon = <0x39>;
		#sound-dai-cells = <0x01>;
		compatible = "rockchip,rk3399-cdn-dp";
		status = "okay";
		rockchip,grf = <0x1d>;
		phys = <0x38>;
		reg = <0x00 0xfec00000 0x00 0x100000>;
		phandle = <0xd9>;
		reset-names = "spdif\0dptx\0apb\0core";

		ports {

			port {
				#address-cells = <0x01>;
				#size-cells = <0x00>;
				phandle = <0xf6>;

				endpoint@1 {
					remote-endpoint = <0x3b>;
					status = "okay";
					reg = <0x01>;
					phandle = <0xb1>;
				};

				endpoint@0 {
					remote-endpoint = <0x3a>;
					status = "disabled";
					reg = <0x00>;
					phandle = <0xb8>;
				};
			};
		};
	};

	nocp-lp-msch1@ffa8ec00 {
		compatible = "rockchip,rk3399-nocp";
		reg = <0x00 0xffa8ec00 0x00 0x400>;
		phandle = <0x155>;
	};

	rng@ff8b8000 {
		clock-names = "clk_crypto\0hclk_crypto";
		assigned-clocks = <0x08 0x86 0x08 0x1d3>;
		assigned-clock-rates = <0x8f0d180 0x5f5e100>;
		clocks = <0x08 0x86 0x08 0x1d3>;
		compatible = "rockchip,cryptov1-rng";
		status = "disabled";
		reg = <0x00 0xff8b8000 0x00 0x1000>;
		phandle = <0x13c>;
	};

	nocp-vio0-msch1@ffa8f400 {
		compatible = "rockchip,rk3399-nocp";
		reg = <0x00 0xffa8f400 0x00 0x400>;
		phandle = <0x157>;
	};

	gpio-leds {
		compatible = "gpio-leds";
		status = "okay";

		user-led1 {
			linux,default-trigger = "default-on";
			default-state = "on";
			gpios = <0x1f 0x1c 0x01>;
		};

		user-led2 {
			linux,default-trigger = "heartbeat";
			default-state = "on";
			gpios = <0x1f 0x1d 0x00>;
		};
	};

	iommu@ff670800 {
		power-domains = <0x1c 0x22>;
		clock-names = "aclk\0iface";
		interrupts = <0x00 0x2a 0x04 0x00>;
		clocks = <0x08 0xe1 0x08 0x1dd>;
		#iommu-cells = <0x00>;
		compatible = "rockchip,iommu";
		status = "okay";
		interrupt-names = "iep_mmu";
		reg = <0x00 0xff670800 0x00 0x40>;
		phandle = <0xa5>;
	};

	spi@ff1e0000 {
		pinctrl-names = "default";
		#address-cells = <0x01>;
		pinctrl-0 = <0x57 0x58 0x59 0x5a>;
		clock-names = "spiclk\0apb_pclk";
		interrupts = <0x00 0x34 0x04 0x00>;
		clocks = <0x08 0x49 0x08 0x15d>;
		#size-cells = <0x00>;
		dma-names = "tx\0rx";
		compatible = "rockchip,rk3399-spi\0rockchip,rk3066-spi";
		status = "disabled";
		reg = <0x00 0xff1e0000 0x00 0x1000>;
		phandle = <0x104>;
		dmas = <0x4e 0x0e 0x4e 0x0f>;
	};

	rga@ff680000 {
		power-domains = <0x1c 0x21>;
		clock-names = "aclk_rga\0hclk_rga\0clk_rga";
		resets = <0x08 0x6a 0x08 0x67 0x08 0x69>;
		interrupts = <0x00 0x37 0x04 0x00>;
		clocks = <0x08 0xdc 0x08 0x1e5 0x08 0x6d>;
		dev_mode = <0x01>;
		compatible = "rockchip,rga2";
		status = "okay";
		reg = <0x00 0xff680000 0x00 0x1000>;
		phandle = <0x127>;
		reset-names = "core\0axi\0ahb";
	};

	i2s@ff890000 {
		power-domains = <0x1c 0x1c>;
		pinctrl-names = "default";
		pinctrl-0 = <0xab>;
		clock-names = "i2s_clk\0i2s_hclk";
		assigned-clocks = <0x08 0xaf>;
		assigned-clock-parents = <0x08 0x05>;
		resets = <0x08 0xe1 0x08 0xc3>;
		interrupts = <0x00 0x28 0x04 0x00>;
		clocks = <0x08 0x57 0x08 0x1d5>;
		dma-names = "tx\0rx";
		#sound-dai-cells = <0x00>;
		compatible = "rockchip,rk3399-i2s\0rockchip,rk3066-i2s";
		status = "okay";
		reg = <0x00 0xff890000 0x00 0x1000>;
		phandle = <0x13b>;
		dmas = <0x5f 0x02 0x5f 0x03>;
		reset-names = "reset-m\0reset-h";
	};

	thermal-zones {
		phandle = <0x107>;

		cpu-thermal {
			polling-delay = <0x3e8>;
			polling-delay-passive = <0x14>;
			thermal-sensors = <0x64 0x00>;
			sustainable-power = <0x1388>;
			phandle = <0x108>;

			trips {

				cpu_crit {
					temperature = <0x19a28>;
					hysteresis = <0x7d0>;
					type = "critical";
					phandle = <0x109>;
				};

				cpu_alert0 {
					temperature = <0xea60>;
					hysteresis = <0x7d0>;
					type = "passive";
					phandle = <0x68>;
				};

				cpu_alert1 {
					temperature = <0x186a0>;
					hysteresis = <0x7d0>;
					type = "passive";
					phandle = <0x65>;
				};
			};

			cooling-maps {

				map4 {
					trip = <0x68>;
					cooling-device = <0x67 0xffffffff 0xffffffff>;
					contribution = <0x2000>;
				};

				map2 {
					trip = <0x65>;
					cooling-device = <0x66 0xffffffff 0xffffffff>;
					contribution = <0x1000>;
				};

				map0 {
					trip = <0x65>;
					cooling-device = <0x02 0xffffffff 0xffffffff>;
					contribution = <0x1000>;
				};

				map3 {
					trip = <0x65>;
					cooling-device = <0x67 0xffffffff 0xffffffff>;
					contribution = <0x2000>;
				};

				map1 {
					trip = <0x65>;
					cooling-device = <0x06 0xffffffff 0xffffffff>;
					contribution = <0x400>;
				};
			};
		};

		gpu-thermal {
			polling-delay = <0x3e8>;
			polling-delay-passive = <0x64>;
			thermal-sensors = <0x64 0x01>;
			phandle = <0x10a>;
		};
	};

	cif_isp@ff910000 {
		power-domains = <0x1c 0x13>;
		iommus = <0xbb>;
		clock-names = "aclk_isp0_noc\0aclk_isp0_wrapper\0hclk_isp0_noc\0hclk_isp0_wrapper\0clk_isp0\0pclk_dphyrx\0clk_cif_out\0clk_cif_pll\0pclk_dphy_ref";
		reg-names = "register\0dsihost-register";
		interrupts = <0x00 0x2b 0x04 0x00>;
		clocks = <0x08 0xe7 0x08 0xe9 0x08 0x1e1 0x08 0x1e3 0x08 0x6e 0x08 0xa5 0x08 0x89 0x08 0x89 0x08 0x77>;
		rockchip,isp,iommu-enable = <0x01>;
		compatible = "rockchip,rk3399-cif-isp";
		status = "disabled";
		rockchip,grf = <0x1d>;
		interrupt-names = "cif_isp10_irq";
		reg = <0x00 0xff910000 0x00 0x4000 0x00 0xff968000 0x00 0x8000>;
		phandle = <0x18e>;
	};

	video-codec@ff650000 {
		power-domains = <0x1c 0x1f>;
		iommus = <0xa2>;
		clock-names = "aclk\0hclk";
		interrupts = <0x00 0x72 0x04 0x00 0x00 0x71 0x04 0x00>;
		clocks = <0x08 0xeb 0x08 0x1ea>;
		compatible = "rockchip,rk3399-vpu";
		status = "okay";
		interrupt-names = "vepu\0vdpu";
		reg = <0x00 0xff650000 0x00 0x800>;
		phandle = <0x121>;
	};

	pmu_a72 {
		interrupts = <0x01 0x07 0x08 0x16>;
		compatible = "arm,cortex-a72-pmu";
	};

	vcc5v0-sys {
		regulator-max-microvolt = <0x4c4b40>;
		regulator-boot-on;
		regulator-always-on;
		regulator-min-microvolt = <0x4c4b40>;
		regulator-name = "vcc5v0_sys";
		compatible = "regulator-fixed";
		phandle = <0x92>;
	};

	iommu@ff914000 {
		power-domains = <0x1c 0x13>;
		clock-names = "aclk\0iface";
		interrupts = <0x00 0x2b 0x04 0x00>;
		clocks = <0x08 0xe9 0x08 0x1e3>;
		#iommu-cells = <0x00>;
		compatible = "rockchip,iommu";
		rockchip,disable-mmu-reset;
		status = "okay";
		interrupt-names = "isp0_mmu";
		reg = <0x00 0xff914000 0x00 0x100 0x00 0xff915000 0x00 0x100>;
		phandle = <0xbb>;
	};

	qos@ffaa0000 {
		compatible = "syscon";
		reg = <0x00 0xffaa0000 0x00 0x20>;
		phandle = <0x7d>;
	};

	psci {
		method = "smc";
		compatible = "arm,psci-1.0";
	};

	nocp-gpu-msch0@ffa86400 {
		compatible = "rockchip,rk3399-nocp";
		reg = <0x00 0xffa86400 0x00 0x400>;
		phandle = <0x14c>;
	};

	xin24m {
		clock-output-names = "xin24m";
		#clock-cells = <0x00>;
		clock-frequency = <0x16e3600>;
		compatible = "fixed-clock";
		phandle = <0xe5>;
	};

	nocp-video-msch1@ffa8f000 {
		compatible = "rockchip,rk3399-nocp";
		reg = <0x00 0xffa8f000 0x00 0x400>;
		phandle = <0x156>;
	};

	spi@ff200000 {
		power-domains = <0x1c 0x1c>;
		pinctrl-names = "default";
		#address-cells = <0x01>;
		pinctrl-0 = <0x60 0x61 0x62 0x63>;
		clock-names = "spiclk\0apb_pclk";
		interrupts = <0x00 0x84 0x04 0x00>;
		clocks = <0x08 0x4b 0x08 0x15f>;
		#size-cells = <0x00>;
		dma-names = "tx\0rx";
		compatible = "rockchip,rk3399-spi\0rockchip,rk3066-spi";
		status = "disabled";
		reg = <0x00 0xff200000 0x00 0x1000>;
		phandle = <0x106>;
		dmas = <0x5f 0x08 0x5f 0x09>;
	};

	qos@ffae0000 {
		compatible = "syscon";
		reg = <0x00 0xffae0000 0x00 0x20>;
		phandle = <0x71>;
	};

	qos@ffab0080 {
		compatible = "syscon";
		reg = <0x00 0xffab0080 0x00 0x20>;
		phandle = <0x6d>;
	};

	iommu@ff903f00 {
		power-domains = <0x1c 0x11>;
		clock-names = "aclk\0iface";
		interrupts = <0x00 0x76 0x04 0x00>;
		clocks = <0x08 0xd9 0x08 0x1d9>;
		#iommu-cells = <0x00>;
		compatible = "rockchip,iommu";
		status = "okay";
		interrupt-names = "vopb_mmu";
		reg = <0x00 0xff903f00 0x00 0x100>;
		phandle = <0xb3>;
		rockchip,disable-device-link-resume;
	};

	dsi@ff960000 {
		power-domains = <0x1c 0x0f>;
		#address-cells = <0x01>;
		clock-names = "ref\0pclk\0phy_cfg\0grf";
		resets = <0x08 0xfb>;
		interrupts = <0x00 0x2d 0x04 0x00>;
		clocks = <0x08 0xa2 0x08 0x170 0x08 0xa3 0x08 0x16f>;
		#size-cells = <0x00>;
		compatible = "rockchip,rk3399-mipi-dsi\0snps,dw-mipi-dsi";
		status = "disabled";
		rockchip,grf = <0x1d>;
		reg = <0x00 0xff960000 0x00 0x8000>;
		phandle = <0x145>;
		reset-names = "apb";

		ports {
			#address-cells = <0x01>;
			#size-cells = <0x00>;

			port@0 {
				#address-cells = <0x01>;
				#size-cells = <0x00>;
				reg = <0x00>;

				endpoint@1 {
					remote-endpoint = <0x13>;
					reg = <0x01>;
					phandle = <0xad>;
				};

				endpoint@0 {
					remote-endpoint = <0xc2>;
					reg = <0x00>;
					phandle = <0xb5>;
				};
			};
		};
	};

	qos@ffa76000 {
		compatible = "syscon";
		reg = <0x00 0xffa76000 0x00 0x20>;
		phandle = <0x79>;
	};

	serial@ff1b0000 {
		reg-io-width = <0x04>;
		pinctrl-names = "default";
		pinctrl-0 = <0x4d>;
		clock-names = "baudclk\0apb_pclk";
		assigned-clocks = <0x08 0xad>;
		assigned-clock-parents = <0x08 0x05>;
		interrupts = <0x00 0x65 0x04 0x00>;
		clocks = <0x08 0x54 0x08 0x163>;
		compatible = "rockchip,rk3399-uart\0snps,dw-apb-uart";
		status = "disabled";
		reg = <0x00 0xff1b0000 0x00 0x100>;
		phandle = <0x100>;
		reg-shift = <0x02>;
	};

	watchdog@ff848000 {
		interrupts = <0x00 0x78 0x04 0x00>;
		clocks = <0x08 0x17c>;
		compatible = "snps,dw-wdt";
		reg = <0x00 0xff848000 0x00 0x100>;
	};

	qos@ffaa8080 {
		compatible = "syscon";
		reg = <0x00 0xffaa8080 0x00 0x20>;
		phandle = <0x80>;
	};

	ddr_timing {
		lpddr3_drv = <0x22>;
		phy_lpddr4_dq_drv = <0x3c>;
		phy_lpddr4_ca_drv = <0x28>;
		ddr3_drv = <0x28>;
		phy_dll_dis_freq = <0x104>;
		standby_idle = <0x00>;
		lpddr4_drv = <0xf0>;
		sr_idle = <0x00>;
		phy_ddr3_odt = <0xf0>;
		lpddr3_odt_dis_freq = <0x29a>;
		phy_lpddr4_ck_cs_drv = <0x28>;
		sr_mc_gate_idle = <0x00>;
		pd_idle = <0x00>;
		compatible = "rockchip,ddr-timing";
		phy_lpddr3_odt = <0xf0>;
		lpddr3_odt = <0xf0>;
		ddr3_odt = <0x78>;
		phandle = <0x9f>;
		lpddr4_dq_odt = <0x28>;
		ddr3_odt_dis_freq = <0x29a>;
		lpddr4_ca_odt = <0x00>;
		auto_lp_dis_freq = <0x29a>;
		lpddr4_odt_dis_freq = <0x320>;
		phy_ddr3_dq_drv = <0x28>;
		phy_ddr3_ca_drv = <0x28>;
		ddr3_dll_dis_freq = <0x12c>;
		phy_lpddr4_odt = <0x28>;
		srpd_lite_idle = <0x00>;
		phy_lpddr3_dq_drv = <0x22>;
		ddr3_speed_bin = <0x15>;
		phy_lpddr3_ca_drv = <0x22>;
	};

	qos@ffa70000 {
		compatible = "syscon";
		reg = <0x00 0xffa70000 0x00 0x20>;
		phandle = <0x7a>;
	};

	nocp-vio1-msch0@ffa87800 {
		compatible = "rockchip,rk3399-nocp";
		reg = <0x00 0xffa87800 0x00 0x400>;
		phandle = <0x151>;
	};

	i2c@ff130000 {
		pinctrl-names = "default";
		#address-cells = <0x01>;
		pinctrl-0 = <0x3f>;
		clock-names = "i2c\0pclk";
		assigned-clocks = <0x08 0x43>;
		assigned-clock-rates = <0xbebc200>;
		interrupts = <0x00 0x22 0x04 0x00>;
		clocks = <0x08 0x43 0x08 0x157>;
		#size-cells = <0x00>;
		compatible = "rockchip,rk3399-i2c";
		status = "disabled";
		reg = <0x00 0xff130000 0x00 0x1000>;
		phandle = <0xf9>;
	};

	opp-table-2 {
		compatible = "operating-points-v2";
		phandle = <0xc6>;

		opp02 {
			opp-microvolt = <0xd59f8 0xd59f8 0x118c30>;
			opp-hz = <0x00 0x17d78400>;
		};

		opp00 {
			opp-microvolt = <0xd59f8 0xd59f8 0x118c30>;
			opp-hz = <0x00 0xbebc200>;
		};

		opp03 {
			opp-microvolt = <0xee098 0xee098 0x118c30>;
			opp-hz = <0x00 0x23c34600>;
		};

		opp01 {
			opp-microvolt = <0xd59f8 0xd59f8 0x118c30>;
			opp-hz = <0x00 0x11e1a300>;
		};
	};

	mipi-dphy-tx1rx1@ff968000 {
		power-domains = <0x1c 0x0f>;
		clock-names = "dphy-ref\0dphy-cfg\0grf\0pclk_mipi_dsi";
		clocks = <0x08 0x77 0x08 0xa4 0x08 0x16f 0x08 0x171>;
		compatible = "rockchip,rk3399-mipi-dphy";
		status = "disabled";
		rockchip,grf = <0x1d>;
		reg = <0x00 0xff968000 0x00 0x8000>;
		phandle = <0x147>;
	};

	voppwm@ff9001a0 {
		pinctrl-names = "active";
		pinctrl-0 = <0xb9>;
		clock-names = "pwm";
		clocks = <0x08 0x6b>;
		#pwm-cells = <0x03>;
		compatible = "rockchip,vop-pwm";
		status = "disabled";
		reg = <0x00 0xff9001a0 0x00 0x10>;
		phandle = <0x140>;
	};

	nocp-hp-msch1@ffa8e800 {
		compatible = "rockchip,rk3399-nocp";
		reg = <0x00 0xffa8e800 0x00 0x400>;
		phandle = <0x154>;
	};

	tsadc@ff260000 {
		pinctrl-names = "gpio\0otpout";
		pinctrl-0 = <0x69>;
		clock-names = "tsadc\0apb_pclk";
		rockchip,hw-tshut-polarity = <0x01>;
		assigned-clocks = <0x08 0x4f>;
		assigned-clock-rates = <0xb71b0>;
		resets = <0x08 0xe8>;
		interrupts = <0x00 0x61 0x04 0x00>;
		rockchip,hw-tshut-mode = <0x01>;
		clocks = <0x08 0x4f 0x08 0x164>;
		#thermal-sensor-cells = <0x01>;
		compatible = "rockchip,rk3399-tsadc";
		pinctrl-1 = <0x6a>;
		status = "okay";
		rockchip,grf = <0x1d>;
		reg = <0x00 0xff260000 0x00 0x100>;
		phandle = <0x64>;
		reset-names = "tsadc-apb";
		rockchip,hw-tshut-temp = <0x1adb0>;
	};

	usb@fe900000 {
		#address-cells = <0x02>;
		clock-names = "ref_clk\0suspend_clk\0bus_clk\0aclk_usb3_rksoc_axi_perf\0aclk_usb3\0grf_clk";
		clocks = <0x08 0x82 0x08 0x84 0x08 0xf7 0x08 0xf8 0x08 0xf4 0x08 0xf9>;
		#size-cells = <0x02>;
		compatible = "rockchip,rk3399-dwc3";
		ranges;
		status = "okay";
		phandle = <0xf4>;

		usb@fe900000 {
			power-domains = <0x1c 0x18>;
			snps,dis_enblslpm_quirk;
			phy-names = "usb2-phy\0usb3-phy";
			clock-names = "ref\0bus_early\0suspend";
			snps,dis-u2-freeclk-exists-quirk;
			phy_type = "utmi_wide";
			snps,dis_u2_susphy_quirk;
			resets = <0x08 0x126>;
			interrupts = <0x00 0x6e 0x04 0x00>;
			clocks = <0x08 0x82 0x08 0xf7 0x08 0x84>;
			compatible = "snps,dwc3";
			snps,dis-del-phy-power-chg-quirk;
			status = "okay";
			phys = <0x36 0x37>;
			reg = <0x00 0xfe900000 0x00 0x100000>;
			phandle = <0xf5>;
			dr_mode = "host";
			reset-names = "usb3-otg";
			snps,dis-tx-ipgap-linecheck-quirk;
		};
	};

	serial@ff180000 {
		reg-io-width = <0x04>;
		pinctrl-names = "default";
		pinctrl-0 = <0x43 0x44 0x45>;
		clock-names = "baudclk\0apb_pclk";
		assigned-clocks = <0x08 0xac>;
		assigned-clock-parents = <0x08 0x05>;
		interrupts = <0x00 0x63 0x04 0x00>;
		clocks = <0x08 0x51 0x08 0x160>;
		compatible = "rockchip,rk3399-uart\0snps,dw-apb-uart";
		status = "okay";
		reg = <0x00 0xff180000 0x00 0x100>;
		phandle = <0xfd>;
		reg-shift = <0x02>;

		bluetooth {
			device-wakeup-gpios = <0x47 0x1b 0x00>;
			pinctrl-names = "default";
			pinctrl-0 = <0x48 0x49 0x4a>;
			clock-names = "lpo";
			clocks = <0x46 0x01>;
			shutdown-gpios = <0x27 0x09 0x00>;
			max-speed = <0x16e360>;
			compatible = "brcm,bcm4345c5";
			vddio-supply = <0x3c>;
			vbat-supply = <0x29>;
			host-wakeup-gpios = <0x27 0x04 0x00>;
		};
	};

	usb@fe380000 {
		phy-names = "usb";
		interrupts = <0x00 0x1a 0x04 0x00>;
		clocks = <0x08 0x1c8 0x08 0x1c9 0x30>;
		compatible = "generic-ehci";
		status = "okay";
		phys = <0x31>;
		reg = <0x00 0xfe380000 0x00 0x20000>;
		phandle = <0xee>;
	};

	ethernet@fe300000 {
		power-domains = <0x1c 0x16>;
		pinctrl-names = "default\0sleep";
		phy-supply = <0x1e>;
		phy-mode = "rgmii";
		snps,txpbl = <0x04>;
		snps,reset-active-low;
		pinctrl-0 = <0x21>;
		clock-names = "stmmaceth\0mac_clk_rx\0mac_clk_tx\0clk_mac_ref\0clk_mac_refout\0aclk_mac\0pclk_mac";
		assigned-clocks = <0x08 0xa6>;
		assigned-clock-parents = <0x20>;
		local-mac-address = [f6 01 81 bf b4 b6];
		resets = <0x08 0x89>;
		interrupts = <0x00 0x0c 0x04 0x00>;
		clocks = <0x08 0x69 0x08 0x67 0x08 0x68 0x08 0x66 0x08 0x6a 0x08 0xd5 0x08 0x166>;
		clock_in_out = "input";
		compatible = "rockchip,rk3399-gmac";
		pinctrl-1 = <0x22>;
		status = "okay";
		rockchip,grf = <0x1d>;
		interrupt-names = "macirq";
		snps,reset-gpio = <0x1f 0x0f 0x01>;
		reg = <0x00 0xfe300000 0x00 0x10000>;
		rx_delay = <0x21>;
		phandle = <0xea>;
		reset-names = "stmmaceth";
		tx_delay = <0x2a>;
		snps,reset-delays-us = <0x00 0x4e20 0x186a0>;
	};

	spi@ff350000 {
		pinctrl-names = "default";
		#address-cells = <0x01>;
		pinctrl-0 = <0x86 0x87 0x88 0x89>;
		clock-names = "spiclk\0apb_pclk";
		interrupts = <0x00 0x3c 0x04 0x00>;
		clocks = <0x85 0x03 0x85 0x1f>;
		#size-cells = <0x00>;
		compatible = "rockchip,rk3399-spi\0rockchip,rk3066-spi";
		status = "disabled";
		reg = <0x00 0xff350000 0x00 0x1000>;
		phandle = <0x10f>;
	};

	vcc-phy-regulator {
		regulator-boot-on;
		regulator-always-on;
		regulator-name = "vcc_phy";
		compatible = "regulator-fixed";
		phandle = <0x1e>;
	};

	spi@ff1f0000 {
		pinctrl-names = "default";
		#address-cells = <0x01>;
		pinctrl-0 = <0x5b 0x5c 0x5d 0x5e>;
		clock-names = "spiclk\0apb_pclk";
		interrupts = <0x00 0x43 0x04 0x00>;
		clocks = <0x08 0x4a 0x08 0x15e>;
		#size-cells = <0x00>;
		dma-names = "tx\0rx";
		compatible = "rockchip,rk3399-spi\0rockchip,rk3066-spi";
		status = "disabled";
		reg = <0x00 0xff1f0000 0x00 0x1000>;
		phandle = <0x105>;
		dmas = <0x4e 0x12 0x4e 0x13>;
	};

	syscon@ff320000 {
		compatible = "rockchip,rk3399-pmugrf\0syscon\0simple-mfd";
		reg = <0x00 0xff320000 0x00 0x1000>;
		phandle = <0x9d>;

		pmu-pvtm {
			#address-cells = <0x01>;
			#size-cells = <0x00>;
			compatible = "rockchip,rk3399-pmu-pvtm";
			status = "okay";
			phandle = <0x10e>;

			pvtm@4 {
				clock-names = "clk";
				resets = <0x85 0x1b>;
				clocks = <0x85 0x07>;
				reg = <0x04>;
				reset-names = "rst";
			};
		};

		reboot-mode {
			mode-normal = <0x5242c300>;
			mode-loader = <0x5242c301>;
			mode-recovery = <0x5242c303>;
			mode-ums = <0x5242c30c>;
			mode-fastboot = <0x5242c309>;
			offset = <0x300>;
			compatible = "syscon-reboot-mode";
			phandle = <0x10d>;
			mode-charge = <0x5242c30b>;
			mode-panic = <0x5242c307>;
		};

		io-domains {
			compatible = "rockchip,rk3399-pmu-io-voltage-domain";
			status = "okay";
			pmu1830-supply = <0x84>;
			phandle = <0x10c>;
		};
	};

	mpp-srv {
		rockchip,resetgroup-count = <0x02>;
		rockchip,taskqueue-count = <0x02>;
		compatible = "rockchip,mpp-service";
		status = "okay";
		phandle = <0xa3>;
	};

	iommu@ff8f3f00 {
		power-domains = <0x1c 0x12>;
		clock-names = "aclk\0iface";
		interrupts = <0x00 0x77 0x04 0x00>;
		clocks = <0x08 0xdb 0x08 0x1db>;
		#iommu-cells = <0x00>;
		compatible = "rockchip,iommu";
		status = "okay";
		interrupt-names = "vopl_mmu";
		reg = <0x00 0xff8f3f00 0x00 0x100>;
		phandle = <0xac>;
		rockchip,disable-device-link-resume;
	};

	cif_isp@ff920000 {
		power-domains = <0x1c 0x14>;
		iommus = <0xbc>;
		clock-names = "aclk_isp1_noc\0aclk_isp1_wrapper\0hclk_isp1_noc\0hclk_isp1_wrapper\0clk_isp1\0pclkin_isp1\0pclk_dphytxrx\0pclk_mipi_dsi\0mipi_dphy_cfg\0clk_cif_out\0clk_cif_pll\0pclk_dphy_ref";
		reg-names = "register\0dsihost-register";
		interrupts = <0x00 0x2c 0x04 0x00>;
		clocks = <0x08 0xe8 0x08 0xea 0x08 0x1e2 0x08 0x1e4 0x08 0x6f 0x08 0x17b 0x08 0xa4 0x08 0x171 0x08 0x78 0x08 0x89 0x08 0x89 0x08 0x77>;
		rockchip,isp,iommu-enable = <0x01>;
		compatible = "rockchip,rk3399-cif-isp";
		status = "disabled";
		rockchip,grf = <0x1d>;
		interrupt-names = "cif_isp10_irq";
		reg = <0x00 0xff920000 0x00 0x4000 0x00 0xff968000 0x00 0x8000>;
		phandle = <0x18f>;
	};

	vbus-typec {
		pinctrl-names = "default";
		regulator-boot-on;
		gpio = <0x1a 0x03 0x00>;
		pinctrl-0 = <0xd6>;
		regulator-always-on;
		enable-active-high;
		regulator-name = "vbus_typec";
		compatible = "regulator-fixed";
		phandle = <0x190>;
		vin-supply = <0x92>;
	};

	timer {
		arm,no-tick-in-suspend;
		interrupts = <0x01 0x0d 0x08 0x00 0x01 0x0e 0x08 0x00 0x01 0x0b 0x08 0x00 0x01 0x0a 0x08 0x00>;
		compatible = "arm,armv8-timer";
	};

	video-codec@ff660000 {
		power-domains = <0x1c 0x20>;
		iommus = <0xa4>;
		clock-names = "axi\0ahb\0cabac\0core";
		interrupts = <0x00 0x74 0x04 0x00>;
		clocks = <0x08 0xed 0x08 0x1ec 0x08 0x9f 0x08 0x9e>;
		compatible = "rockchip,rk3399-vdec";
		status = "disabled";
		reg = <0x00 0xff660000 0x00 0x400>;
		phandle = <0x124>;
	};

	opp-table-0 {
		opp-shared;
		compatible = "operating-points-v2";
		phandle = <0x0b>;

		opp02 {
			opp-microvolt = <0xdbba0 0xdbba0 0x1312d0>;
			opp-hz = <0x00 0x30a32c00>;
		};

		opp00 {
			opp-microvolt = <0xd59f8 0xd59f8 0x1312d0>;
			opp-hz = <0x00 0x18519600>;
			clock-latency-ns = <0x9c40>;
		};

		opp03 {
			opp-microvolt = <0xee098 0xee098 0x1312d0>;
			opp-hz = <0x00 0x3c14dc00>;
		};

		opp01 {
			opp-microvolt = <0xd59f8 0xd59f8 0x1312d0>;
			opp-hz = <0x00 0x23c34600>;
		};
	};

	rockchip-suspend {
		rockchip,sleep-debug-en = <0x01>;
		rockchip,sleep-mode-config = <0x5e>;
		rockchip,virtual-poweroff = <0x00>;
		rockchip,pwm-regulator-config = <0x04>;
		compatible = "rockchip,pm-rk3399";
		status = "okay";
		rockchip,wakeup-config = <0x4884>;
		phandle = <0x18b>;
		rockchip,power-ctrl = <0x1a 0x11 0x00 0x1a 0x0e 0x00 0x27 0x03 0x00>;
	};

	sdio-pwrseq {
		pinctrl-names = "default";
		pinctrl-0 = <0xe0>;
		clock-names = "ext_clock";
		clocks = <0x46 0x01>;
		reset-gpios = <0x27 0x0a 0x01>;
		compatible = "mmc-pwrseq-simple";
		phandle = <0x23>;
	};

	iommu@ff924000 {
		power-domains = <0x1c 0x14>;
		clock-names = "aclk\0iface";
		interrupts = <0x00 0x2c 0x04 0x00>;
		clocks = <0x08 0xea 0x08 0x1e4>;
		#iommu-cells = <0x00>;
		compatible = "rockchip,iommu";
		rockchip,disable-mmu-reset;
		status = "okay";
		interrupt-names = "isp1_mmu";
		reg = <0x00 0xff924000 0x00 0x100 0x00 0xff925000 0x00 0x100>;
		phandle = <0xbc>;
	};

	rkisp1@ff910000 {
		power-domains = <0x1c 0x13>;
		iommus = <0xbb>;
		clock-names = "clk_isp\0aclk_isp\0hclk_isp\0aclk_isp_wrap\0hclk_isp_wrap";
		interrupts = <0x00 0x2b 0x04 0x00>;
		clocks = <0x08 0x6e 0x08 0xe5 0x08 0x1df 0x08 0xe9 0x08 0x1e3>;
		compatible = "rockchip,rk3399-rkisp1";
		status = "disabled";
		devfreq = <0xba>;
		interrupt-names = "isp_irq";
		reg = <0x00 0xff910000 0x00 0x4000>;
		phandle = <0x141>;
	};

	bus {
		#address-cells = <0x02>;
		#size-cells = <0x02>;
		compatible = "simple-bus";
		ranges;
		phandle = <0xe8>;

		dma-controller@ff6e0000 {
			clock-names = "apb_pclk";
			interrupts = <0x00 0x07 0x04 0x00 0x00 0x08 0x04 0x00>;
			clocks = <0x08 0xd4>;
			arm,pl330-periph-burst;
			compatible = "arm,pl330\0arm,primecell";
			reg = <0x00 0xff6e0000 0x00 0x4000>;
			phandle = <0x4e>;
			#dma-cells = <0x01>;
		};

		dma-controller@ff6d0000 {
			clock-names = "apb_pclk";
			interrupts = <0x00 0x05 0x04 0x00 0x00 0x06 0x04 0x00>;
			clocks = <0x08 0xd3>;
			arm,pl330-periph-burst;
			compatible = "arm,pl330\0arm,primecell";
			reg = <0x00 0xff6d0000 0x00 0x4000>;
			phandle = <0x5f>;
			#dma-cells = <0x01>;
		};
	};

	opp-table3 {
		compatible = "operating-points-v2";
		phandle = <0xa0>;

		opp-300000000 {
			opp-microvolt = <0xdbba0>;
			opp-hz = <0x00 0x11e1a300>;
			status = "disabled";
		};

		opp-416000000 {
			opp-microvolt = <0xdbba0>;
			opp-hz = <0x00 0x18cba800>;
		};

		opp-328000000 {
			opp-microvolt = <0xdbba0>;
			opp-hz = <0x00 0x138ce200>;
		};

		opp-200000000 {
			opp-microvolt = <0xdbba0>;
			opp-hz = <0x00 0xbebc200>;
			status = "disabled";
		};

		opp-528000000 {
			opp-microvolt = <0xdbba0>;
			opp-hz = <0x00 0x1f78a400>;
			status = "disabled";
		};

		opp-400000000 {
			opp-microvolt = <0xdbba0>;
			opp-hz = <0x00 0x17d78400>;
			status = "disabled";
		};

		opp-666000000 {
			opp-microvolt = <0xdbba0>;
			opp-hz = <0x00 0x27b25a80>;
		};

		opp-600000000 {
			opp-microvolt = <0xdbba0>;
			opp-hz = <0x00 0x23c34600>;
			status = "disabled";
		};
	};

	i2c@ff3c0000 {
		pinctrl-names = "default";
		#address-cells = <0x01>;
		pinctrl-0 = <0x8b>;
		clock-names = "i2c\0pclk";
		assigned-clocks = <0x85 0x09>;
		i2c-scl-rising-time-ns = <0xb4>;
		i2c-scl-falling-time-ns = <0x1e>;
		assigned-clock-rates = <0xbebc200>;
		interrupts = <0x00 0x39 0x04 0x00>;
		clocks = <0x85 0x09 0x85 0x1b>;
		#size-cells = <0x00>;
		clock-frequency = <0xf4240>;
		compatible = "rockchip,rk3399-i2c";
		status = "okay";
		reg = <0x00 0xff3c0000 0x00 0x1000>;
		phandle = <0x111>;

		at24c04@50 {
			compatible = "atmel,24c04";
			status = "okay";
			pagesize = <0x08>;
			reg = <0x50>;
			phandle = <0x11b>;
		};

		pmic@20 {
			pinctrl-names = "default\0pmic-sleep\0pmic-power-off\0pmic-reset";
			pinctrl-2 = <0x8f 0x90>;
			rockchip,system-power-controller;
			clock-output-names = "rk808-clkout1\0rk808-clkout2";
			pinctrl-0 = <0x8c>;
			wakeup-source;
			interrupts = <0x15 0x08>;
			#clock-cells = <0x01>;
			interrupt-parent = <0x1a>;
			vcc1-supply = <0x92>;
			pmic-reset-func = <0x00>;
			pinctrl-3 = <0x8f 0x91>;
			vcc2-supply = <0x92>;
			compatible = "rockchip,rk809";
			vcc3-supply = <0x92>;
			pinctrl-1 = <0x8d 0x8e>;
			vcc4-supply = <0x92>;
			vcc5-supply = <0x93>;
			reg = <0x20>;
			phandle = <0x46>;
			vcc6-supply = <0x93>;
			vcc7-supply = <0x92>;
			vcc8-supply = <0x29>;
			vcc9-supply = <0x92>;

			pinctrl_rk8xx {
				gpio-controller;
				phandle = <0x112>;
				#gpio-cells = <0x02>;

				rk809_slppin_slp {
					function = "pin_fun1";
					pins = "gpio_slp";
					phandle = <0x8e>;
				};

				rk809_slppin_null {
					function = "pin_fun0";
					pins = "gpio_slp";
					phandle = <0x91>;
				};

				rk809_slppin_pwrdn {
					function = "pin_fun2";
					pins = "gpio_slp";
					phandle = <0x90>;
				};

				rk809_slppin_rst {
					function = "pin_fun3";
					pins = "gpio_slp";
					phandle = <0x113>;
				};
			};

			pwrkey {
				status = "okay";
			};

			regulators {

				DCDC_REG4 {
					regulator-max-microvolt = <0x325aa0>;
					regulator-boot-on;
					regulator-always-on;
					regulator-min-microvolt = <0x325aa0>;
					regulator-name = "vcc3v3_sys";
					regulator-initial-mode = <0x02>;
					phandle = <0x29>;

					regulator-state-mem {
						regulator-suspend-microvolt = <0x325aa0>;
						regulator-on-in-suspend;
					};
				};

				LDO_REG4 {
					regulator-max-microvolt = <0x1c3a90>;
					regulator-boot-on;
					regulator-always-on;
					regulator-min-microvolt = <0x1c3a90>;
					regulator-name = "vcca_1v8";
					phandle = <0xa6>;

					regulator-state-mem {
						regulator-off-in-suspend;
					};
				};

				DCDC_REG2 {
					regulator-max-microvolt = <0x149970>;
					regulator-boot-on;
					regulator-always-on;
					regulator-min-microvolt = <0xb71b0>;
					regulator-name = "vdd_cpu_l";
					regulator-ramp-delay = <0x1771>;
					regulator-initial-mode = <0x02>;
					phandle = <0x0c>;

					regulator-state-mem {
						regulator-off-in-suspend;
					};
				};

				LDO_REG2 {
					regulator-max-microvolt = <0x1b7740>;
					regulator-boot-on;
					regulator-always-on;
					regulator-min-microvolt = <0x1b7740>;
					regulator-name = "vcc_1v8";
					phandle = <0x3c>;

					regulator-state-mem {
						regulator-suspend-microvolt = <0x1b7740>;
						regulator-on-in-suspend;
					};
				};

				LDO_REG9 {
					regulator-max-microvolt = <0x325aa0>;
					regulator-boot-on;
					regulator-always-on;
					regulator-min-microvolt = <0x325aa0>;
					regulator-name = "vcc_cam";
					phandle = <0x119>;

					regulator-state-mem {
						regulator-off-in-suspend;
					};
				};

				SWITCH_REG1 {
					regulator-max-microvolt = <0x4c4b40>;
					regulator-min-microvolt = <0x4c4b40>;
					regulator-name = "vcc5v0_usb2.0";
					phandle = <0xd5>;

					regulator-state-mem {
						regulator-suspend-microvolt = <0x4c4b40>;
						regulator-on-in-suspend;
					};
				};

				LDO_REG7 {
					regulator-max-microvolt = <0x2dc6c0>;
					regulator-boot-on;
					regulator-always-on;
					regulator-min-microvolt = <0x2dc6c0>;
					regulator-name = "vcc_3v0";
					phandle = <0x84>;

					regulator-state-mem {
						regulator-off-in-suspend;
					};
				};

				DCDC_REG5 {
					regulator-max-microvolt = <0x325aa0>;
					regulator-boot-on;
					regulator-always-on;
					regulator-min-microvolt = <0x325aa0>;
					regulator-name = "vcc_buck5";
					phandle = <0x93>;

					regulator-state-mem {
						regulator-suspend-microvolt = <0x325aa0>;
						regulator-on-in-suspend;
					};
				};

				LDO_REG5 {
					regulator-max-microvolt = <0x2dc6c0>;
					regulator-boot-on;
					regulator-always-on;
					regulator-min-microvolt = <0x2dc6c0>;
					regulator-name = "vcc_mipi";
					phandle = <0x117>;

					regulator-state-mem {
						regulator-off-in-suspend;
					};
				};

				DCDC_REG3 {
					regulator-boot-on;
					regulator-always-on;
					regulator-name = "vcc_ddr";
					regulator-initial-mode = <0x02>;
					phandle = <0x114>;

					regulator-state-mem {
						regulator-on-in-suspend;
					};
				};

				LDO_REG3 {
					regulator-max-microvolt = <0xdbba0>;
					regulator-boot-on;
					regulator-always-on;
					regulator-min-microvolt = <0xdbba0>;
					regulator-name = "vcc0v9_soc";
					phandle = <0x116>;

					regulator-state-mem {
						regulator-suspend-microvolt = <0xdbba0>;
						regulator-on-in-suspend;
					};
				};

				DCDC_REG1 {
					regulator-max-microvolt = <0x149970>;
					regulator-boot-on;
					regulator-always-on;
					regulator-min-microvolt = <0xb71b0>;
					regulator-name = "vdd_log";
					regulator-initial-mode = <0x02>;
					phandle = <0xa1>;

					regulator-state-mem {
						regulator-off-in-suspend;
						regulator-suspend-microvolt = <0xdbba0>;
					};
				};

				LDO_REG1 {
					regulator-max-microvolt = <0xdbba0>;
					regulator-boot-on;
					regulator-always-on;
					regulator-min-microvolt = <0xdbba0>;
					regulator-name = "vcca_0v9";
					phandle = <0x115>;

					regulator-state-mem {
						regulator-off-in-suspend;
					};
				};

				SWITCH_REG2 {
					regulator-max-microvolt = <0x325aa0>;
					regulator-boot-on;
					regulator-always-on;
					regulator-min-microvolt = <0x325aa0>;
					regulator-name = "lcd_3v3";
					phandle = <0x11a>;

					regulator-state-mem {
						regulator-off-in-suspend;
					};
				};

				LDO_REG8 {
					regulator-max-microvolt = <0x325aa0>;
					regulator-boot-on;
					regulator-always-on;
					regulator-min-microvolt = <0x1b7740>;
					regulator-name = "vccio_sd";
					phandle = <0x2a>;

					regulator-state-mem {
						regulator-off-in-suspend;
					};
				};

				LDO_REG6 {
					regulator-max-microvolt = <0x16e360>;
					regulator-boot-on;
					regulator-always-on;
					regulator-min-microvolt = <0x16e360>;
					regulator-name = "vcc_1v5";
					phandle = <0x118>;

					regulator-state-mem {
						regulator-off-in-suspend;
					};
				};
			};

			codec {
				pinctrl-names = "default";
				spk-volume = <0x03>;
				pinctrl-0 = <0x94>;
				clock-names = "mclk";
				assigned-clocks = <0x08 0x40>;
				assigned-clock-parents = <0x08 0x56>;
				clocks = <0x08 0x59>;
				#sound-dai-cells = <0x00>;
				hp-volume = <0x14>;
				compatible = "rockchip,rk809-codec\0rockchip,rk817-codec";
				status = "okay";
				phandle = <0xde>;
			};

			rtc {
				status = "okay";
			};
		};

		syr827@40 {
			regulator-max-microvolt = <0x16e360>;
			regulator-boot-on;
			pinctrl-0 = <0x95>;
			regulator-always-on;
			regulator-min-microvolt = <0xadf34>;
			regulator-name = "vdd_cpu_b";
			regulator-ramp-delay = <0x3e8>;
			fcs,suspend-voltage-selector = <0x01>;
			compatible = "silergy,syr827";
			reg = <0x40>;
			phandle = <0x0e>;
			vsel-gpios = <0x1a 0x11 0x00>;
			vin-supply = <0x92>;
			regulator-compatible = "fan53555-reg";

			regulator-state-mem {
				regulator-off-in-suspend;
			};
		};

		syr828@41 {
			regulator-max-microvolt = <0x16e360>;
			regulator-boot-on;
			pinctrl-0 = <0x96>;
			regulator-always-on;
			regulator-min-microvolt = <0xadf34>;
			regulator-name = "vdd_gpu";
			regulator-ramp-delay = <0x3e8>;
			fcs,suspend-voltage-selector = <0x01>;
			compatible = "silergy,syr828";
			regulator-initial-mode = <0x01>;
			reg = <0x41>;
			phandle = <0xc7>;
			vsel-gpios = <0x1a 0x0e 0x00>;
			vin-supply = <0x92>;
			regulator-compatible = "fan53555-reg";

			regulator-state-mem {
				regulator-off-in-suspend;
			};
		};
	};

	qos@ffab0000 {
		compatible = "syscon";
		reg = <0x00 0xffab0000 0x00 0x20>;
		phandle = <0x6c>;
	};

	hdmi@ff940000 {
		power-domains = <0x1c 0x15>;
		reg-io-width = <0x04>;
		pinctrl-names = "default";
		#address-cells = <0x01>;
		pinctrl-0 = <0xbf 0xc0>;
		clock-names = "iahb\0isfr\0cec\0grf\0vpll";
		interrupts = <0x00 0x17 0x04 0x00>;
		clocks = <0x08 0x174 0x08 0x71 0x08 0x70 0x08 0x16f 0x08 0x07>;
		#size-cells = <0x00>;
		#sound-dai-cells = <0x00>;
		compatible = "rockchip,rk3399-dw-hdmi";
		status = "okay";
		rockchip,grf = <0x1d>;
		reg = <0x00 0xff940000 0x00 0x20000>;
		phandle = <0xbe>;

		ports {

			port {
				#address-cells = <0x01>;
				#size-cells = <0x00>;
				phandle = <0x144>;

				endpoint@1 {
					remote-endpoint = <0xc1>;
					status = "disabled";
					reg = <0x01>;
					phandle = <0xaf>;
				};

				endpoint@0 {
					remote-endpoint = <0x12>;
					status = "okay";
					reg = <0x00>;
					phandle = <0xb6>;
				};
			};
		};
	};

	phy@ff800000 {
		power-domains = <0x1c 0x09>;
		clock-names = "tcpdcore\0tcpdphy-ref";
		assigned-clocks = <0x08 0x80>;
		assigned-clock-rates = <0x2faf080>;
		resets = <0x08 0x9d 0x08 0x9c 0x08 0x14d>;
		clocks = <0x08 0x80 0x08 0x7f>;
		compatible = "rockchip,rk3399-typec-phy";
		status = "okay";
		rockchip,grf = <0x1d>;
		reg = <0x00 0xff800000 0x00 0x40000>;
		phandle = <0x138>;
		reset-names = "uphy\0uphy-pipe\0uphy-tcphy";

		dp-port {
			#phy-cells = <0x00>;
			phandle = <0x139>;
		};

		usb3-port {
			#phy-cells = <0x00>;
			phandle = <0x37>;
		};
	};

	pwm-fan {
		cooling-levels = <0x00 0x40 0x80 0xc0 0xff>;
		compatible = "pwm-fan";
		phandle = <0x67>;
		pwms = <0xd3 0x00 0x9c40 0x00>;
		#cooling-cells = <0x02>;
	};

	qos@ffaa8000 {
		compatible = "syscon";
		reg = <0x00 0xffaa8000 0x00 0x20>;
		phandle = <0x7f>;
	};

	vcc3v3-pcie-regulator {
		pinctrl-names = "default";
		regulator-boot-on;
		gpio = <0x1f 0x19 0x00>;
		pinctrl-0 = <0xd7>;
		regulator-always-on;
		enable-active-high;
		regulator-name = "vcc3v3_pcie";
		compatible = "regulator-fixed";
		phandle = <0x191>;
		vin-supply = <0x92>;
	};

	aliases {
		i2c3 = "/i2c@ff130000";
		ethernet0 = "/ethernet@fe300000";
		spi2 = "/spi@ff1e0000";
		gpio0 = "/pinctrl/gpio0@ff720000";
		dsi1 = "/dsi@ff968000";
		i2c1 = "/i2c@ff110000";
		mmc1 = "/sdhci@fe330000";
		i2c8 = "/i2c@ff3e0000";
		serial3 = "/serial@ff1b0000";
		i2c6 = "/i2c@ff150000";
		serial1 = "/serial@ff190000";
		pwm1 = "/pwm@ff420010";
		gpio3 = "/pinctrl/gpio3@ff788000";
		i2c4 = "/i2c@ff3d0000";
		gpio1 = "/pinctrl/gpio1@ff730000";
		i2c2 = "/i2c@ff120000";
		spi1 = "/spi@ff1d0000";
		dsi0 = "/dsi@ff960000";
		i2c0 = "/i2c@ff3c0000";
		mmc2 = "/mmc@fe310000";
		serial4 = "/serial@ff370000";
		mmc0 = "/mmc@fe320000";
		i2c7 = "/i2c@ff160000";
		serial2 = "/serial@ff1a0000";
		gpio4 = "/pinctrl/gpio4@ff790000";
		i2c5 = "/i2c@ff140000";
		serial0 = "/serial@ff180000";
		pwm0 = "/pwm@ff420000";
		gpio2 = "/pinctrl/gpio2@ff780000";
	};

	qos@ffac0080 {
		compatible = "syscon";
		reg = <0x00 0xffac0080 0x00 0x20>;
		phandle = <0x70>;
	};

	dummy_cpll {
		clock-output-names = "dummy_cpll";
		#clock-cells = <0x00>;
		clock-frequency = <0x00>;
		compatible = "fixed-clock";
		phandle = <0xe6>;
	};

	voppwm@ff8f01a0 {
		pinctrl-names = "active";
		pinctrl-0 = <0xb2>;
		clock-names = "pwm";
		clocks = <0x08 0x6c>;
		#pwm-cells = <0x03>;
		compatible = "rockchip,vop-pwm";
		status = "disabled";
		reg = <0x00 0xff8f01a0 0x00 0x10>;
		phandle = <0x13e>;
	};

	usb@fe800000 {
		#address-cells = <0x02>;
		clock-names = "ref_clk\0suspend_clk\0bus_clk\0aclk_usb3_rksoc_axi_perf\0aclk_usb3\0grf_clk";
		clocks = <0x08 0x81 0x08 0x83 0x08 0xf6 0x08 0xf8 0x08 0xf4 0x08 0xf9>;
		#size-cells = <0x02>;
		compatible = "rockchip,rk3399-dwc3";
		ranges;
		status = "okay";
		phandle = <0xf2>;

		usb@fe800000 {
			power-domains = <0x1c 0x18>;
			snps,dis-u1-entry-quirk;
			snps,dis_enblslpm_quirk;
			phy-names = "usb2-phy\0usb3-phy";
			clock-names = "ref\0bus_early\0suspend";
			snps,dis-u2-freeclk-exists-quirk;
			phy_type = "utmi_wide";
			snps,dis_u2_susphy_quirk;
			resets = <0x08 0x125>;
			interrupts = <0x00 0x69 0x04 0x00>;
			clocks = <0x08 0x81 0x08 0xf6 0x08 0x83>;
			snps,dis-u2-entry-quirk;
			compatible = "snps,dwc3";
			snps,dis-del-phy-power-chg-quirk;
			status = "okay";
			phys = <0x34 0x35>;
			reg = <0x00 0xfe800000 0x00 0x100000>;
			phandle = <0xf3>;
			dr_mode = "host";
			reset-names = "usb3-otg";
			snps,dis-tx-ipgap-linecheck-quirk;
		};
	};

	qos@ffa60180 {
		compatible = "syscon";
		reg = <0x00 0xffa60180 0x00 0x20>;
		phandle = <0x77>;
	};

	rk809-sound {
		rockchip,cpu = <0xdd>;
		rockchip,codec = <0xde>;
		io-channels = <0xdf 0x02>;
		rockchip,card-name = "rockchip-rk809";
		rockchip,format = "i2s";
		rockchip,audio-routing = "Speaker\0Speaker Power";
		poll-interval = <0x64>;
		keyup-threshold-microvolt = <0x1b7740>;
		compatible = "rockchip,multicodecs-card";
		phandle = <0x193>;
		rockchip,mclk-fs = <0x100>;
		io-channel-names = "adc-detect";

		play-pause-key {
			press-threshold-microvolt = <0x7d0>;
			label = "playpause";
			linux,code = <0xa4>;
		};
	};

	nocp-cci-msch0@ffa86000 {
		compatible = "rockchip,rk3399-nocp";
		reg = <0x00 0xffa86000 0x00 0x400>;
		phandle = <0x14b>;
	};

	usb@fe3c0000 {
		phy-names = "usb";
		interrupts = <0x00 0x1e 0x04 0x00>;
		clocks = <0x08 0x1ca 0x08 0x1cb 0x32>;
		compatible = "generic-ehci";
		status = "okay";
		phys = <0x33>;
		reg = <0x00 0xfe3c0000 0x00 0x20000>;
		phandle = <0xf0>;
	};

	dsi@ff968000 {
		power-domains = <0x1c 0x0f>;
		#address-cells = <0x01>;
		clock-names = "ref\0pclk\0phy_cfg\0grf";
		resets = <0x08 0xfc>;
		interrupts = <0x00 0x2e 0x04 0x00>;
		clocks = <0x08 0xa2 0x08 0x171 0x08 0xa4 0x08 0x16f>;
		#size-cells = <0x00>;
		compatible = "rockchip,rk3399-mipi-dsi\0snps,dw-mipi-dsi";
		status = "disabled";
		rockchip,grf = <0x1d>;
		reg = <0x00 0xff968000 0x00 0x8000>;
		phandle = <0x146>;
		reset-names = "apb";

		ports {
			#address-cells = <0x01>;
			#size-cells = <0x00>;

			port@0 {
				#address-cells = <0x01>;
				#size-cells = <0x00>;
				reg = <0x00>;

				endpoint@1 {
					remote-endpoint = <0xc4>;
					reg = <0x01>;
					phandle = <0xb0>;
				};

				endpoint@0 {
					remote-endpoint = <0xc3>;
					reg = <0x00>;
					phandle = <0xb7>;
				};
			};
		};
	};

	i2s@ff8a0000 {
		power-domains = <0x1c 0x1c>;
		clock-names = "i2s_clk\0i2s_hclk";
		assigned-clocks = <0x08 0xb0>;
		assigned-clock-parents = <0x08 0x05>;
		resets = <0x08 0xe2 0x08 0xc4>;
		interrupts = <0x00 0x29 0x04 0x00>;
		clocks = <0x08 0x58 0x08 0x1d6>;
		dma-names = "tx";
		#sound-dai-cells = <0x00>;
		compatible = "rockchip,rk3399-i2s\0rockchip,rk3066-i2s";
		status = "okay";
		reg = <0x00 0xff8a0000 0x00 0x1000>;
		phandle = <0xbd>;
		dmas = <0x5f 0x04>;
		reset-names = "reset-m\0reset-h";
	};

	edp@ff970000 {
		power-domains = <0x1c 0x19>;
		clock-names = "dp\0pclk\0grf";
		resets = <0x08 0x11d>;
		interrupts = <0x00 0x0a 0x04 0x00>;
		clocks = <0x08 0x16a 0x08 0x16c 0x08 0x16f>;
		compatible = "rockchip,rk3399-edp";
		status = "disabled";
		rockchip,grf = <0x1d>;
		reg = <0x00 0xff970000 0x00 0x8000>;
		phandle = <0x148>;
		reset-names = "dp";

		ports {
			#address-cells = <0x01>;
			#size-cells = <0x00>;

			port@0 {
				#address-cells = <0x01>;
				#size-cells = <0x00>;
				reg = <0x00>;
				phandle = <0x149>;

				endpoint@1 {
					remote-endpoint = <0x14>;
					reg = <0x01>;
					phandle = <0xae>;
				};

				endpoint@0 {
					remote-endpoint = <0xc5>;
					reg = <0x00>;
					phandle = <0xb4>;
				};
			};
		};
	};

	vbus-host {
		pinctrl-names = "default";
		regulator-boot-on;
		gpio = <0x1f 0x1e 0x00>;
		pinctrl-0 = <0xd4>;
		regulator-always-on;
		enable-active-high;
		regulator-name = "vbus_host";
		compatible = "regulator-fixed";
		phandle = <0xa7>;
		vin-supply = <0xd5>;
	};

	sdhci@fe330000 {
		power-domains = <0x1c 0x17>;
		mmc-hs400-enhanced-strobe;
		disable-cqe-dcmd;
		clock-output-names = "emmc_cardclock";
		phy-names = "phy_arasan";
		clock-names = "clk_xin\0clk_ahb";
		assigned-clocks = <0x08 0x4e>;
		assigned-clock-parents = <0x08 0x05>;
		bus-width = <0x08>;
		non-removable;
		no-sdio;
		assigned-clock-rates = <0xbebc200>;
		mmc-hs400-1_8v;
		interrupts = <0x00 0x0b 0x04 0x00>;
		clocks = <0x08 0x4e 0x08 0xf0>;
		arasan,soc-ctl-syscon = <0x1d>;
		#clock-cells = <0x00>;
		no-sd;
		compatible = "rockchip,rk3399-sdhci-5.1\0arasan,sdhci-5.1";
		status = "okay";
		phys = <0x2f>;
		reg = <0x00 0xfe330000 0x00 0x10000>;
		phandle = <0xa8>;
		max-frequency = <0x8f0d180>;
		disable-cqe;
	};

	i2c@ff140000 {
		pinctrl-names = "default";
		#address-cells = <0x01>;
		pinctrl-0 = <0x40>;
		clock-names = "i2c\0pclk";
		assigned-clocks = <0x08 0x44>;
		assigned-clock-rates = <0xbebc200>;
		interrupts = <0x00 0x26 0x04 0x00>;
		clocks = <0x08 0x44 0x08 0x158>;
		#size-cells = <0x00>;
		compatible = "rockchip,rk3399-i2c";
		status = "disabled";
		reg = <0x00 0xff140000 0x00 0x1000>;
		phandle = <0xfa>;
	};

	chosen {
		u-boot,version = "latest-2022.10-1-4debc57a-00007-gb923c1b6";
		linux,initrd-end = <0x00 0xf5ef7db8>;
		bootargs = "root=UUID=8087ba46-93d3-4f58-a640-231fd0aa806c loglevel=4 console=tty0 console=ttyAML0,115200n8 console=ttyS2,1500000n8 console=ttyFIQ0,1500000n8 coherent_pool=2M irqchip.gicv3_pseudo_nmi=0 quiet splash plymouth.ignore-serial-consoles overlays=i2c2 i2c2_speed=1000000";
		linux,initrd-start = <0x00 0xf5195000>;
	};

	vop@ff900000 {
		power-domains = <0x1c 0x11>;
		iommus = <0xb3>;
		clock-names = "aclk_vop\0dclk_vop\0hclk_vop\0dclk_source";
		reg-names = "regs\0cabc_lut\0gamma_lut";
		assigned-clocks = <0x08 0xb6>;
		assigned-clock-parents = <0x08 0x07>;
		resets = <0x08 0x112 0x08 0x116 0x08 0x118>;
		interrupts = <0x00 0x76 0x04 0x00>;
		clocks = <0x08 0xd9 0x08 0xb4 0x08 0x1d9 0x08 0xb6>;
		compatible = "rockchip,rk3399-vop-big";
		status = "okay";
		reg = <0x00 0xff900000 0x00 0x600 0x00 0xff901c00 0x00 0x200 0x00 0xff902000 0x00 0x1000>;
		phandle = <0x13f>;
		reset-names = "axi\0ahb\0dclk";

		port {
			#address-cells = <0x01>;
			#size-cells = <0x00>;
			phandle = <0x0f>;

			endpoint@3 {
				remote-endpoint = <0xb7>;
				reg = <0x03>;
				phandle = <0xc3>;
			};

			endpoint@1 {
				remote-endpoint = <0xb5>;
				reg = <0x01>;
				phandle = <0xc2>;
			};

			endpoint@4 {
				remote-endpoint = <0xb8>;
				reg = <0x04>;
				phandle = <0x3a>;
			};

			endpoint@2 {
				remote-endpoint = <0xb6>;
				reg = <0x02>;
				phandle = <0x12>;
			};

			endpoint@0 {
				remote-endpoint = <0xb4>;
				reg = <0x00>;
				phandle = <0xc5>;
			};
		};
	};

	serial@ff190000 {
		reg-io-width = <0x04>;
		pinctrl-names = "default";
		pinctrl-0 = <0x4b>;
		clock-names = "baudclk\0apb_pclk";
		assigned-clocks = <0x08 0xad>;
		assigned-clock-parents = <0x08 0x05>;
		interrupts = <0x00 0x62 0x04 0x00>;
		clocks = <0x08 0x52 0x08 0x161>;
		compatible = "rockchip,rk3399-uart\0snps,dw-apb-uart";
		status = "disabled";
		reg = <0x00 0xff190000 0x00 0x100>;
		phandle = <0xfe>;
		reg-shift = <0x02>;
	};

	iommu@ff650800 {
		power-domains = <0x1c 0x1f>;
		clock-names = "aclk\0iface";
		interrupts = <0x00 0x73 0x04 0x00>;
		clocks = <0x08 0xeb 0x08 0x1ea>;
		#iommu-cells = <0x00>;
		compatible = "rockchip,iommu";
		status = "okay";
		interrupt-names = "vpu_mmu";
		reg = <0x00 0xff650800 0x00 0x40>;
		phandle = <0xa2>;
	};

	qos@ffa5c000 {
		compatible = "syscon";
		reg = <0x00 0xffa5c000 0x00 0x20>;
		phandle = <0x73>;
	};

	spi@ff1c0000 {
		pinctrl-names = "default";
		#address-cells = <0x01>;
		pinctrl-0 = <0x4f 0x50 0x51 0x52>;
		clock-names = "spiclk\0apb_pclk";
		interrupts = <0x00 0x44 0x04 0x00>;
		clocks = <0x08 0x47 0x08 0x15b>;
		#size-cells = <0x00>;
		dma-names = "tx\0rx";
		compatible = "rockchip,rk3399-spi\0rockchip,rk3066-spi";
		status = "disabled";
		reg = <0x00 0xff1c0000 0x00 0x1000>;
		phandle = <0x101>;
		dmas = <0x4e 0x0a 0x4e 0x0b>;
	};

	vepu@ff650000 {
		power-domains = <0x1c 0x1f>;
		iommus = <0xa2>;
		clock-names = "aclk_vcodec\0hclk_vcodec";
		resets = <0x08 0x53 0x08 0x51>;
		interrupts = <0x00 0x72 0x04 0x00>;
		clocks = <0x08 0xeb 0x08 0x1ea>;
		rockchip,srv = <0xa3>;
		rockchip,taskqueue-node = <0x00>;
		compatible = "rockchip,vpu-encoder-v2";
		rockchip,resetgroup-node = <0x00>;
		status = "okay";
		interrupt-names = "irq_enc";
		reg = <0x00 0xff650000 0x00 0x400>;
		phandle = <0x122>;
		reset-names = "shared_video_h\0shared_video_a";
	};

	fiq-debugger {
		pinctrl-names = "default";
		rockchip,irq-mode-enable = <0x01>;
		rockchip,baudrate = <0x16e360>;
		pinctrl-0 = <0x4c>;
		interrupts = <0x00 0x96 0x04 0x00>;
		rockchip,wake-irq = <0x00>;
		compatible = "rockchip,fiq-debugger";
		status = "okay";
		phandle = <0x18d>;
		rockchip,serial-id = <0x02>;
		rockchip,signal-irq = <0xb6>;
	};

	nocp-gpu-msch1@ffa8e400 {
		compatible = "rockchip,rk3399-nocp";
		reg = <0x00 0xffa8e400 0x00 0x400>;
		phandle = <0x153>;
	};

	external-gmac-clock {
		clock-output-names = "clkin_gmac";
		#clock-cells = <0x00>;
		clock-frequency = <0x7735940>;
		compatible = "fixed-clock";
		phandle = <0x20>;
	};

	pmu_a53 {
		interrupts = <0x01 0x07 0x08 0x15>;
		compatible = "arm,cortex-a53-pmu";
	};

	cpus {
		#address-cells = <0x02>;
		#size-cells = <0x00>;

		cpu@1 {
			capacity-dmips-mhz = <0x1e5>;
			cpu-supply = <0x0c>;
			clocks = <0x08 0x08>;
			cpu-idle-states = <0x09 0x0a>;
			device_type = "cpu";
			compatible = "arm,cortex-a53";
			dynamic-power-coefficient = <0x64>;
			reg = <0x00 0x01>;
			enable-method = "psci";
			phandle = <0x03>;
			operating-points-v2 = <0x0b>;
			#cooling-cells = <0x02>;
		};

		cpu@101 {
			capacity-dmips-mhz = <0x400>;
			cpu-supply = <0x0e>;
			clocks = <0x08 0x09>;
			cpu-idle-states = <0x09 0x0a>;
			device_type = "cpu";
			compatible = "arm,cortex-a72";
			dynamic-power-coefficient = <0x1b4>;
			reg = <0x00 0x101>;
			enable-method = "psci";
			phandle = <0x07>;
			operating-points-v2 = <0x0d>;
			#cooling-cells = <0x02>;
		};

		idle-states {
			entry-method = "psci";

			cluster-sleep {
				entry-latency-us = <0x190>;
				local-timer-stop;
				exit-latency-us = <0x1f4>;
				arm,psci-suspend-param = <0x1010000>;
				compatible = "arm,idle-state";
				phandle = <0x0a>;
				min-residency-us = <0x7d0>;
			};

			cpu-sleep {
				entry-latency-us = <0x78>;
				local-timer-stop;
				exit-latency-us = <0xfa>;
				arm,psci-suspend-param = <0x10000>;
				compatible = "arm,idle-state";
				phandle = <0x09>;
				min-residency-us = <0x384>;
			};
		};

		cpu-map {

			cluster0 {

				core3 {
					cpu = <0x05>;
				};

				core1 {
					cpu = <0x03>;
				};

				core2 {
					cpu = <0x04>;
				};

				core0 {
					cpu = <0x02>;
				};
			};

			cluster1 {

				core1 {
					cpu = <0x07>;
				};

				core0 {
					cpu = <0x06>;
				};
			};
		};

		cpu@2 {
			capacity-dmips-mhz = <0x1e5>;
			cpu-supply = <0x0c>;
			clocks = <0x08 0x08>;
			cpu-idle-states = <0x09 0x0a>;
			device_type = "cpu";
			compatible = "arm,cortex-a53";
			dynamic-power-coefficient = <0x64>;
			reg = <0x00 0x02>;
			enable-method = "psci";
			phandle = <0x04>;
			operating-points-v2 = <0x0b>;
			#cooling-cells = <0x02>;
		};

		cpu@0 {
			capacity-dmips-mhz = <0x1e5>;
			cpu-supply = <0x0c>;
			clocks = <0x08 0x08>;
			cpu-idle-states = <0x09 0x0a>;
			device_type = "cpu";
			compatible = "arm,cortex-a53";
			dynamic-power-coefficient = <0x64>;
			reg = <0x00 0x00>;
			enable-method = "psci";
			phandle = <0x02>;
			operating-points-v2 = <0x0b>;
			#cooling-cells = <0x02>;
		};

		cpu@100 {
			capacity-dmips-mhz = <0x400>;
			cpu-supply = <0x0e>;
			clocks = <0x08 0x09>;
			cpu-idle-states = <0x09 0x0a>;
			device_type = "cpu";
			compatible = "arm,cortex-a72";
			dynamic-power-coefficient = <0x1b4>;
			reg = <0x00 0x100>;
			enable-method = "psci";
			phandle = <0x06>;
			operating-points-v2 = <0x0d>;
			#cooling-cells = <0x02>;
		};

		cpu@3 {
			capacity-dmips-mhz = <0x1e5>;
			cpu-supply = <0x0c>;
			clocks = <0x08 0x08>;
			cpu-idle-states = <0x09 0x0a>;
			device_type = "cpu";
			compatible = "arm,cortex-a53";
			dynamic-power-coefficient = <0x64>;
			reg = <0x00 0x03>;
			enable-method = "psci";
			phandle = <0x05>;
			operating-points-v2 = <0x0b>;
			#cooling-cells = <0x02>;
		};
	};

	nocp-lp-msch0@ffa86c00 {
		compatible = "rockchip,rk3399-nocp";
		reg = <0x00 0xffa86c00 0x00 0x400>;
		phandle = <0x14e>;
	};

	__symbols__ {
		i2s0_2ch_bus = "/pinctrl/i2s0/i2s0-2ch-bus";
		i2c3 = "/i2c@ff130000";
		usb_host1_ohci = "/usb@fe3e0000";
		spi5_clk = "/pinctrl/spi5/spi5-clk";
		cam0_sleep_pins = "/pinctrl/cam_pins/cam0-sleep-pins";
		sdmmc_clk = "/pinctrl/sdmmc/sdmmc-clk";
		tcphy1 = "/phy@ff800000";
		vcc_buck5 = "/i2c@ff3c0000/pmic@20/regulators/DCDC_REG5";
		vdpu = "/vdpu@ff650400";
		cpu_crit = "/thermal-zones/cpu-thermal/trips/cpu_crit";
		thermal_zones = "/thermal-zones";
		dsi_in_vopb = "/dsi@ff960000/ports/port@0/endpoint@0";
		qos_gpu = "/qos@ffae0000";
		qos_iep = "/qos@ffa98000";
		clk_32k = "/pinctrl/clock/clk-32k";
		cpu_l1 = "/cpus/cpu@1";
		vcc3v3_pcie = "/vcc3v3-pcie-regulator";
		cpu_performance = "/efuse@ff690000/cpu-performance@1e";
		nocp_gpu_msch1 = "/nocp-gpu-msch1@ffa8e400";
		spi2 = "/spi@ff1e0000";
		pcfg_pull_down_12ma = "/pinctrl/pcfg-pull-down-12ma";
		qos_isp0_m0 = "/qos@ffaa0000";
		gpio0 = "/pinctrl/gpio0@ff720000";
		spi4_tx = "/pinctrl/spi4/spi4-tx";
		saradc = "/saradc@ff100000";
		test_clkout1 = "/pinctrl/testclk/test-clkout1";
		route_edp = "/display-subsystem/route/route-edp";
		vop0_pwm_pin = "/pinctrl/pwm0/vop0-pwm-pin";
		cluster1_opp = "/opp-table-1";
		dsi1 = "/dsi@ff968000";
		vopl_out_dsi1 = "/vop@ff8f0000/port/endpoint@3";
		pmu_pvtm = "/syscon@ff320000/pmu-pvtm";
		spi0_cs0 = "/pinctrl/spi0/spi0-cs0";
		dfi = "/dfi@ff630000";
		pinctrl = "/pinctrl";
		qos_rga_r = "/qos@ffab0000";
		spi1_tx = "/pinctrl/spi1/spi1-tx";
		dmac_peri = "/bus/dma-controller@ff6e0000";
		vdd_cpu_b = "/i2c@ff3c0000/syr827@40";
		pcie_drv = "/pinctrl/pcie/pcie-drv";
		i2s1 = "/i2s@ff890000";
		hdmi_cec = "/pinctrl/hdmi/hdmi-cec";
		i2c1 = "/i2c@ff110000";
		gpu_leakage = "/efuse@ff690000/gpu-leakage@18";
		gmac = "/ethernet@fe300000";
		qos_usb_otg1 = "/qos@ffa70080";
		spi4_cs0 = "/pinctrl/spi4/spi4-cs0";
		rockchip_system_monitor = "/rockchip-system-monitor";
		pwm3a_pin = "/pinctrl/pwm3a/pwm3a-pin";
		spi4_rx = "/pinctrl/spi4/spi4-rx";
		i2c4_xfer = "/pinctrl/i2c4/i2c4-xfer";
		pcfg_pull_none = "/pinctrl/pcfg-pull-none";
		wifi_host_wake_l = "/pinctrl/wifi/wifi-host-wake-l";
		tcphy1_usb3 = "/phy@ff800000/usb3-port";
		otp_out = "/pinctrl/tsadc/otp-out";
		vopl_out_dp = "/vop@ff8f0000/port/endpoint@4";
		vopl_mmu = "/iommu@ff8f3f00";
		CLUSTER_SLEEP = "/cpus/idle-states/cluster-sleep";
		spi1_rx = "/pinctrl/spi1/spi1-rx";
		sdhci = "/sdhci@fe330000";
		target = "/thermal-zones/cpu-thermal/trips/cpu_alert1";
		sdmmc_bus1 = "/pinctrl/sdmmc/sdmmc-bus1";
		u2phy1 = "/syscon@ff770000/usb2-phy@e460";
		gpu = "/gpu@ff9a0000";
		spi0 = "/spi@ff1c0000";
		iep = "/iep@ff670000";
		dsi = "/dsi@ff960000";
		drm_logo = "/reserved-memory/drm-logo@00000000";
		pwm0_pin = "/pinctrl/pwm0/pwm0-pin";
		clkin_gmac = "/external-gmac-clock";
		vsel2_gpio = "/pinctrl/pmic/vsel2-gpio";
		usb_host0_ohci = "/usb@fe3a0000";
		dp_in_vopl = "/dp@fec00000/ports/port/endpoint@1";
		sdio0_cmd = "/pinctrl/sdio0/sdio0-cmd";
		dmc = "/dmc";
		qos_isp1_m1 = "/qos@ffaa8080";
		vcc3v3_dp = "/vcc3v3-dp";
		qos_emmc = "/qos@ffa58000";
		edp_in = "/edp@ff970000/ports/port@0";
		mipi_dphy_rx0 = "/syscon@ff770000/mipi-dphy-rx0";
		uart3_cts = "/pinctrl/uart3/uart3-cts";
		nocp_vio1_msch1 = "/nocp-vio1-msch1@ffa8f800";
		rmii_pins = "/pinctrl/gmac/rmii-pins";
		pmugrf = "/syscon@ff320000";
		sdmmc_wp = "/pinctrl/sdmmc/sdmmc-wp";
		rgmii_sleep_pins = "/pinctrl/gmac/rgmii-sleep-pins";
		logic_leakage = "/efuse@ff690000/logic-leakage@1b";
		sdio0_bkpwr = "/pinctrl/sdio0/sdio0-bkpwr";
		virtual_pd = "/virtual-pd";
		rktimer = "/rktimer@ff850000";
		i2c3_gpio = "/pinctrl/i2c3/i2c3_gpio";
		amba = "/bus";
		vopl = "/vop@ff8f0000";
		qos_pcie = "/qos@ffa60080";
		rkisp1_0 = "/rkisp1@ff910000";
		route_hdmi = "/display-subsystem/route/route-hdmi";
		spi2_clk = "/pinctrl/spi2/spi2-clk";
		dmc_opp_table = "/opp-table3";
		pcfg_pull_down_18ma = "/pinctrl/pcfg-pull-down-18ma";
		uart4 = "/serial@ff370000";
		uarthdcp_xfer = "/pinctrl/uarthdcp/uarthdcp-xfer";
		u2phy1_host = "/syscon@ff770000/usb2-phy@e460/host-port";
		pwm3a_pin_pull_down = "/pinctrl/pwm3a/pwm3a-pin-pull-down";
		vopl_out_dsi = "/vop@ff8f0000/port/endpoint@0";
		pcie_clkreqnb_cpm = "/pinctrl/pcie/pci-clkreqnb-cpm";
		vdd_gpu = "/i2c@ff3c0000/syr828@41";
		i2c8 = "/i2c@ff3e0000";
		cpu_alert0 = "/thermal-zones/cpu-thermal/trips/cpu_alert0";
		pvtm = "/syscon@ff770000/pvtm";
		i2c3_xfer = "/pinctrl/i2c3/i2c3-xfer";
		cpu_thermal = "/thermal-zones/cpu-thermal";
		tcphy0_usb3 = "/phy@ff7c0000/usb3-port";
		power = "/power-management@ff310000/power-controller";
		edp_in_vopl = "/edp@ff970000/ports/port@0/endpoint@1";
		vopl_out = "/vop@ff8f0000/port";
		hpd_en = "/pinctrl/hpd/hpd-en";
		nocp_hp_msch0 = "/nocp-hp-msch0@ffa86800";
		pwm3 = "/pwm@ff420030";
		tcphy1_dp = "/phy@ff800000/dp-port";
		vbus_typec = "/vbus-typec";
		pinctrl_rk8xx = "/i2c@ff3c0000/pmic@20/pinctrl_rk8xx";
		vdec_mmu = "/iommu@ff660480";
		cif_isp1 = "/cif_isp@ff920000";
		sdio0_bus4 = "/pinctrl/sdio0/sdio0-bus4";
		bt_enable_h = "/pinctrl/bt/bt-enable-h";
		edp_hpd = "/pinctrl/edp/edp-hpd";
		rk809_slppin_slp = "/i2c@ff3c0000/pmic@20/pinctrl_rk8xx/rk809_slppin_slp";
		cru = "/clock-controller@ff760000";
		vsel1_gpio = "/pinctrl/pmic/vsel1-gpio";
		cpu_b1 = "/cpus/cpu@101";
		uart4_xfer = "/pinctrl/uart4/uart4-xfer";
		vcc_cam = "/i2c@ff3c0000/pmic@20/regulators/LDO_REG9";
		mipi_dsi1 = "/dsi@ff968000";
		pcfg_pull_down_20ma = "/pinctrl/pcfg-pull-down-20ma";
		reboot_mode = "/syscon@ff320000/reboot-mode";
		uart2 = "/serial@ff1a0000";
		spi1_cs0 = "/pinctrl/spi1/spi1-cs0";
		qos_usb_host0 = "/qos@ffa60100";
		nocp_cci_msch1 = "/nocp-cci-msch1@ffa8e000";
		soc_slppin_gpio = "/pinctrl/pmic/soc-slppin-gpio";
		qos_rga_w = "/qos@ffab0080";
		pcfg_output_low = "/pinctrl/pcfg-output-low";
		sdio_pwrseq = "/sdio-pwrseq";
		ppi_cluster0 = "/interrupt-controller@fee00000/ppi-partitions/interrupt-partition-0";
		i2c6 = "/i2c@ff150000";
		vdec = "/video-codec@ff660000";
		sdio0_clk = "/pinctrl/sdio0/sdio0-clk";
		pmu_io_domains = "/syscon@ff320000/io-domains";
		pcfg_pull_none_13ma = "/pinctrl/pcfg-pull-none-13ma";
		spi5_cs0 = "/pinctrl/spi5/spi5-cs0";
		hdmi_i2c_xfer = "/pinctrl/hdmi/hdmi-i2c-xfer";
		gic = "/interrupt-controller@fee00000";
		hdmi_in_vopb = "/hdmi@ff940000/ports/port/endpoint@0";
		pcie0 = "/pcie@f8000000";
		pwm3b_pin = "/pinctrl/pwm3b/pwm3b-pin";
		isp_shutter = "/pinctrl/isp/isp-shutter";
		pcfg_pull_down_8ma = "/pinctrl/pcfg-pull-down-8ma";
		rk809_slppin_null = "/i2c@ff3c0000/pmic@20/pinctrl_rk8xx/rk809_slppin_null";
		efuse0 = "/efuse@ff690000";
		usbdrd3_1 = "/usb@fe900000";
		pwm1 = "/pwm@ff420010";
		cpu_id = "/efuse@ff690000/cpu-id@7";
		threshold = "/thermal-zones/cpu-thermal/trips/cpu_alert0";
		vpu = "/video-codec@ff650000";
		dsi1_in_vopb = "/dsi@ff968000/ports/port@0/endpoint@0";
		edp = "/edp@ff970000";
		rk809_slppin_pwrdn = "/i2c@ff3c0000/pmic@20/pinctrl_rk8xx/rk809_slppin_pwrdn";
		usbdrd_dwc3_0 = "/usb@fe800000/usb@fe800000";
		otp_pin = "/pinctrl/tsadc/otp-pin";
		rk809_sound = "/rk809-sound";
		u2phy0_host = "/syscon@ff770000/usb2-phy@e450/host-port";
		spi3_tx = "/pinctrl/spi3/spi3-tx";
		usb_host1_ehci = "/usb@fe3c0000";
		xin24m = "/xin24m";
		pcfg_pull_up_2ma = "/pinctrl/pcfg-pull-up-2ma";
		rk809_codec = "/i2c@ff3c0000/pmic@20/codec";
		spi5 = "/spi@ff200000";
		tsadc = "/tsadc@ff260000";
		vcca_0v9 = "/i2c@ff3c0000/pmic@20/regulators/LDO_REG1";
		i2s_8ch_mclk = "/pinctrl/i2s0/i2s-8ch-mclk";
		uart0_cts = "/pinctrl/uart0/uart0-cts";
		gpio3 = "/pinctrl/gpio3@ff788000";
		pwm1_pin = "/pinctrl/pwm1/pwm1-pin";
		gpu_opp_table = "/opp-table-2";
		pcfg_output_high = "/pinctrl/pcfg-output-high";
		spi0_tx = "/pinctrl/spi0/spi0-tx";
		uart0 = "/serial@ff180000";
		pwm1_pin_pull_down = "/pinctrl/pwm1/pwm1-pin-pull-down";
		isp_flash_trigger = "/pinctrl/isp/isp-flash-trigger";
		ddrio_pwroff = "/pinctrl/suspend/ddrio-pwroff";
		uart3_rts = "/pinctrl/uart3/uart3-rts";
		isp_flash_trigger_as_gpio = "/pinctrl/isp/isp-flash-trigger-as-gpio";
		i2c2_xfer = "/pinctrl/i2c2/i2c2-xfer";
		pmic_int_l = "/pinctrl/pmic/pmic-int-l";
		pcie_phy = "/syscon@ff770000/pcie-phy";
		vcc5v0_host_en = "/pinctrl/vbus_host/vcc5v0-host-en";
		nocp_video_msch0 = "/nocp-video-msch0@ffa87000";
		u2phy0_otg = "/syscon@ff770000/usb2-phy@e450/otg-port";
		qos_hdcp = "/qos@ffa90000";
		i2c4 = "/i2c@ff3d0000";
		ddr_timing = "/ddr_timing";
		cpul_leakage = "/efuse@ff690000/cpu-leakage@1a";
		spi3_rx = "/pinctrl/spi3/spi3-rx";
		vcc_1v5 = "/i2c@ff3c0000/pmic@20/regulators/LDO_REG6";
		nocp_vio0_msch0 = "/nocp-vio0-msch0@ffa87400";
		fan0 = "/pwm-fan";
		isp0_mmu = "/iommu@ff914000";
		mipi_dphy_tx1rx1 = "/mipi-dphy-tx1rx1@ff968000";
		lcd_3v3 = "/i2c@ff3c0000/pmic@20/regulators/SWITCH_REG2";
		spi0_rx = "/pinctrl/spi0/spi0-rx";
		iep_mmu = "/iommu@ff670800";
		uart3_xfer = "/pinctrl/uart3/uart3-xfer";
		spdif = "/spdif@ff870000";
		vopl_out_edp = "/vop@ff8f0000/port/endpoint@1";
		spi3_clk = "/pinctrl/spi3/spi3-clk";
		i2c8_xfer = "/pinctrl/i2c8/i2c8-xfer";
		sdmmc_cd = "/pinctrl/sdmmc/sdmmc-cd";
		rng = "/rng@ff8b8000";
		cpu_l2 = "/cpus/cpu@2";
		nocp_lp_msch0 = "/nocp-lp-msch0@ffa86c00";
		isp_dvp_d0d7 = "/pinctrl/isp/isp-dvp-d0d7";
		wifi_enable_h = "/pinctrl/wifi/wifi-enable-h";
		sdmmc_bus4 = "/pinctrl/sdmmc/sdmmc-bus4";
		rkvdec = "/rkvdec@ff660000";
		sdio0_wp = "/pinctrl/sdio0/sdio0-wp";
		spi3 = "/spi@ff350000";
		qos_isp0_m1 = "/qos@ffaa0080";
		gpio1 = "/pinctrl/gpio1@ff730000";
		test_clkout2 = "/pinctrl/testclk/test-clkout2";
		pcfg_pull_up_18ma = "/pinctrl/pcfg-pull-up-18ma";
		spiflash = "/spi@ff1d0000/spi-flash@0";
		vcc5v0_sys = "/vcc5v0-sys";
		qos_vop_big_r = "/qos@ffac8000";
		spi0_cs1 = "/pinctrl/spi0/spi0-cs1";
		its = "/interrupt-controller@fee00000/interrupt-controller@fee20000";
		sdio0 = "/mmc@fe310000";
		i2s2 = "/i2s@ff8a0000";
		rgmii_pins = "/pinctrl/gmac/rgmii-pins";
		gpu_power_model = "/gpu@ff9a0000/power_model";
		i2c2 = "/i2c@ff120000";
		soc_slppin_slp = "/pinctrl/pmic/soc-slppin-slp";
		spdif_bus = "/pinctrl/spdif/spdif-bus";
		vopb_mmu = "/iommu@ff903f00";
		dsi_in_vopl = "/dsi@ff960000/ports/port@0/endpoint@1";
		usb_host0_ehci = "/usb@fe380000";
		i2s1_2ch_bus = "/pinctrl/i2s1/i2s1-2ch-bus";
		qos_vop_little = "/qos@ffad0000";
		tcphy0 = "/phy@ff7c0000";
		cam0_default_pins = "/pinctrl/cam_pins/cam0-default-pins";
		cif_clkout = "/pinctrl/isp/cif-clkout";
		brcmf = "/mmc@fe310000/wifi@1";
		pcfg_pull_up_8ma = "/pinctrl/pcfg-pull-up-8ma";
		i2c1_xfer = "/pinctrl/i2c1/i2c1-xfer";
		vcc_3v0 = "/i2c@ff3c0000/pmic@20/regulators/LDO_REG7";
		vopb_out_dsi = "/vop@ff900000/port/endpoint@1";
		cpu_l0 = "/cpus/cpu@0";
		spi2_cs0 = "/pinctrl/spi2/spi2-cs0";
		pmucru = "/pmu-clock-controller@ff750000";
		vdd_log = "/i2c@ff3c0000/pmic@20/regulators/DCDC_REG1";
		pcfg_pull_down_4ma = "/pinctrl/pcfg-pull-down-4ma";
		vop0_pwm = "/voppwm@ff9001a0";
		nocp_gpu_msch0 = "/nocp-gpu-msch0@ffa86400";
		vcc_ddr = "/i2c@ff3c0000/pmic@20/regulators/DCDC_REG3";
		spi1 = "/spi@ff1d0000";
		vdd_cpu_l = "/i2c@ff3c0000/pmic@20/regulators/DCDC_REG2";
		pcfg_pull_up_20ma = "/pinctrl/pcfg-pull-up-20ma";
		test_clkout0 = "/pinctrl/testclk/test-clkout0";
		vopb_out_dp = "/vop@ff900000/port/endpoint@4";
		vop1_pwm_pin = "/pinctrl/pwm0/vop1-pwm-pin";
		qos_video_m1_r = "/qos@ffac0000";
		tcphy0_dp = "/phy@ff7c0000/dp-port";
		sdmmc = "/mmc@fe320000";
		i2s0 = "/i2s@ff880000";
		eeprom = "/i2c@ff3c0000/at24c04@50";
		spdif_bus_1 = "/pinctrl/spdif/spdif-bus-1";
		i2c0 = "/i2c@ff3c0000";
		dp_in_vopb = "/dp@fec00000/ports/port/endpoint@0";
		soc_thermal = "/thermal-zones/cpu-thermal";
		dmac_bus = "/bus/dma-controller@ff6d0000";
		i2c7_xfer = "/pinctrl/i2c7/i2c7-xfer";
		uart0_rts = "/pinctrl/uart0/uart0-rts";
		qos_usb_otg0 = "/qos@ffa70000";
		vcca_1v8 = "/i2c@ff3c0000/pmic@20/regulators/LDO_REG4";
		i2s0_8ch_bus = "/pinctrl/i2s0/i2s0-8ch-bus";
		rk809_slppin_rst = "/i2c@ff3c0000/pmic@20/pinctrl_rk8xx/rk809_slppin_rst";
		pcfg_pull_none_12ma = "/pinctrl/pcfg-pull-none-12ma";
		vcc0v9_soc = "/i2c@ff3c0000/pmic@20/regulators/LDO_REG3";
		uart2c_xfer = "/pinctrl/uart2c/uart2c-xfer";
		io_domains = "/syscon@ff770000/io-domains";
		rkisp1_1 = "/rkisp1@ff920000";
		pwm2_pin = "/pinctrl/pwm2/pwm2-pin";
		dummy_cpll = "/dummy_cpll";
		pwm3b_pin_pull_down = "/pinctrl/pwm3b/pwm3b-pin-pull-down";
		rockchip_suspend = "/rockchip-suspend";
		wafer_info = "/efuse@ff690000/wafer-info@1c";
		fiq_debugger = "/fiq-debugger";
		pcie0_intc = "/pcie@f8000000/interrupt-controller";
		vopb = "/vop@ff900000";
		u2phy0 = "/syscon@ff770000/usb2-phy@e450";
		vopb_out_hdmi = "/vop@ff900000/port/endpoint@2";
		u2phy1_otg = "/syscon@ff770000/usb2-phy@e460/otg-port";
		vopb_out = "/vop@ff900000/port";
		qos_perihp = "/qos@ffad8080";
		vbus_host = "/vbus-host";
		spi0_clk = "/pinctrl/spi0/spi0-clk";
		cpu_alert1 = "/thermal-zones/cpu-thermal/trips/cpu_alert1";
		qos_isp1_m0 = "/qos@ffaa8000";
		spi5_tx = "/pinctrl/spi5/spi5-tx";
		customer_demand = "/efuse@ff690000/customer-demand@22";
		vepu = "/vepu@ff650000";
		isp1_mmu = "/iommu@ff924000";
		ramoops_mem = "/reserved-memory/region@110000";
		ap_pwroff = "/pinctrl/suspend/ap-pwroff";
		nocp_vio1_msch0 = "/nocp-vio1-msch0@ffa87800";
		qos_sdioaudio = "/qos@ffa76000";
		spi2_tx = "/pinctrl/spi2/spi2-tx";
		nocp_hp_msch1 = "/nocp-hp-msch1@ffa8e800";
		i2c0_xfer = "/pinctrl/i2c0/i2c0-xfer";
		vcc3v3_sys = "/i2c@ff3c0000/pmic@20/regulators/DCDC_REG4";
		spi4_clk = "/pinctrl/spi4/spi4-clk";
		soc_crit = "/thermal-zones/cpu-thermal/trips/cpu_crit";
		mpp_srv = "/mpp-srv";
		edp_in_vopb = "/edp@ff970000/ports/port@0/endpoint@0";
		spi5_rx = "/pinctrl/spi5/spi5-rx";
		pcfg_pull_down = "/pinctrl/pcfg-pull-down";
		pcie_clkreqn_cpm = "/pinctrl/pcie/pci-clkreqn-cpm";
		vcc5v0_usb2 = "/i2c@ff3c0000/pmic@20/regulators/SWITCH_REG1";
		uart3 = "/serial@ff1b0000";
		pcfg_pull_up = "/pinctrl/pcfg-pull-up";
		qos_vop_big_w = "/qos@ffac8080";
		vpu_mmu = "/iommu@ff650800";
		qos_usb_host1 = "/qos@ffa60180";
		uart1_xfer = "/pinctrl/uart1/uart1-xfer";
		spi2_rx = "/pinctrl/spi2/spi2-rx";
		gpu_performance = "/efuse@ff690000/gpu-performance@1e";
		sdio0_cd = "/pinctrl/sdio0/sdio0-cd";
		cpub_leakage = "/efuse@ff690000/cpu-leakage@17";
		vcc_phy = "/vcc-phy-regulator";
		i2c6_xfer = "/pinctrl/i2c6/i2c6-xfer";
		cluster0_opp = "/opp-table-0";
		ppi_cluster1 = "/interrupt-controller@fee00000/ppi-partitions/interrupt-partition-1";
		i2c7 = "/i2c@ff160000";
		vccio_sd = "/i2c@ff3c0000/pmic@20/regulators/LDO_REG8";
		vcc_1v8 = "/i2c@ff3c0000/pmic@20/regulators/LDO_REG2";
		route_dsi = "/display-subsystem/route/route-dsi";
		sdmmc_cmd = "/pinctrl/sdmmc/sdmmc-cmd";
		uart2b_xfer = "/pinctrl/uart2b/uart2b-xfer";
		bt_host_wake_l = "/pinctrl/bt/bt-host-wake-l";
		qos_gmac = "/qos@ffa5c000";
		vopb_out_edp = "/vop@ff900000/port/endpoint@0";
		pwm2 = "/pwm@ff420020";
		CPU_SLEEP = "/cpus/idle-states/cpu-sleep";
		specification_serial_number = "/efuse@ff690000/specification-serial-number@6";
		pcfg_pull_none_18ma = "/pinctrl/pcfg-pull-none-18ma";
		usbdrd_dwc3_1 = "/usb@fe900000/usb@fe900000";
		cif_isp0 = "/cif_isp@ff910000";
		spi3_cs0 = "/pinctrl/spi3/spi3-cs0";
		display_subsystem = "/display-subsystem";
		qos_video_m0 = "/qos@ffab8000";
		vop1_pwm = "/voppwm@ff8f01a0";
		pmu = "/power-management@ff310000";
		pwm2_pin_pull_down = "/pinctrl/pwm2/pwm2-pin-pull-down";
		bt_wake_l = "/pinctrl/bt/bt-wake-l";
		cpu_b0 = "/cpus/cpu@100";
		gpio4 = "/pinctrl/gpio4@ff790000";
		gpu_thermal = "/thermal-zones/gpu-thermal";
		uart1 = "/serial@ff190000";
		hdmi = "/hdmi@ff940000";
		vopl_out_hdmi = "/vop@ff8f0000/port/endpoint@2";
		nocp_cci_msch0 = "/nocp-cci-msch0@ffa86000";
		vopb_out_dsi1 = "/vop@ff900000/port/endpoint@3";
		cdn_dp = "/dp@fec00000";
		qos_video_m1_w = "/qos@ffac0080";
		rk809 = "/i2c@ff3c0000/pmic@20";
		ramoops = "/ramoops";
		hdmi_in_vopl = "/hdmi@ff940000/ports/port/endpoint@1";
		hdmi_in = "/hdmi@ff940000/ports/port";
		dp0_sound = "/dp0-sound";
		nocp_video_msch1 = "/nocp-video-msch1@ffa8f000";
		soc_slppin_rst = "/pinctrl/pmic/soc-slppin-rst";
		i2c5 = "/i2c@ff140000";
		mipi_dsi = "/dsi@ff960000";
		sdio0_pwr = "/pinctrl/sdio0/sdio0-pwr";
		dsi1_in_vopl = "/dsi@ff968000/ports/port@0/endpoint@1";
		grf = "/syscon@ff770000";
		nocp_vio0_msch1 = "/nocp-vio0-msch1@ffa8f400";
		dp_in = "/dp@fec00000/ports/port";
		usbdrd3_0 = "/usb@fe800000";
		pcfg_pull_none_20ma = "/pinctrl/pcfg-pull-none-20ma";
		pwm0 = "/pwm@ff420000";
		qos_sd = "/qos@ffa74000";
		hdmi_sound = "/hdmi-sound";
		dummy_vpll = "/dummy_vpll";
		cpu_l3 = "/cpus/cpu@3";
		sdio0_bus1 = "/pinctrl/sdio0/sdio0-bus1";
		nocp_lp_msch1 = "/nocp-lp-msch1@ffa8ec00";
		uart0_xfer = "/pinctrl/uart0/uart0-xfer";
		sdio0_int = "/pinctrl/sdio0/sdio0-int";
		spi4 = "/spi@ff1f0000";
		i2c5_xfer = "/pinctrl/i2c5/i2c5-xfer";
		gpio2 = "/pinctrl/gpio2@ff780000";
		center_leakage = "/efuse@ff690000/center-leakage@19";
		spi1_clk = "/pinctrl/spi1/spi1-clk";
		vbus_typec_en = "/pinctrl/vbus_typec/vbus-typec-en";
		rga = "/rga@ff680000";
		uart2a_xfer = "/pinctrl/uart2a/uart2a-xfer";
		pwm0_pin_pull_down = "/pinctrl/pwm0/pwm0-pin-pull-down";
		vcc_mipi = "/i2c@ff3c0000/pmic@20/regulators/LDO_REG5";
		emmc_phy = "/syscon@ff770000/phy@f780";
	};

	rkisp1@ff920000 {
		power-domains = <0x1c 0x14>;
		iommus = <0xbc>;
		clock-names = "clk_isp\0aclk_isp\0hclk_isp\0aclk_isp_wrap\0hclk_isp_wrap\0pclk_isp_wrap";
		interrupts = <0x00 0x2c 0x04 0x00>;
		clocks = <0x08 0x6f 0x08 0xe6 0x08 0x1e0 0x08 0xea 0x08 0x1e4 0x08 0x17b>;
		compatible = "rockchip,rk3399-rkisp1";
		status = "disabled";
		devfreq = <0xba>;
		interrupt-names = "isp_irq";
		reg = <0x00 0xff920000 0x00 0x4000>;
		phandle = <0x142>;
	};

	nocp-vio0-msch0@ffa87400 {
		compatible = "rockchip,rk3399-nocp";
		reg = <0x00 0xffa87400 0x00 0x400>;
		phandle = <0x150>;
	};

	i2c@ff3d0000 {
		pinctrl-names = "default";
		#address-cells = <0x01>;
		pinctrl-0 = <0x97>;
		clock-names = "i2c\0pclk";
		assigned-clocks = <0x85 0x0a>;
		assigned-clock-rates = <0xbebc200>;
		interrupts = <0x00 0x38 0x04 0x00>;
		clocks = <0x85 0x0a 0x85 0x1c>;
		#size-cells = <0x00>;
		compatible = "rockchip,rk3399-i2c";
		status = "disabled";
		reg = <0x00 0xff3d0000 0x00 0x1000>;
		phandle = <0x11c>;
	};

	ramoops {
		memory-region = <0xd2>;
		record-size = <0x00 0x40000>;
		pmsg-size = <0x00 0x00>;
		compatible = "ramoops";
		console-size = <0x00 0x80000>;
		phandle = <0x18c>;
		ftrace-size = <0x00 0x00>;
	};

	reserved-memory {
		#address-cells = <0x02>;
		#size-cells = <0x02>;
		ranges;

		region@110000 {
			reg-names = "ramoops_mem";
			reg = <0x00 0x110000 0x00 0xf0000>;
			phandle = <0xd2>;
		};

		drm-logo@00000000 {
			compatible = "rockchip,drm-logo";
			reg = <0x00 0x00 0x00 0x00>;
			phandle = <0x11>;
		};
	};

	qos@ffac0000 {
		compatible = "syscon";
		reg = <0x00 0xffac0000 0x00 0x20>;
		phandle = <0x6f>;
	};

	nocp-vio1-msch1@ffa8f800 {
		compatible = "rockchip,rk3399-nocp";
		reg = <0x00 0xffa8f800 0x00 0x400>;
		phandle = <0x158>;
	};

	qos@ffa60100 {
		compatible = "syscon";
		reg = <0x00 0xffa60100 0x00 0x20>;
		phandle = <0x76>;
	};

	qos@ffab8000 {
		compatible = "syscon";
		reg = <0x00 0xffab8000 0x00 0x20>;
		phandle = <0x6e>;
	};

	clock-controller@ff760000 {
		#reset-cells = <0x01>;
		assigned-clocks = <0x08 0xc0 0x08 0xc2 0x08 0x1c2 0x08 0x4c 0x08 0xf0 0x08 0xcd 0x08 0x1cd 0x08 0x9f 0x08 0x9e 0x08 0xf4 0x08 0xbe 0x08 0xc9 0x08 0x186 0x08 0xd5 0x08 0x88 0x08 0x87 0x08 0x08 0x08 0x09 0x08 0x06 0x08 0xd0 0x08 0x05 0x08 0xc0 0x08 0x1c0 0x08 0x140 0x08 0xc2 0x08 0x1c1 0x08 0x142 0x08 0x1c2 0x08 0x143 0x08 0x41 0x08 0x42 0x08 0x43 0x08 0x44 0x08 0x45 0x08 0x46 0x08 0x47 0x08 0x48 0x08 0x49 0x08 0x4a 0x08 0x4b 0x08 0xfa 0x08 0xe5 0x08 0xe6 0x08 0x6b 0x08 0x6c 0x08 0x16a 0x08 0xde 0x08 0xe3 0x08 0x1cd 0x08 0x85 0x08 0x86 0x08 0x4e 0x08 0xf0 0x08 0xcd 0x08 0xe1 0x08 0xdc 0x08 0x6d 0x08 0xed 0x08 0xeb 0x08 0x178 0x08 0xd5 0x08 0x9f 0x08 0x9e 0x08 0xf4 0x08 0xbe 0x08 0xc9 0x08 0x186 0x08 0x88 0x08 0x87 0x08 0xd9 0x08 0x1d9 0x08 0xdb 0x08 0x1db>;
		assigned-clock-rates = <0x47868c0 0x2faf080 0x2faf080 0x2faf080 0x2faf080 0x5f5e100 0x2faf080 0x8f0d180 0x8f0d180 0x8f0d180 0x2faf080 0x8f0d180 0x2faf080 0x5f5e100 0x47868c0 0x47868c0 0x30a32c00 0x30a32c00 0x23c34600 0xbebc200 0x2faf0800 0x8f0d180 0x47868c0 0x23c3460 0x11e1a300 0x5f5e100 0x2faf080 0x5f5e100 0x2faf080 0x5f5e100 0x5f5e100 0x5f5e100 0x5f5e100 0x5f5e100 0x5f5e100 0x2faf080 0x2faf080 0x2faf080 0x2faf080 0x2faf080 0xbebc200 0x17d78400 0x17d78400 0x5f5e100 0x5f5e100 0x5f5e100 0x17d78400 0x17d78400 0xbebc200 0x5f5e100 0xbebc200 0xbebc200 0x5f5e100 0x17d78400 0x17d78400 0x17d78400 0x17d78400 0x11e1a300 0x17d78400 0xbebc200 0x17d78400 0x11e1a300 0x11e1a300 0x11e1a300 0x11e1a300 0x23c34600 0x5f5e100 0x8f0d180 0x8f0d180 0x17d78400 0x5f5e100 0x17d78400 0x5f5e100>;
		#clock-cells = <0x01>;
		compatible = "rockchip,rk3399-cru";
		rockchip,grf = <0x1d>;
		reg = <0x00 0xff760000 0x00 0x1000>;
		phandle = <0x08>;
	};

	vop@ff8f0000 {
		power-domains = <0x1c 0x12>;
		iommus = <0xac>;
		clock-names = "aclk_vop\0dclk_vop\0hclk_vop\0dclk_source";
		reg-names = "regs\0cabc_lut\0gamma_lut";
		assigned-clocks = <0x08 0xb7>;
		assigned-clock-parents = <0x08 0x04>;
		resets = <0x08 0x113 0x08 0x117 0x08 0x119>;
		interrupts = <0x00 0x77 0x04 0x00>;
		clocks = <0x08 0xdb 0x08 0xb5 0x08 0x1db 0x08 0xb7>;
		compatible = "rockchip,rk3399-vop-lit";
		status = "okay";
		reg = <0x00 0xff8f0000 0x00 0x600 0x00 0xff8f1c00 0x00 0x200 0x00 0xff8f2000 0x00 0x400>;
		phandle = <0x13d>;
		reset-names = "axi\0ahb\0dclk";

		port {
			#address-cells = <0x01>;
			#size-cells = <0x00>;
			phandle = <0x10>;

			endpoint@3 {
				remote-endpoint = <0xb0>;
				reg = <0x03>;
				phandle = <0xc4>;
			};

			endpoint@1 {
				remote-endpoint = <0xae>;
				reg = <0x01>;
				phandle = <0x14>;
			};

			endpoint@4 {
				remote-endpoint = <0xb1>;
				reg = <0x04>;
				phandle = <0x3b>;
			};

			endpoint@2 {
				remote-endpoint = <0xaf>;
				reg = <0x02>;
				phandle = <0xc1>;
			};

			endpoint@0 {
				remote-endpoint = <0xad>;
				reg = <0x00>;
				phandle = <0x13>;
			};
		};
	};

	dummy_vpll {
		clock-output-names = "dummy_vpll";
		#clock-cells = <0x00>;
		clock-frequency = <0x00>;
		compatible = "fixed-clock";
		phandle = <0xe7>;
	};

	qos@ffac8080 {
		compatible = "syscon";
		reg = <0x00 0xffac8080 0x00 0x20>;
		phandle = <0x82>;
	};

	serial@ff370000 {
		reg-io-width = <0x04>;
		pinctrl-names = "default";
		pinctrl-0 = <0x8a>;
		clock-names = "baudclk\0apb_pclk";
		assigned-clocks = <0x85 0x0c>;
		assigned-clock-parents = <0x85 0x01>;
		interrupts = <0x00 0x66 0x04 0x00>;
		clocks = <0x85 0x06 0x85 0x22>;
		compatible = "rockchip,rk3399-uart\0snps,dw-apb-uart";
		status = "disabled";
		reg = <0x00 0xff370000 0x00 0x100>;
		phandle = <0x110>;
		reg-shift = <0x02>;
	};

	spdif@ff870000 {
		power-domains = <0x1c 0x1c>;
		pinctrl-names = "default";
		pinctrl-0 = <0xa9>;
		clock-names = "mclk\0hclk";
		assigned-clocks = <0x08 0xb1>;
		assigned-clock-parents = <0x08 0x05>;
		interrupts = <0x00 0x42 0x04 0x00>;
		clocks = <0x08 0x55 0x08 0x1d7>;
		dma-names = "tx";
		#sound-dai-cells = <0x00>;
		compatible = "rockchip,rk3399-spdif";
		status = "okay";
		reg = <0x00 0xff870000 0x00 0x1000>;
		phandle = <0xd8>;
		dmas = <0x5f 0x07>;
	};

	i2c@ff110000 {
		pinctrl-names = "default";
		#address-cells = <0x01>;
		pinctrl-0 = <0x3d>;
		clock-names = "i2c\0pclk";
		assigned-clocks = <0x08 0x41>;
		assigned-clock-rates = <0xbebc200>;
		interrupts = <0x00 0x3b 0x04 0x00>;
		clocks = <0x08 0x41 0x08 0x155>;
		#size-cells = <0x00>;
		compatible = "rockchip,rk3399-i2c";
		status = "disabled";
		reg = <0x00 0xff110000 0x00 0x1000>;
		phandle = <0xf7>;
	};

	memory {
		device_type = "memory";
		reg = <0x00 0x200000 0x00 0xf7e00000>;
	};

	vcc3v3-dp {
		regulator-max-microvolt = <0x325aa0>;
		regulator-boot-on;
		regulator-always-on;
		regulator-min-microvolt = <0x325aa0>;
		regulator-name = "vcc3v3_dp";
		compatible = "regulator-fixed";
		phandle = <0xdc>;
		vin-supply = <0x92>;
	};

	mmc@fe310000 {
		power-domains = <0x1c 0x1c>;
		fifo-depth = <0x100>;
		pinctrl-names = "default";
		#address-cells = <0x01>;
		pinctrl-0 = <0x24 0x25 0x26>;
		clock-names = "biu\0ciu\0ciu-drive\0ciu-sample";
		cap-sd-highspeed;
		bus-width = <0x04>;
		non-removable;
		resets = <0x08 0x79>;
		cap-sdio-irq;
		interrupts = <0x00 0x40 0x04 0x00>;
		clocks = <0x08 0x1ee 0x08 0x4d 0x08 0x9c 0x08 0x9d>;
		#size-cells = <0x00>;
		keep-power-in-suspend;
		clock-frequency = <0x2faf080>;
		compatible = "rockchip,rk3399-dw-mshc\0rockchip,rk3288-dw-mshc";
		status = "okay";
		mmc-pwrseq = <0x23>;
		reg = <0x00 0xfe310000 0x00 0x4000>;
		phandle = <0xeb>;
		sd-uhs-sdr104;
		max-frequency = <0x8f0d180>;
		reset-names = "reset";

		wifi@1 {
			pinctrl-names = "default";
			pinctrl-0 = <0x28>;
			interrupts = <0x03 0x00>;
			interrupt-parent = <0x27>;
			compatible = "brcm,bcm4329-fmac";
			interrupt-names = "host-wake";
			reg = <0x01>;
			phandle = <0xec>;
		};
	};

	rockchip-system-monitor {
		rockchip,thermal-zone = "soc-thermal";
		compatible = "rockchip,system-monitor";
		phandle = <0x159>;
		rockchip,polling-delay = <0xc8>;
	};

	pwm@ff420030 {
		pinctrl-names = "active";
		pinctrl-0 = <0x9c>;
		clock-names = "pwm";
		clocks = <0x85 0x1e>;
		#pwm-cells = <0x03>;
		compatible = "rockchip,rk3399-pwm\0rockchip,rk3288-pwm";
		status = "okay";
		reg = <0x00 0xff420030 0x00 0x10>;
		phandle = <0xd3>;
	};

	pmu-clock-controller@ff750000 {
		#reset-cells = <0x01>;
		assigned-clocks = <0x85 0x01>;
		assigned-clock-rates = <0x284af100>;
		#clock-cells = <0x01>;
		compatible = "rockchip,rk3399-pmucru";
		rockchip,grf = <0x9d>;
		reg = <0x00 0xff750000 0x00 0x1000>;
		phandle = <0x85>;
	};

	qos@ffa90000 {
		compatible = "syscon";
		reg = <0x00 0xffa90000 0x00 0x20>;
		phandle = <0x7c>;
	};

	nocp-video-msch0@ffa87000 {
		compatible = "rockchip,rk3399-nocp";
		reg = <0x00 0xffa87000 0x00 0x400>;
		phandle = <0x14f>;
	};

	qos@ffa60080 {
		compatible = "syscon";
		reg = <0x00 0xffa60080 0x00 0x20>;
		phandle = <0x75>;
	};
};
