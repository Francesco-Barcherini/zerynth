/dts-v1/;

/ {
	compatible = "radxa,rock-4c-plus\0rockchip,rk3399";
	interrupt-parent = <0x01>;
	#address-cells = <0x02>;
	#size-cells = <0x02>;
	model = "Radxa ROCK 4C+";

	ddr_timing {
		compatible = "rockchip,ddr-timing";
		ddr3_speed_bin = <0x15>;
		pd_idle = <0x00>;
		sr_idle = <0x00>;
		sr_mc_gate_idle = <0x00>;
		srpd_lite_idle = <0x00>;
		standby_idle = <0x00>;
		auto_lp_dis_freq = <0x29a>;
		ddr3_dll_dis_freq = <0x12c>;
		phy_dll_dis_freq = <0x104>;
		ddr3_odt_dis_freq = <0x29a>;
		ddr3_drv = <0x28>;
		ddr3_odt = <0x78>;
		phy_ddr3_ca_drv = <0x28>;
		phy_ddr3_dq_drv = <0x28>;
		phy_ddr3_odt = <0xf0>;
		lpddr3_odt_dis_freq = <0x29a>;
		lpddr3_drv = <0x22>;
		lpddr3_odt = <0xf0>;
		phy_lpddr3_ca_drv = <0x22>;
		phy_lpddr3_dq_drv = <0x22>;
		phy_lpddr3_odt = <0xf0>;
		lpddr4_odt_dis_freq = <0x320>;
		lpddr4_drv = <0xf0>;
		lpddr4_dq_odt = <0x28>;
		lpddr4_ca_odt = <0x00>;
		phy_lpddr4_ca_drv = <0x28>;
		phy_lpddr4_ck_cs_drv = <0x28>;
		phy_lpddr4_dq_drv = <0x3c>;
		phy_lpddr4_odt = <0x28>;
		phandle = <0x9f>;
	};

	aliases {
		dsi0 = "/dsi@ff960000";
		dsi1 = "/dsi@ff968000";
		ethernet0 = "/ethernet@fe300000";
		gpio0 = "/pinctrl/gpio0@ff720000";
		gpio1 = "/pinctrl/gpio1@ff730000";
		gpio2 = "/pinctrl/gpio2@ff780000";
		gpio3 = "/pinctrl/gpio3@ff788000";
		gpio4 = "/pinctrl/gpio4@ff790000";
		i2c0 = "/i2c@ff3c0000";
		i2c1 = "/i2c@ff110000";
		i2c2 = "/i2c@ff120000";
		i2c3 = "/i2c@ff130000";
		i2c4 = "/i2c@ff3d0000";
		i2c5 = "/i2c@ff140000";
		i2c6 = "/i2c@ff150000";
		i2c7 = "/i2c@ff160000";
		i2c8 = "/i2c@ff3e0000";
		mmc0 = "/mmc@fe320000";
		mmc1 = "/sdhci@fe330000";
		mmc2 = "/mmc@fe310000";
		pwm0 = "/pwm@ff420000";
		pwm1 = "/pwm@ff420010";
		serial0 = "/serial@ff180000";
		serial1 = "/serial@ff190000";
		serial2 = "/serial@ff1a0000";
		serial3 = "/serial@ff1b0000";
		serial4 = "/serial@ff370000";
		spi1 = "/spi@ff1d0000";
		spi2 = "/spi@ff1e0000";
	};

	cpus {
		#address-cells = <0x02>;
		#size-cells = <0x00>;

		cpu-map {

			cluster0 {

				core0 {
					cpu = <0x02>;
				};

				core1 {
					cpu = <0x03>;
				};

				core2 {
					cpu = <0x04>;
				};

				core3 {
					cpu = <0x05>;
				};
			};

			cluster1 {

				core0 {
					cpu = <0x06>;
				};

				core1 {
					cpu = <0x07>;
				};
			};
		};

		cpu@0 {
			device_type = "cpu";
			compatible = "arm,cortex-a53";
			reg = <0x00 0x00>;
			enable-method = "psci";
			capacity-dmips-mhz = <0x1e5>;
			clocks = <0x08 0x08>;
			#cooling-cells = <0x02>;
			dynamic-power-coefficient = <0x64>;
			cpu-idle-states = <0x09 0x0a>;
			operating-points-v2 = <0x0b>;
			cpu-supply = <0x0c>;
			phandle = <0x02>;
		};

		cpu@1 {
			device_type = "cpu";
			compatible = "arm,cortex-a53";
			reg = <0x00 0x01>;
			enable-method = "psci";
			capacity-dmips-mhz = <0x1e5>;
			clocks = <0x08 0x08>;
			#cooling-cells = <0x02>;
			dynamic-power-coefficient = <0x64>;
			cpu-idle-states = <0x09 0x0a>;
			operating-points-v2 = <0x0b>;
			cpu-supply = <0x0c>;
			phandle = <0x03>;
		};

		cpu@2 {
			device_type = "cpu";
			compatible = "arm,cortex-a53";
			reg = <0x00 0x02>;
			enable-method = "psci";
			capacity-dmips-mhz = <0x1e5>;
			clocks = <0x08 0x08>;
			#cooling-cells = <0x02>;
			dynamic-power-coefficient = <0x64>;
			cpu-idle-states = <0x09 0x0a>;
			operating-points-v2 = <0x0b>;
			cpu-supply = <0x0c>;
			phandle = <0x04>;
		};

		cpu@3 {
			device_type = "cpu";
			compatible = "arm,cortex-a53";
			reg = <0x00 0x03>;
			enable-method = "psci";
			capacity-dmips-mhz = <0x1e5>;
			clocks = <0x08 0x08>;
			#cooling-cells = <0x02>;
			dynamic-power-coefficient = <0x64>;
			cpu-idle-states = <0x09 0x0a>;
			operating-points-v2 = <0x0b>;
			cpu-supply = <0x0c>;
			phandle = <0x05>;
		};

		cpu@100 {
			device_type = "cpu";
			compatible = "arm,cortex-a72";
			reg = <0x00 0x100>;
			enable-method = "psci";
			capacity-dmips-mhz = <0x400>;
			clocks = <0x08 0x09>;
			#cooling-cells = <0x02>;
			dynamic-power-coefficient = <0x1b4>;
			cpu-idle-states = <0x09 0x0a>;
			operating-points-v2 = <0x0d>;
			cpu-supply = <0x0e>;
			phandle = <0x06>;
		};

		cpu@101 {
			device_type = "cpu";
			compatible = "arm,cortex-a72";
			reg = <0x00 0x101>;
			enable-method = "psci";
			capacity-dmips-mhz = <0x400>;
			clocks = <0x08 0x09>;
			#cooling-cells = <0x02>;
			dynamic-power-coefficient = <0x1b4>;
			cpu-idle-states = <0x09 0x0a>;
			operating-points-v2 = <0x0d>;
			cpu-supply = <0x0e>;
			phandle = <0x07>;
		};

		idle-states {
			entry-method = "psci";

			cpu-sleep {
				compatible = "arm,idle-state";
				local-timer-stop;
				arm,psci-suspend-param = <0x10000>;
				entry-latency-us = <0x78>;
				exit-latency-us = <0xfa>;
				min-residency-us = <0x384>;
				phandle = <0x09>;
			};

			cluster-sleep {
				compatible = "arm,idle-state";
				local-timer-stop;
				arm,psci-suspend-param = <0x1010000>;
				entry-latency-us = <0x190>;
				exit-latency-us = <0x1f4>;
				min-residency-us = <0x7d0>;
				phandle = <0x0a>;
			};
		};
	};

	display-subsystem {
		compatible = "rockchip,display-subsystem";
		ports = <0x0f 0x10>;
		clocks = <0x08 0x07 0x08 0x04>;
		clock-names = "hdmi-tmds-pll\0default-vop-pll";
		status = "okay";
		logo-memory-region = <0x11>;
		phandle = <0xe1>;

		route {

			route-hdmi {
				status = "okay";
				logo,uboot = "logo.bmp";
				logo,kernel = "logo_kernel.bmp";
				logo,mode = "center";
				charge_logo,mode = "center";
				connect = <0x12>;
				phandle = <0xe2>;
			};

			route-dsi {
				status = "disabled";
				logo,uboot = "logo.bmp";
				logo,kernel = "logo_kernel.bmp";
				logo,mode = "center";
				charge_logo,mode = "center";
				connect = <0x13>;
				phandle = <0xe3>;
			};

			route-edp {
				status = "disabled";
				logo,uboot = "logo.bmp";
				logo,kernel = "logo_kernel.bmp";
				logo,mode = "center";
				charge_logo,mode = "center";
				connect = <0x14>;
				phandle = <0xe4>;
			};
		};
	};

	pmu_a53 {
		compatible = "arm,cortex-a53-pmu";
		interrupts = <0x01 0x07 0x08 0x15>;
	};

	pmu_a72 {
		compatible = "arm,cortex-a72-pmu";
		interrupts = <0x01 0x07 0x08 0x16>;
	};

	psci {
		compatible = "arm,psci-1.0";
		method = "smc";
	};

	timer {
		compatible = "arm,armv8-timer";
		interrupts = <0x01 0x0d 0x08 0x00 0x01 0x0e 0x08 0x00 0x01 0x0b 0x08 0x00 0x01 0x0a 0x08 0x00>;
		arm,no-tick-in-suspend;
	};

	xin24m {
		compatible = "fixed-clock";
		clock-frequency = <0x16e3600>;
		clock-output-names = "xin24m";
		#clock-cells = <0x00>;
		phandle = <0xe5>;
	};

	dummy_cpll {
		compatible = "fixed-clock";
		clock-frequency = <0x00>;
		clock-output-names = "dummy_cpll";
		#clock-cells = <0x00>;
		phandle = <0xe6>;
	};

	dummy_vpll {
		compatible = "fixed-clock";
		clock-frequency = <0x00>;
		clock-output-names = "dummy_vpll";
		#clock-cells = <0x00>;
		phandle = <0xe7>;
	};

	bus {
		compatible = "simple-bus";
		#address-cells = <0x02>;
		#size-cells = <0x02>;
		ranges;
		phandle = <0xe8>;

		dma-controller@ff6d0000 {
			compatible = "arm,pl330\0arm,primecell";
			reg = <0x00 0xff6d0000 0x00 0x4000>;
			interrupts = <0x00 0x05 0x04 0x00 0x00 0x06 0x04 0x00>;
			#dma-cells = <0x01>;
			arm,pl330-periph-burst;
			clocks = <0x08 0xd3>;
			clock-names = "apb_pclk";
			phandle = <0x5f>;
		};

		dma-controller@ff6e0000 {
			compatible = "arm,pl330\0arm,primecell";
			reg = <0x00 0xff6e0000 0x00 0x4000>;
			interrupts = <0x00 0x07 0x04 0x00 0x00 0x08 0x04 0x00>;
			#dma-cells = <0x01>;
			arm,pl330-periph-burst;
			clocks = <0x08 0xd4>;
			clock-names = "apb_pclk";
			phandle = <0x4e>;
		};
	};

	pcie@f8000000 {
		compatible = "rockchip,rk3399-pcie";
		reg = <0x00 0xf8000000 0x00 0x2000000 0x00 0xfd000000 0x00 0x1000000>;
		reg-names = "axi-base\0apb-base";
		device_type = "pci";
		#address-cells = <0x03>;
		#size-cells = <0x02>;
		#interrupt-cells = <0x01>;
		aspm-no-l0s;
		bus-range = <0x00 0x1f>;
		clocks = <0x08 0xc5 0x08 0xc4 0x08 0x147 0x08 0xa0>;
		clock-names = "aclk\0aclk-perf\0hclk\0pm";
		interrupts = <0x00 0x31 0x04 0x00 0x00 0x32 0x04 0x00 0x00 0x33 0x04 0x00>;
		interrupt-names = "sys\0legacy\0client";
		interrupt-map-mask = <0x00 0x00 0x00 0x07>;
		interrupt-map = <0x00 0x00 0x00 0x01 0x17 0x00 0x00 0x00 0x00 0x02 0x17 0x01 0x00 0x00 0x00 0x03 0x17 0x02 0x00 0x00 0x00 0x04 0x17 0x03>;
		max-link-speed = <0x01>;
		msi-map = <0x00 0x18 0x00 0x1000>;
		phys = <0x19 0x00 0x19 0x01 0x19 0x02 0x19 0x03>;
		phy-names = "pcie-phy-0\0pcie-phy-1\0pcie-phy-2\0pcie-phy-3";
		ranges = <0x83000000 0x00 0xfa000000 0x00 0xfa000000 0x00 0x1e00000 0x81000000 0x00 0xfbe00000 0x00 0xfbe00000 0x00 0x100000>;
		resets = <0x08 0x82 0x08 0x83 0x08 0x84 0x08 0x85 0x08 0x86 0x08 0x81 0x08 0x80>;
		reset-names = "core\0mgmt\0mgmt-sticky\0pipe\0pm\0pclk\0aclk";
		status = "okay";
		ep-gpios = <0x1a 0x01 0x00>;
		num-lanes = <0x04>;
		pinctrl-names = "default";
		pinctrl-0 = <0x1b>;
		phandle = <0xe9>;

		interrupt-controller {
			interrupt-controller;
			#address-cells = <0x00>;
			#interrupt-cells = <0x01>;
			phandle = <0x17>;
		};
	};

	ethernet@fe300000 {
		compatible = "rockchip,rk3399-gmac";
		reg = <0x00 0xfe300000 0x00 0x10000>;
		interrupts = <0x00 0x0c 0x04 0x00>;
		interrupt-names = "macirq";
		clocks = <0x08 0x69 0x08 0x67 0x08 0x68 0x08 0x66 0x08 0x6a 0x08 0xd5 0x08 0x166>;
		clock-names = "stmmaceth\0mac_clk_rx\0mac_clk_tx\0clk_mac_ref\0clk_mac_refout\0aclk_mac\0pclk_mac";
		power-domains = <0x1c 0x16>;
		resets = <0x08 0x89>;
		reset-names = "stmmaceth";
		rockchip,grf = <0x1d>;
		snps,txpbl = <0x04>;
		status = "okay";
		phy-supply = <0x1e>;
		phy-mode = "rgmii";
		clock_in_out = "input";
		snps,reset-gpio = <0x1f 0x0f 0x01>;
		snps,reset-active-low;
		snps,reset-delays-us = <0x00 0x4e20 0x186a0>;
		assigned-clocks = <0x08 0xa6>;
		assigned-clock-parents = <0x20>;
		pinctrl-names = "default\0sleep";
		pinctrl-0 = <0x21>;
		pinctrl-1 = <0x22>;
		tx_delay = <0x2a>;
		rx_delay = <0x21>;
		phandle = <0xea>;
	};

	mmc@fe310000 {
		compatible = "rockchip,rk3399-dw-mshc\0rockchip,rk3288-dw-mshc";
		reg = <0x00 0xfe310000 0x00 0x4000>;
		interrupts = <0x00 0x40 0x04 0x00>;
		max-frequency = <0x8f0d180>;
		clocks = <0x08 0x1ee 0x08 0x4d 0x08 0x9c 0x08 0x9d>;
		clock-names = "biu\0ciu\0ciu-drive\0ciu-sample";
		fifo-depth = <0x100>;
		power-domains = <0x1c 0x1c>;
		resets = <0x08 0x79>;
		reset-names = "reset";
		status = "okay";
		#address-cells = <0x01>;
		#size-cells = <0x00>;
		bus-width = <0x04>;
		clock-frequency = <0x2faf080>;
		cap-sdio-irq;
		cap-sd-highspeed;
		keep-power-in-suspend;
		mmc-pwrseq = <0x23>;
		non-removable;
		pinctrl-names = "default";
		pinctrl-0 = <0x24 0x25 0x26>;
		sd-uhs-sdr104;
		phandle = <0xeb>;

		wifi@1 {
			compatible = "brcm,bcm4329-fmac";
			reg = <0x01>;
			interrupt-parent = <0x27>;
			interrupts = <0x03 0x00>;
			interrupt-names = "host-wake";
			pinctrl-names = "default";
			pinctrl-0 = <0x28>;
			phandle = <0xec>;
		};
	};

	mmc@fe320000 {
		compatible = "rockchip,rk3399-dw-mshc\0rockchip,rk3288-dw-mshc";
		reg = <0x00 0xfe320000 0x00 0x4000>;
		interrupts = <0x00 0x41 0x04 0x00>;
		max-frequency = <0x8f0d180>;
		assigned-clocks = <0x08 0x1cd>;
		assigned-clock-rates = <0xbebc200>;
		clocks = <0x08 0x1ce 0x08 0x4c 0x08 0x9a 0x08 0x9b>;
		clock-names = "biu\0ciu\0ciu-drive\0ciu-sample";
		fifo-depth = <0x100>;
		power-domains = <0x1c 0x1b>;
		resets = <0x08 0x7a>;
		reset-names = "reset";
		status = "okay";
		clock-frequency = <0x8f0d180>;
		clock-freq-min-max = <0x186a0 0x8f0d180>;
		no-sdio;
		no-mmc;
		bus-width = <0x04>;
		cap-mmc-highspeed;
		cap-sd-highspeed;
		disable-wp;
		num-slots = <0x01>;
		sd-uhs-sdr104;
		vmmc-supply = <0x29>;
		vqmmc-supply = <0x2a>;
		pinctrl-names = "default";
		pinctrl-0 = <0x2b 0x2c 0x2d 0x2e>;
		phandle = <0xed>;
	};

	sdhci@fe330000 {
		compatible = "rockchip,rk3399-sdhci-5.1\0arasan,sdhci-5.1";
		reg = <0x00 0xfe330000 0x00 0x10000>;
		interrupts = <0x00 0x0b 0x04 0x00>;
		arasan,soc-ctl-syscon = <0x1d>;
		assigned-clocks = <0x08 0x4e>;
		assigned-clock-rates = <0xbebc200>;
		clocks = <0x08 0x4e 0x08 0xf0>;
		clock-names = "clk_xin\0clk_ahb";
		clock-output-names = "emmc_cardclock";
		#clock-cells = <0x00>;
		phys = <0x2f>;
		phy-names = "phy_arasan";
		power-domains = <0x1c 0x17>;
		disable-cqe-dcmd;
		disable-cqe;
		status = "okay";
		assigned-clock-parents = <0x08 0x05>;
		max-frequency = <0x8f0d180>;
		bus-width = <0x08>;
		mmc-hs400-1_8v;
		no-sdio;
		no-sd;
		non-removable;
		mmc-hs400-enhanced-strobe;
		phandle = <0xa8>;
	};

	usb@fe380000 {
		compatible = "generic-ehci";
		reg = <0x00 0xfe380000 0x00 0x20000>;
		interrupts = <0x00 0x1a 0x04 0x00>;
		clocks = <0x08 0x1c8 0x08 0x1c9 0x30>;
		phys = <0x31>;
		phy-names = "usb";
		status = "okay";
		phandle = <0xee>;
	};

	usb@fe3a0000 {
		compatible = "generic-ohci";
		reg = <0x00 0xfe3a0000 0x00 0x20000>;
		interrupts = <0x00 0x1c 0x04 0x00>;
		clocks = <0x08 0x1c8 0x08 0x1c9 0x30>;
		phys = <0x31>;
		phy-names = "usb";
		status = "okay";
		phandle = <0xef>;
	};

	usb@fe3c0000 {
		compatible = "generic-ehci";
		reg = <0x00 0xfe3c0000 0x00 0x20000>;
		interrupts = <0x00 0x1e 0x04 0x00>;
		clocks = <0x08 0x1ca 0x08 0x1cb 0x32>;
		phys = <0x33>;
		phy-names = "usb";
		status = "okay";
		phandle = <0xf0>;
	};

	usb@fe3e0000 {
		compatible = "generic-ohci";
		reg = <0x00 0xfe3e0000 0x00 0x20000>;
		interrupts = <0x00 0x20 0x04 0x00>;
		clocks = <0x08 0x1ca 0x08 0x1cb 0x32>;
		phys = <0x33>;
		phy-names = "usb";
		status = "okay";
		phandle = <0xf1>;
	};

	usb@fe800000 {
		compatible = "rockchip,rk3399-dwc3";
		#address-cells = <0x02>;
		#size-cells = <0x02>;
		ranges;
		clocks = <0x08 0x81 0x08 0x83 0x08 0xf6 0x08 0xf8 0x08 0xf4 0x08 0xf9>;
		clock-names = "ref_clk\0suspend_clk\0bus_clk\0aclk_usb3_rksoc_axi_perf\0aclk_usb3\0grf_clk";
		status = "okay";
		phandle = <0xf2>;

		usb@fe800000 {
			compatible = "snps,dwc3";
			reg = <0x00 0xfe800000 0x00 0x100000>;
			interrupts = <0x00 0x69 0x04 0x00>;
			clocks = <0x08 0x81 0x08 0xf6 0x08 0x83>;
			clock-names = "ref\0bus_early\0suspend";
			resets = <0x08 0x125>;
			reset-names = "usb3-otg";
			dr_mode = "host";
			phys = <0x34 0x35>;
			phy-names = "usb2-phy\0usb3-phy";
			phy_type = "utmi_wide";
			snps,dis_enblslpm_quirk;
			snps,dis-u1-entry-quirk;
			snps,dis-u2-entry-quirk;
			snps,dis-u2-freeclk-exists-quirk;
			snps,dis_u2_susphy_quirk;
			snps,dis-del-phy-power-chg-quirk;
			snps,dis-tx-ipgap-linecheck-quirk;
			power-domains = <0x1c 0x18>;
			status = "okay";
			phandle = <0xf3>;
		};
	};

	usb@fe900000 {
		compatible = "rockchip,rk3399-dwc3";
		#address-cells = <0x02>;
		#size-cells = <0x02>;
		ranges;
		clocks = <0x08 0x82 0x08 0x84 0x08 0xf7 0x08 0xf8 0x08 0xf4 0x08 0xf9>;
		clock-names = "ref_clk\0suspend_clk\0bus_clk\0aclk_usb3_rksoc_axi_perf\0aclk_usb3\0grf_clk";
		status = "okay";
		phandle = <0xf4>;

		usb@fe900000 {
			compatible = "snps,dwc3";
			reg = <0x00 0xfe900000 0x00 0x100000>;
			interrupts = <0x00 0x6e 0x04 0x00>;
			clocks = <0x08 0x82 0x08 0xf7 0x08 0x84>;
			clock-names = "ref\0bus_early\0suspend";
			resets = <0x08 0x126>;
			reset-names = "usb3-otg";
			dr_mode = "host";
			phys = <0x36 0x37>;
			phy-names = "usb2-phy\0usb3-phy";
			phy_type = "utmi_wide";
			snps,dis_enblslpm_quirk;
			snps,dis-u2-freeclk-exists-quirk;
			snps,dis_u2_susphy_quirk;
			snps,dis-del-phy-power-chg-quirk;
			snps,dis-tx-ipgap-linecheck-quirk;
			power-domains = <0x1c 0x18>;
			status = "okay";
			phandle = <0xf5>;
		};
	};

	dp@fec00000 {
		compatible = "rockchip,rk3399-cdn-dp";
		reg = <0x00 0xfec00000 0x00 0x100000>;
		interrupts = <0x00 0x09 0x04 0x00>;
		assigned-clocks = <0x08 0x72 0x08 0xa1>;
		assigned-clock-rates = <0x5f5e100 0xbebc200>;
		clocks = <0x08 0x72 0x08 0x175 0x08 0xa1 0x08 0x16f>;
		clock-names = "core-clk\0pclk\0spdif\0grf";
		phys = <0x38>;
		power-domains = <0x1c 0x15>;
		resets = <0x08 0x103 0x08 0x148 0x08 0x14a 0x08 0xfd>;
		reset-names = "spdif\0dptx\0apb\0core";
		rockchip,grf = <0x1d>;
		#sound-dai-cells = <0x01>;
		status = "okay";
		extcon = <0x39>;
		phandle = <0xd9>;

		ports {

			port {
				#address-cells = <0x01>;
				#size-cells = <0x00>;
				phandle = <0xf6>;

				endpoint@0 {
					reg = <0x00>;
					remote-endpoint = <0x3a>;
					status = "disabled";
					phandle = <0xb8>;
				};

				endpoint@1 {
					reg = <0x01>;
					remote-endpoint = <0x3b>;
					status = "okay";
					phandle = <0xb1>;
				};
			};
		};
	};

	interrupt-controller@fee00000 {
		compatible = "arm,gic-v3";
		#interrupt-cells = <0x04>;
		#address-cells = <0x02>;
		#size-cells = <0x02>;
		ranges;
		interrupt-controller;
		reg = <0x00 0xfee00000 0x00 0x10000 0x00 0xfef00000 0x00 0xc0000 0x00 0xfff00000 0x00 0x10000 0x00 0xfff10000 0x00 0x10000 0x00 0xfff20000 0x00 0x10000>;
		interrupts = <0x01 0x09 0x04 0x00>;
		phandle = <0x01>;

		interrupt-controller@fee20000 {
			compatible = "arm,gic-v3-its";
			msi-controller;
			#msi-cells = <0x01>;
			reg = <0x00 0xfee20000 0x00 0x20000>;
			phandle = <0x18>;
		};

		ppi-partitions {

			interrupt-partition-0 {
				affinity = <0x02 0x03 0x04 0x05>;
				phandle = <0x15>;
			};

			interrupt-partition-1 {
				affinity = <0x06 0x07>;
				phandle = <0x16>;
			};
		};
	};

	saradc@ff100000 {
		compatible = "rockchip,rk3399-saradc";
		reg = <0x00 0xff100000 0x00 0x100>;
		interrupts = <0x00 0x3e 0x04 0x00>;
		#io-channel-cells = <0x01>;
		clocks = <0x08 0x50 0x08 0x165>;
		clock-names = "saradc\0apb_pclk";
		resets = <0x08 0xd4>;
		reset-names = "saradc-apb";
		status = "okay";
		vref-supply = <0x3c>;
		phandle = <0xdf>;
	};

	i2c@ff110000 {
		compatible = "rockchip,rk3399-i2c";
		reg = <0x00 0xff110000 0x00 0x1000>;
		assigned-clocks = <0x08 0x41>;
		assigned-clock-rates = <0xbebc200>;
		clocks = <0x08 0x41 0x08 0x155>;
		clock-names = "i2c\0pclk";
		interrupts = <0x00 0x3b 0x04 0x00>;
		pinctrl-names = "default";
		pinctrl-0 = <0x3d>;
		#address-cells = <0x01>;
		#size-cells = <0x00>;
		status = "disabled";
		phandle = <0xf7>;
	};

	i2c@ff120000 {
		compatible = "rockchip,rk3399-i2c";
		reg = <0x00 0xff120000 0x00 0x1000>;
		assigned-clocks = <0x08 0x42>;
		assigned-clock-rates = <0xbebc200>;
		clocks = <0x08 0x42 0x08 0x156>;
		clock-names = "i2c\0pclk";
		interrupts = <0x00 0x23 0x04 0x00>;
		pinctrl-names = "default";
		pinctrl-0 = <0x3e>;
		#address-cells = <0x01>;
		#size-cells = <0x00>;
		status = "disabled";
		phandle = <0xf8>;
		clock-frequency = <0x4c4b40>; 
		/*clock-frequency = <0xf4240>;*/
	};

	i2c@ff130000 {
		compatible = "rockchip,rk3399-i2c";
		reg = <0x00 0xff130000 0x00 0x1000>;
		assigned-clocks = <0x08 0x43>;
		assigned-clock-rates = <0xbebc200>;
		clocks = <0x08 0x43 0x08 0x157>;
		clock-names = "i2c\0pclk";
		interrupts = <0x00 0x22 0x04 0x00>;
		pinctrl-names = "default";
		pinctrl-0 = <0x3f>;
		#address-cells = <0x01>;
		#size-cells = <0x00>;
		status = "disabled";
		phandle = <0xf9>;
	};

	i2c@ff140000 {
		compatible = "rockchip,rk3399-i2c";
		reg = <0x00 0xff140000 0x00 0x1000>;
		assigned-clocks = <0x08 0x44>;
		assigned-clock-rates = <0xbebc200>;
		clocks = <0x08 0x44 0x08 0x158>;
		clock-names = "i2c\0pclk";
		interrupts = <0x00 0x26 0x04 0x00>;
		pinctrl-names = "default";
		pinctrl-0 = <0x40>;
		#address-cells = <0x01>;
		#size-cells = <0x00>;
		status = "disabled";
		phandle = <0xfa>;
	};

	i2c@ff150000 {
		compatible = "rockchip,rk3399-i2c";
		reg = <0x00 0xff150000 0x00 0x1000>;
		assigned-clocks = <0x08 0x45>;
		assigned-clock-rates = <0xbebc200>;
		clocks = <0x08 0x45 0x08 0x159>;
		clock-names = "i2c\0pclk";
		interrupts = <0x00 0x25 0x04 0x00>;
		pinctrl-names = "default";
		pinctrl-0 = <0x41>;
		#address-cells = <0x01>;
		#size-cells = <0x00>;
		status = "disabled";
		phandle = <0xfb>;
	};

	i2c@ff160000 {
		compatible = "rockchip,rk3399-i2c";
		reg = <0x00 0xff160000 0x00 0x1000>;
		assigned-clocks = <0x08 0x46>;
		assigned-clock-rates = <0xbebc200>;
		clocks = <0x08 0x46 0x08 0x15a>;
		clock-names = "i2c\0pclk";
		interrupts = <0x00 0x24 0x04 0x00>;
		pinctrl-names = "default";
		pinctrl-0 = <0x42>;
		#address-cells = <0x01>;
		#size-cells = <0x00>;
		status = "disabled";
		phandle = <0xfc>;
		clock-frequency = <0x61a80>;
	};

	serial@ff180000 {
		compatible = "rockchip,rk3399-uart\0snps,dw-apb-uart";
		reg = <0x00 0xff180000 0x00 0x100>;
		clocks = <0x08 0x51 0x08 0x160>;
		clock-names = "baudclk\0apb_pclk";
		interrupts = <0x00 0x63 0x04 0x00>;
		reg-shift = <0x02>;
		reg-io-width = <0x04>;
		pinctrl-names = "default";
		pinctrl-0 = <0x43 0x44 0x45>;
		status = "okay";
		assigned-clocks = <0x08 0xac>;
		assigned-clock-parents = <0x08 0x05>;
		phandle = <0xfd>;

		bluetooth {
			compatible = "brcm,bcm4345c5";
			clocks = <0x46 0x01>;
			clock-names = "lpo";
			device-wakeup-gpios = <0x47 0x1b 0x00>;
			host-wakeup-gpios = <0x27 0x04 0x00>;
			shutdown-gpios = <0x27 0x09 0x00>;
			max-speed = <0x16e360>;
			pinctrl-names = "default";
			pinctrl-0 = <0x48 0x49 0x4a>;
			vbat-supply = <0x29>;
			vddio-supply = <0x3c>;
		};
	};

	serial@ff190000 {
		compatible = "rockchip,rk3399-uart\0snps,dw-apb-uart";
		reg = <0x00 0xff190000 0x00 0x100>;
		clocks = <0x08 0x52 0x08 0x161>;
		clock-names = "baudclk\0apb_pclk";
		interrupts = <0x00 0x62 0x04 0x00>;
		reg-shift = <0x02>;
		reg-io-width = <0x04>;
		pinctrl-names = "default";
		pinctrl-0 = <0x4b>;
		status = "disabled";
		assigned-clocks = <0x08 0xad>;
		assigned-clock-parents = <0x08 0x05>;
		phandle = <0xfe>;
	};

	serial@ff1a0000 {
		compatible = "rockchip,rk3399-uart\0snps,dw-apb-uart";
		reg = <0x00 0xff1a0000 0x00 0x100>;
		clocks = <0x08 0x53 0x08 0x162>;
		clock-names = "baudclk\0apb_pclk";
		interrupts = <0x00 0x64 0x04 0x00>;
		reg-shift = <0x02>;
		reg-io-width = <0x04>;
		pinctrl-names = "default";
		pinctrl-0 = <0x4c>;
		status = "disabled";
		assigned-clocks = <0x08 0xad>;
		assigned-clock-parents = <0x08 0x05>;
		phandle = <0xff>;
	};

	serial@ff1b0000 {
		compatible = "rockchip,rk3399-uart\0snps,dw-apb-uart";
		reg = <0x00 0xff1b0000 0x00 0x100>;
		clocks = <0x08 0x54 0x08 0x163>;
		clock-names = "baudclk\0apb_pclk";
		interrupts = <0x00 0x65 0x04 0x00>;
		reg-shift = <0x02>;
		reg-io-width = <0x04>;
		pinctrl-names = "default";
		pinctrl-0 = <0x4d>;
		status = "disabled";
		assigned-clocks = <0x08 0xad>;
		assigned-clock-parents = <0x08 0x05>;
		phandle = <0x100>;
	};

	spi@ff1c0000 {
		compatible = "rockchip,rk3399-spi\0rockchip,rk3066-spi";
		reg = <0x00 0xff1c0000 0x00 0x1000>;
		clocks = <0x08 0x47 0x08 0x15b>;
		clock-names = "spiclk\0apb_pclk";
		interrupts = <0x00 0x44 0x04 0x00>;
		dmas = <0x4e 0x0a 0x4e 0x0b>;
		dma-names = "tx\0rx";
		pinctrl-names = "default";
		pinctrl-0 = <0x4f 0x50 0x51 0x52>;
		#address-cells = <0x01>;
		#size-cells = <0x00>;
		status = "disabled";
		phandle = <0x101>;
	};

	spi@ff1d0000 {
		compatible = "rockchip,rk3399-spi\0rockchip,rk3066-spi";
		reg = <0x00 0xff1d0000 0x00 0x1000>;
		clocks = <0x08 0x48 0x08 0x15c>;
		clock-names = "spiclk\0apb_pclk";
		interrupts = <0x00 0x35 0x04 0x00>;
		dmas = <0x4e 0x0c 0x4e 0x0d>;
		dma-names = "tx\0rx";
		pinctrl-names = "default";
		pinctrl-0 = <0x53 0x54 0x55 0x56>;
		#address-cells = <0x01>;
		#size-cells = <0x00>;
		status = "disabled";
		max-freq = <0x989680>;
		phandle = <0x102>;

		spi-flash@0 {
			#address-cells = <0x01>;
			#size-cells = <0x01>;
			compatible = "jedec,spi-nor";
			reg = <0x00>;
			spi-max-frequency = <0x989680>;
			status = "disabled";
			phandle = <0x103>;

			partitions {
				compatible = "fixed-partitions";
				#address-cells = <0x01>;
				#size-cells = <0x01>;

				loader@0 {
					label = "loader";
					reg = <0x00 0x400000>;
				};
			};
		};
	};

	spi@ff1e0000 {
		compatible = "rockchip,rk3399-spi\0rockchip,rk3066-spi";
		reg = <0x00 0xff1e0000 0x00 0x1000>;
		clocks = <0x08 0x49 0x08 0x15d>;
		clock-names = "spiclk\0apb_pclk";
		interrupts = <0x00 0x34 0x04 0x00>;
		dmas = <0x4e 0x0e 0x4e 0x0f>;
		dma-names = "tx\0rx";
		pinctrl-names = "default";
		pinctrl-0 = <0x57 0x58 0x59 0x5a>;
		#address-cells = <0x01>;
		#size-cells = <0x00>;
		status = "disabled";
		phandle = <0x104>;
	};

	spi@ff1f0000 {
		compatible = "rockchip,rk3399-spi\0rockchip,rk3066-spi";
		reg = <0x00 0xff1f0000 0x00 0x1000>;
		clocks = <0x08 0x4a 0x08 0x15e>;
		clock-names = "spiclk\0apb_pclk";
		interrupts = <0x00 0x43 0x04 0x00>;
		dmas = <0x4e 0x12 0x4e 0x13>;
		dma-names = "tx\0rx";
		pinctrl-names = "default";
		pinctrl-0 = <0x5b 0x5c 0x5d 0x5e>;
		#address-cells = <0x01>;
		#size-cells = <0x00>;
		status = "disabled";
		phandle = <0x105>;
	};

	spi@ff200000 {
		compatible = "rockchip,rk3399-spi\0rockchip,rk3066-spi";
		reg = <0x00 0xff200000 0x00 0x1000>;
		clocks = <0x08 0x4b 0x08 0x15f>;
		clock-names = "spiclk\0apb_pclk";
		interrupts = <0x00 0x84 0x04 0x00>;
		dmas = <0x5f 0x08 0x5f 0x09>;
		dma-names = "tx\0rx";
		pinctrl-names = "default";
		pinctrl-0 = <0x60 0x61 0x62 0x63>;
		power-domains = <0x1c 0x1c>;
		#address-cells = <0x01>;
		#size-cells = <0x00>;
		status = "disabled";
		phandle = <0x106>;
	};

	thermal-zones {
		phandle = <0x107>;

		cpu-thermal {
			polling-delay-passive = <0x14>;
			polling-delay = <0x3e8>;
			sustainable-power = <0x1388>;
			thermal-sensors = <0x64 0x00>;
			phandle = <0x108>;

			trips {

				cpu_alert0 {
					temperature = <0xea60>;
					hysteresis = <0x7d0>;
					type = "passive";
					phandle = <0x68>;
				};

				cpu_alert1 {
					temperature = <0x186a0>;
					hysteresis = <0x7d0>;
					type = "passive";
					phandle = <0x65>;
				};

				cpu_crit {
					temperature = <0x19a28>;
					hysteresis = <0x7d0>;
					type = "critical";
					phandle = <0x109>;
				};
			};

			cooling-maps {

				map0 {
					trip = <0x65>;
					cooling-device = <0x02 0xffffffff 0xffffffff>;
					contribution = <0x1000>;
				};

				map1 {
					trip = <0x65>;
					cooling-device = <0x06 0xffffffff 0xffffffff>;
					contribution = <0x400>;
				};

				map2 {
					trip = <0x65>;
					cooling-device = <0x66 0xffffffff 0xffffffff>;
					contribution = <0x1000>;
				};

				map3 {
					trip = <0x65>;
					cooling-device = <0x67 0xffffffff 0xffffffff>;
					contribution = <0x2000>;
				};

				map4 {
					trip = <0x68>;
					cooling-device = <0x67 0xffffffff 0xffffffff>;
					contribution = <0x2000>;
				};
			};
		};

		gpu-thermal {
			polling-delay-passive = <0x64>;
			polling-delay = <0x3e8>;
			thermal-sensors = <0x64 0x01>;
			phandle = <0x10a>;
		};
	};

	tsadc@ff260000 {
		compatible = "rockchip,rk3399-tsadc";
		reg = <0x00 0xff260000 0x00 0x100>;
		interrupts = <0x00 0x61 0x04 0x00>;
		assigned-clocks = <0x08 0x4f>;
		assigned-clock-rates = <0xb71b0>;
		clocks = <0x08 0x4f 0x08 0x164>;
		clock-names = "tsadc\0apb_pclk";
		resets = <0x08 0xe8>;
		reset-names = "tsadc-apb";
		rockchip,grf = <0x1d>;
		rockchip,hw-tshut-temp = <0x1adb0>;
		pinctrl-names = "gpio\0otpout";
		pinctrl-0 = <0x69>;
		pinctrl-1 = <0x6a>;
		#thermal-sensor-cells = <0x01>;
		status = "okay";
		rockchip,hw-tshut-mode = <0x01>;
		rockchip,hw-tshut-polarity = <0x01>;
		phandle = <0x64>;
	};

	qos@ffa58000 {
		compatible = "syscon";
		reg = <0x00 0xffa58000 0x00 0x20>;
		phandle = <0x72>;
	};

	qos@ffa5c000 {
		compatible = "syscon";
		reg = <0x00 0xffa5c000 0x00 0x20>;
		phandle = <0x73>;
	};

	qos@ffa60080 {
		compatible = "syscon";
		reg = <0x00 0xffa60080 0x00 0x20>;
		phandle = <0x75>;
	};

	qos@ffa60100 {
		compatible = "syscon";
		reg = <0x00 0xffa60100 0x00 0x20>;
		phandle = <0x76>;
	};

	qos@ffa60180 {
		compatible = "syscon";
		reg = <0x00 0xffa60180 0x00 0x20>;
		phandle = <0x77>;
	};

	qos@ffa70000 {
		compatible = "syscon";
		reg = <0x00 0xffa70000 0x00 0x20>;
		phandle = <0x7a>;
	};

	qos@ffa70080 {
		compatible = "syscon";
		reg = <0x00 0xffa70080 0x00 0x20>;
		phandle = <0x7b>;
	};

	qos@ffa74000 {
		compatible = "syscon";
		reg = <0x00 0xffa74000 0x00 0x20>;
		phandle = <0x78>;
	};

	qos@ffa76000 {
		compatible = "syscon";
		reg = <0x00 0xffa76000 0x00 0x20>;
		phandle = <0x79>;
	};

	qos@ffa90000 {
		compatible = "syscon";
		reg = <0x00 0xffa90000 0x00 0x20>;
		phandle = <0x7c>;
	};

	qos@ffa98000 {
		compatible = "syscon";
		reg = <0x00 0xffa98000 0x00 0x20>;
		phandle = <0x6b>;
	};

	qos@ffaa0000 {
		compatible = "syscon";
		reg = <0x00 0xffaa0000 0x00 0x20>;
		phandle = <0x7d>;
	};

	qos@ffaa0080 {
		compatible = "syscon";
		reg = <0x00 0xffaa0080 0x00 0x20>;
		phandle = <0x7e>;
	};

	qos@ffaa8000 {
		compatible = "syscon";
		reg = <0x00 0xffaa8000 0x00 0x20>;
		phandle = <0x7f>;
	};

	qos@ffaa8080 {
		compatible = "syscon";
		reg = <0x00 0xffaa8080 0x00 0x20>;
		phandle = <0x80>;
	};

	qos@ffab0000 {
		compatible = "syscon";
		reg = <0x00 0xffab0000 0x00 0x20>;
		phandle = <0x6c>;
	};

	qos@ffab0080 {
		compatible = "syscon";
		reg = <0x00 0xffab0080 0x00 0x20>;
		phandle = <0x6d>;
	};

	qos@ffab8000 {
		compatible = "syscon";
		reg = <0x00 0xffab8000 0x00 0x20>;
		phandle = <0x6e>;
	};

	qos@ffac0000 {
		compatible = "syscon";
		reg = <0x00 0xffac0000 0x00 0x20>;
		phandle = <0x6f>;
	};

	qos@ffac0080 {
		compatible = "syscon";
		reg = <0x00 0xffac0080 0x00 0x20>;
		phandle = <0x70>;
	};

	qos@ffac8000 {
		compatible = "syscon";
		reg = <0x00 0xffac8000 0x00 0x20>;
		phandle = <0x81>;
	};

	qos@ffac8080 {
		compatible = "syscon";
		reg = <0x00 0xffac8080 0x00 0x20>;
		phandle = <0x82>;
	};

	qos@ffad0000 {
		compatible = "syscon";
		reg = <0x00 0xffad0000 0x00 0x20>;
		phandle = <0x83>;
	};

	qos@ffad8080 {
		compatible = "syscon";
		reg = <0x00 0xffad8080 0x00 0x20>;
		phandle = <0x74>;
	};

	qos@ffae0000 {
		compatible = "syscon";
		reg = <0x00 0xffae0000 0x00 0x20>;
		phandle = <0x71>;
	};

	power-management@ff310000 {
		compatible = "rockchip,rk3399-pmu\0syscon\0simple-mfd";
		reg = <0x00 0xff310000 0x00 0x1000>;
		phandle = <0x10b>;

		power-controller {
			compatible = "rockchip,rk3399-power-controller";
			#power-domain-cells = <0x01>;
			#address-cells = <0x01>;
			#size-cells = <0x00>;
			phandle = <0x1c>;

			power-domain@34 {
				reg = <0x22>;
				clocks = <0x08 0xe1 0x08 0x1dd>;
				pm_qos = <0x6b>;
			};

			power-domain@33 {
				reg = <0x21>;
				clocks = <0x08 0xdc 0x08 0x1e5>;
				pm_qos = <0x6c 0x6d>;
			};

			power-domain@31 {
				reg = <0x1f>;
				clocks = <0x08 0xeb 0x08 0x1ea>;
				pm_qos = <0x6e>;
			};

			power-domain@32 {
				reg = <0x20>;
				clocks = <0x08 0xed 0x08 0x1ec>;
				pm_qos = <0x6f 0x70>;
			};

			power-domain@35 {
				reg = <0x23>;
				clocks = <0x08 0xd0>;
				pm_qos = <0x71>;
			};

			power-domain@25 {
				reg = <0x19>;
				clocks = <0x08 0x16c>;
			};

			power-domain@23 {
				reg = <0x17>;
				clocks = <0x08 0xf0>;
				pm_qos = <0x72>;
			};

			power-domain@22 {
				reg = <0x16>;
				clocks = <0x08 0xd5 0x08 0x166>;
				pm_qos = <0x73>;
			};

			power-domain@14 {
				reg = <0x0e>;
				#address-cells = <0x01>;
				#size-cells = <0x00>;
				clocks = <0x08 0xc0>;
				pm_qos = <0x74 0x75 0x76 0x77>;

				power-domain@27 {
					reg = <0x1b>;
					clocks = <0x08 0x1ce 0x08 0x4c>;
					pm_qos = <0x78>;
				};
			};

			power-domain@28 {
				reg = <0x1c>;
				clocks = <0x08 0x1ee>;
				pm_qos = <0x79>;
			};

			power-domain@8 {
				reg = <0x08>;
				clocks = <0x08 0x7e 0x08 0x7d>;
			};

			power-domain@9 {
				reg = <0x09>;
				clocks = <0x08 0x80 0x08 0x7f>;
			};

			power-domain@24 {
				reg = <0x18>;
				clocks = <0x08 0xf4>;
				pm_qos = <0x7a 0x7b>;
			};

			power-domain@15 {
				reg = <0x0f>;
				#address-cells = <0x01>;
				#size-cells = <0x00>;

				power-domain@21 {
					reg = <0x15>;
					clocks = <0x08 0xde 0x08 0x1e7 0x08 0x172>;
					pm_qos = <0x7c>;
				};

				power-domain@19 {
					reg = <0x13>;
					clocks = <0x08 0xe5 0x08 0x1df>;
					pm_qos = <0x7d 0x7e>;
				};

				power-domain@20 {
					reg = <0x14>;
					clocks = <0x08 0xe6 0x08 0x1e0>;
					pm_qos = <0x7f 0x80>;
				};

				power-domain@16 {
					reg = <0x10>;
					#address-cells = <0x01>;
					#size-cells = <0x00>;

					power-domain@17 {
						reg = <0x11>;
						clocks = <0x08 0xd9 0x08 0x1d9>;
						pm_qos = <0x81 0x82>;
					};

					power-domain@18 {
						reg = <0x12>;
						clocks = <0x08 0xdb 0x08 0x1db>;
						pm_qos = <0x83>;
					};
				};
			};
		};
	};

	syscon@ff320000 {
		compatible = "rockchip,rk3399-pmugrf\0syscon\0simple-mfd";
		reg = <0x00 0xff320000 0x00 0x1000>;
		phandle = <0x9d>;

		io-domains {
			compatible = "rockchip,rk3399-pmu-io-voltage-domain";
			status = "okay";
			pmu1830-supply = <0x84>;
			phandle = <0x10c>;
		};

		reboot-mode {
			compatible = "syscon-reboot-mode";
			offset = <0x300>;
			mode-charge = <0x5242c30b>;
			mode-fastboot = <0x5242c309>;
			mode-loader = <0x5242c301>;
			mode-normal = <0x5242c300>;
			mode-panic = <0x5242c307>;
			mode-recovery = <0x5242c303>;
			mode-ums = <0x5242c30c>;
			phandle = <0x10d>;
		};

		pmu-pvtm {
			compatible = "rockchip,rk3399-pmu-pvtm";
			#address-cells = <0x01>;
			#size-cells = <0x00>;
			status = "okay";
			phandle = <0x10e>;

			pvtm@4 {
				reg = <0x04>;
				clocks = <0x85 0x07>;
				clock-names = "clk";
				resets = <0x85 0x1b>;
				reset-names = "rst";
			};
		};
	};

	spi@ff350000 {
		compatible = "rockchip,rk3399-spi\0rockchip,rk3066-spi";
		reg = <0x00 0xff350000 0x00 0x1000>;
		clocks = <0x85 0x03 0x85 0x1f>;
		clock-names = "spiclk\0apb_pclk";
		interrupts = <0x00 0x3c 0x04 0x00>;
		pinctrl-names = "default";
		pinctrl-0 = <0x86 0x87 0x88 0x89>;
		#address-cells = <0x01>;
		#size-cells = <0x00>;
		status = "disabled";
		phandle = <0x10f>;
	};

	serial@ff370000 {
		compatible = "rockchip,rk3399-uart\0snps,dw-apb-uart";
		reg = <0x00 0xff370000 0x00 0x100>;
		clocks = <0x85 0x06 0x85 0x22>;
		clock-names = "baudclk\0apb_pclk";
		interrupts = <0x00 0x66 0x04 0x00>;
		reg-shift = <0x02>;
		reg-io-width = <0x04>;
		pinctrl-names = "default";
		pinctrl-0 = <0x8a>;
		status = "disabled";
		assigned-clocks = <0x85 0x0c>;
		assigned-clock-parents = <0x85 0x01>;
		phandle = <0x110>;
	};

	i2c@ff3c0000 {
		compatible = "rockchip,rk3399-i2c";
		reg = <0x00 0xff3c0000 0x00 0x1000>;
		assigned-clocks = <0x85 0x09>;
		assigned-clock-rates = <0xbebc200>;
		clocks = <0x85 0x09 0x85 0x1b>;
		clock-names = "i2c\0pclk";
		interrupts = <0x00 0x39 0x04 0x00>;
		pinctrl-names = "default";
		pinctrl-0 = <0x8b>;
		#address-cells = <0x01>;
		#size-cells = <0x00>;
		status = "okay";
		i2c-scl-rising-time-ns = <0xb4>;
		i2c-scl-falling-time-ns = <0x1e>;
		clock-frequency = <0xf4240>;
		phandle = <0x111>;

		pmic@20 {
			compatible = "rockchip,rk809";
			reg = <0x20>;
			interrupt-parent = <0x1a>;
			interrupts = <0x15 0x08>;
			pinctrl-names = "default\0pmic-sleep\0pmic-power-off\0pmic-reset";
			pinctrl-0 = <0x8c>;
			pinctrl-1 = <0x8d 0x8e>;
			pinctrl-2 = <0x8f 0x90>;
			pinctrl-3 = <0x8f 0x91>;
			rockchip,system-power-controller;
			pmic-reset-func = <0x00>;
			wakeup-source;
			#clock-cells = <0x01>;
			clock-output-names = "rk808-clkout1\0rk808-clkout2";
			vcc1-supply = <0x92>;
			vcc2-supply = <0x92>;
			vcc3-supply = <0x92>;
			vcc4-supply = <0x92>;
			vcc5-supply = <0x93>;
			vcc6-supply = <0x93>;
			vcc7-supply = <0x92>;
			vcc8-supply = <0x29>;
			vcc9-supply = <0x92>;
			phandle = <0x46>;

			pwrkey {
				status = "okay";
			};

			rtc {
				status = "okay";
			};

			pinctrl_rk8xx {
				gpio-controller;
				#gpio-cells = <0x02>;
				phandle = <0x112>;

				rk809_slppin_null {
					pins = "gpio_slp";
					function = "pin_fun0";
					phandle = <0x91>;
				};

				rk809_slppin_slp {
					pins = "gpio_slp";
					function = "pin_fun1";
					phandle = <0x8e>;
				};

				rk809_slppin_pwrdn {
					pins = "gpio_slp";
					function = "pin_fun2";
					phandle = <0x90>;
				};

				rk809_slppin_rst {
					pins = "gpio_slp";
					function = "pin_fun3";
					phandle = <0x113>;
				};
			};

			regulators {

				DCDC_REG1 {
					regulator-always-on;
					regulator-boot-on;
					regulator-min-microvolt = <0xb71b0>;
					regulator-max-microvolt = <0x149970>;
					regulator-initial-mode = <0x02>;
					regulator-name = "vdd_log";
					phandle = <0xa1>;

					regulator-state-mem {
						regulator-off-in-suspend;
						regulator-suspend-microvolt = <0xdbba0>;
					};
				};

				DCDC_REG2 {
					regulator-always-on;
					regulator-boot-on;
					regulator-min-microvolt = <0xb71b0>;
					regulator-max-microvolt = <0x149970>;
					regulator-ramp-delay = <0x1771>;
					regulator-initial-mode = <0x02>;
					regulator-name = "vdd_cpu_l";
					phandle = <0x0c>;

					regulator-state-mem {
						regulator-off-in-suspend;
					};
				};

				DCDC_REG3 {
					regulator-always-on;
					regulator-boot-on;
					regulator-name = "vcc_ddr";
					regulator-initial-mode = <0x02>;
					phandle = <0x114>;

					regulator-state-mem {
						regulator-on-in-suspend;
					};
				};

				DCDC_REG4 {
					regulator-always-on;
					regulator-boot-on;
					regulator-min-microvolt = <0x325aa0>;
					regulator-max-microvolt = <0x325aa0>;
					regulator-initial-mode = <0x02>;
					regulator-name = "vcc3v3_sys";
					phandle = <0x29>;

					regulator-state-mem {
						regulator-on-in-suspend;
						regulator-suspend-microvolt = <0x325aa0>;
					};
				};

				DCDC_REG5 {
					regulator-always-on;
					regulator-boot-on;
					regulator-min-microvolt = <0x325aa0>;
					regulator-max-microvolt = <0x325aa0>;
					regulator-name = "vcc_buck5";
					phandle = <0x93>;

					regulator-state-mem {
						regulator-on-in-suspend;
						regulator-suspend-microvolt = <0x325aa0>;
					};
				};

				LDO_REG1 {
					regulator-always-on;
					regulator-boot-on;
					regulator-min-microvolt = <0xdbba0>;
					regulator-max-microvolt = <0xdbba0>;
					regulator-name = "vcca_0v9";
					phandle = <0x115>;

					regulator-state-mem {
						regulator-off-in-suspend;
					};
				};

				LDO_REG2 {
					regulator-always-on;
					regulator-boot-on;
					regulator-min-microvolt = <0x1b7740>;
					regulator-max-microvolt = <0x1b7740>;
					regulator-name = "vcc_1v8";
					phandle = <0x3c>;

					regulator-state-mem {
						regulator-on-in-suspend;
						regulator-suspend-microvolt = <0x1b7740>;
					};
				};

				LDO_REG3 {
					regulator-always-on;
					regulator-boot-on;
					regulator-min-microvolt = <0xdbba0>;
					regulator-max-microvolt = <0xdbba0>;
					regulator-name = "vcc0v9_soc";
					phandle = <0x116>;

					regulator-state-mem {
						regulator-on-in-suspend;
						regulator-suspend-microvolt = <0xdbba0>;
					};
				};

				LDO_REG4 {
					regulator-always-on;
					regulator-boot-on;
					regulator-min-microvolt = <0x1c3a90>;
					regulator-max-microvolt = <0x1c3a90>;
					regulator-name = "vcca_1v8";
					phandle = <0xa6>;

					regulator-state-mem {
						regulator-off-in-suspend;
					};
				};

				LDO_REG5 {
					regulator-always-on;
					regulator-boot-on;
					regulator-min-microvolt = <0x2dc6c0>;
					regulator-max-microvolt = <0x2dc6c0>;
					regulator-name = "vcc_mipi";
					phandle = <0x117>;

					regulator-state-mem {
						regulator-off-in-suspend;
					};
				};

				LDO_REG6 {
					regulator-always-on;
					regulator-boot-on;
					regulator-min-microvolt = <0x16e360>;
					regulator-max-microvolt = <0x16e360>;
					regulator-name = "vcc_1v5";
					phandle = <0x118>;

					regulator-state-mem {
						regulator-off-in-suspend;
					};
				};

				LDO_REG7 {
					regulator-always-on;
					regulator-boot-on;
					regulator-min-microvolt = <0x2dc6c0>;
					regulator-max-microvolt = <0x2dc6c0>;
					regulator-name = "vcc_3v0";
					phandle = <0x84>;

					regulator-state-mem {
						regulator-off-in-suspend;
					};
				};

				LDO_REG8 {
					regulator-always-on;
					regulator-boot-on;
					regulator-min-microvolt = <0x1b7740>;
					regulator-max-microvolt = <0x325aa0>;
					regulator-name = "vccio_sd";
					phandle = <0x2a>;

					regulator-state-mem {
						regulator-off-in-suspend;
					};
				};

				LDO_REG9 {
					regulator-always-on;
					regulator-boot-on;
					regulator-min-microvolt = <0x325aa0>;
					regulator-max-microvolt = <0x325aa0>;
					regulator-name = "vcc_cam";
					phandle = <0x119>;

					regulator-state-mem {
						regulator-off-in-suspend;
					};
				};

				SWITCH_REG1 {
					regulator-min-microvolt = <0x4c4b40>;
					regulator-max-microvolt = <0x4c4b40>;
					regulator-name = "vcc5v0_usb2.0";
					phandle = <0xd5>;

					regulator-state-mem {
						regulator-on-in-suspend;
						regulator-suspend-microvolt = <0x4c4b40>;
					};
				};

				SWITCH_REG2 {
					regulator-always-on;
					regulator-boot-on;
					regulator-min-microvolt = <0x325aa0>;
					regulator-max-microvolt = <0x325aa0>;
					regulator-name = "lcd_3v3";
					phandle = <0x11a>;

					regulator-state-mem {
						regulator-off-in-suspend;
					};
				};
			};

			codec {
				#sound-dai-cells = <0x00>;
				compatible = "rockchip,rk809-codec\0rockchip,rk817-codec";
				clocks = <0x08 0x59>;
				clock-names = "mclk";
				pinctrl-names = "default";
				pinctrl-0 = <0x94>;
				assigned-clocks = <0x08 0x40>;
				assigned-clock-parents = <0x08 0x56>;
				hp-volume = <0x14>;
				spk-volume = <0x03>;
				status = "okay";
				phandle = <0xde>;
			};
		};

		syr827@40 {
			compatible = "silergy,syr827";
			reg = <0x40>;
			regulator-compatible = "fan53555-reg";
			pinctrl-0 = <0x95>;
			vsel-gpios = <0x1a 0x11 0x00>;
			regulator-name = "vdd_cpu_b";
			regulator-min-microvolt = <0xadf34>;
			regulator-max-microvolt = <0x16e360>;
			regulator-ramp-delay = <0x3e8>;
			fcs,suspend-voltage-selector = <0x01>;
			regulator-always-on;
			regulator-boot-on;
			vin-supply = <0x92>;
			phandle = <0x0e>;

			regulator-state-mem {
				regulator-off-in-suspend;
			};
		};

		syr828@41 {
			compatible = "silergy,syr828";
			reg = <0x41>;
			regulator-compatible = "fan53555-reg";
			pinctrl-0 = <0x96>;
			vsel-gpios = <0x1a 0x0e 0x00>;
			regulator-name = "vdd_gpu";
			regulator-min-microvolt = <0xadf34>;
			regulator-max-microvolt = <0x16e360>;
			regulator-ramp-delay = <0x3e8>;
			fcs,suspend-voltage-selector = <0x01>;
			regulator-always-on;
			regulator-boot-on;
			vin-supply = <0x92>;
			regulator-initial-mode = <0x01>;
			phandle = <0xc7>;

			regulator-state-mem {
				regulator-off-in-suspend;
			};
		};

		at24c04@50 {
			status = "okay";
			compatible = "atmel,24c04";
			reg = <0x50>;
			pagesize = <0x08>;
			phandle = <0x11b>;
		};
	};

	i2c@ff3d0000 {
		compatible = "rockchip,rk3399-i2c";
		reg = <0x00 0xff3d0000 0x00 0x1000>;
		assigned-clocks = <0x85 0x0a>;
		assigned-clock-rates = <0xbebc200>;
		clocks = <0x85 0x0a 0x85 0x1c>;
		clock-names = "i2c\0pclk";
		interrupts = <0x00 0x38 0x04 0x00>;
		pinctrl-names = "default";
		pinctrl-0 = <0x97>;
		#address-cells = <0x01>;
		#size-cells = <0x00>;
		status = "disabled";
		phandle = <0x11c>;
	};

	i2c@ff3e0000 {
		compatible = "rockchip,rk3399-i2c";
		reg = <0x00 0xff3e0000 0x00 0x1000>;
		assigned-clocks = <0x85 0x0b>;
		assigned-clock-rates = <0xbebc200>;
		clocks = <0x85 0x0b 0x85 0x1d>;
		clock-names = "i2c\0pclk";
		interrupts = <0x00 0x3a 0x04 0x00>;
		pinctrl-names = "default";
		pinctrl-0 = <0x98>;
		#address-cells = <0x01>;
		#size-cells = <0x00>;
		status = "disabled";
		phandle = <0x11d>;
	};

	pwm@ff420000 {
		compatible = "rockchip,rk3399-pwm\0rockchip,rk3288-pwm";
		reg = <0x00 0xff420000 0x00 0x10>;
		#pwm-cells = <0x03>;
		pinctrl-names = "active";
		pinctrl-0 = <0x99>;
		clocks = <0x85 0x1e>;
		clock-names = "pwm";
		status = "disabled";
		phandle = <0x11e>;
	};

	pwm@ff420010 {
		compatible = "rockchip,rk3399-pwm\0rockchip,rk3288-pwm";
		reg = <0x00 0xff420010 0x00 0x10>;
		#pwm-cells = <0x03>;
		pinctrl-names = "active";
		pinctrl-0 = <0x9a>;
		clocks = <0x85 0x1e>;
		clock-names = "pwm";
		status = "disabled";
		phandle = <0x11f>;
	};

	pwm@ff420020 {
		compatible = "rockchip,rk3399-pwm\0rockchip,rk3288-pwm";
		reg = <0x00 0xff420020 0x00 0x10>;
		#pwm-cells = <0x03>;
		pinctrl-names = "active";
		pinctrl-0 = <0x9b>;
		clocks = <0x85 0x1e>;
		clock-names = "pwm";
		status = "disabled";
		phandle = <0x120>;
	};

	pwm@ff420030 {
		compatible = "rockchip,rk3399-pwm\0rockchip,rk3288-pwm";
		reg = <0x00 0xff420030 0x00 0x10>;
		#pwm-cells = <0x03>;
		pinctrl-names = "active";
		pinctrl-0 = <0x9c>;
		clocks = <0x85 0x1e>;
		clock-names = "pwm";
		status = "okay";
		phandle = <0xd3>;
	};

	dfi@ff630000 {
		reg = <0x00 0xff630000 0x00 0x4000>;
		compatible = "rockchip,rk3399-dfi";
		rockchip,pmu = <0x9d>;
		clocks = <0x08 0x179>;
		clock-names = "pclk_ddr_mon";
		status = "disabled";
		phandle = <0x9e>;
	};

	dmc {
		compatible = "rockchip,rk3399-dmc";
		devfreq-events = <0x9e>;
		interrupts = <0x00 0x01 0x04 0x00>;
		clocks = <0x08 0xaa>;
		clock-names = "dmc_clk";
		ddr_timing = <0x9f>;
		status = "okay";
		operating-points-v2 = <0xa0>;
		center-supply = <0xa1>;
		upthreshold = <0x28>;
		downdifferential = <0x14>;
		system-status-freq = <0x01 0xa2990 0x08 0xa2990 0x02 0x50140 0x20 0xa2990 0x10 0xa2990 0x10000 0xa2990 0x2000 0xa2990 0x1000 0xa2990 0xc00 0xa2990 0x4000 0xa2990>;
		vop-bw-dmc-freq = <0x00 0x2fa 0x65900 0x2fb 0x1869f 0xa2990>;
		vop-pn-msch-readlatency = <0x00 0x20 0x04 0x20>;
		auto-min-freq = <0x50140>;
		auto-freq-en = <0x00>;
		phandle = <0xba>;
	};

	mpp-srv {
		compatible = "rockchip,mpp-service";
		rockchip,taskqueue-count = <0x02>;
		rockchip,resetgroup-count = <0x02>;
		status = "okay";
		phandle = <0xa3>;
	};

	video-codec@ff650000 {
		compatible = "rockchip,rk3399-vpu";
		reg = <0x00 0xff650000 0x00 0x800>;
		interrupts = <0x00 0x72 0x04 0x00 0x00 0x71 0x04 0x00>;
		interrupt-names = "vepu\0vdpu";
		clocks = <0x08 0xeb 0x08 0x1ea>;
		clock-names = "aclk\0hclk";
		iommus = <0xa2>;
		power-domains = <0x1c 0x1f>;
		status = "okay";
		phandle = <0x121>;
	};

	vepu@ff650000 {
		compatible = "rockchip,vpu-encoder-v2";
		reg = <0x00 0xff650000 0x00 0x400>;
		interrupts = <0x00 0x72 0x04 0x00>;
		interrupt-names = "irq_enc";
		clocks = <0x08 0xeb 0x08 0x1ea>;
		clock-names = "aclk_vcodec\0hclk_vcodec";
		resets = <0x08 0x53 0x08 0x51>;
		reset-names = "shared_video_h\0shared_video_a";
		iommus = <0xa2>;
		rockchip,srv = <0xa3>;
		rockchip,taskqueue-node = <0x00>;
		rockchip,resetgroup-node = <0x00>;
		power-domains = <0x1c 0x1f>;
		status = "okay";
		phandle = <0x122>;
	};

	vdpu@ff650400 {
		compatible = "rockchip,vpu-decoder-v2";
		reg = <0x00 0xff650400 0x00 0x400>;
		interrupts = <0x00 0x71 0x04 0x00>;
		interrupt-names = "irq_dec";
		clocks = <0x08 0xeb 0x08 0x1ea>;
		clock-names = "aclk_vcodec\0hclk_vcodec";
		resets = <0x08 0x53 0x08 0x51>;
		reset-names = "shared_video_h\0shared_video_a";
		iommus = <0xa2>;
		power-domains = <0x1c 0x1f>;
		rockchip,srv = <0xa3>;
		rockchip,taskqueue-node = <0x00>;
		rockchip,resetgroup-node = <0x00>;
		status = "okay";
		phandle = <0x123>;
	};

	iommu@ff650800 {
		compatible = "rockchip,iommu";
		reg = <0x00 0xff650800 0x00 0x40>;
		interrupts = <0x00 0x73 0x04 0x00>;
		interrupt-names = "vpu_mmu";
		clocks = <0x08 0xeb 0x08 0x1ea>;
		clock-names = "aclk\0iface";
		#iommu-cells = <0x00>;
		power-domains = <0x1c 0x1f>;
		status = "okay";
		phandle = <0xa2>;
	};

	video-codec@ff660000 {
		compatible = "rockchip,rk3399-vdec";
		reg = <0x00 0xff660000 0x00 0x400>;
		interrupts = <0x00 0x74 0x04 0x00>;
		clocks = <0x08 0xed 0x08 0x1ec 0x08 0x9f 0x08 0x9e>;
		clock-names = "axi\0ahb\0cabac\0core";
		iommus = <0xa4>;
		power-domains = <0x1c 0x20>;
		status = "disabled";
		phandle = <0x124>;
	};

	rkvdec@ff660000 {
		compatible = "rockchip,rkv-decoder-rk3399";
		reg = <0x00 0xff660000 0x00 0x400>;
		interrupts = <0x00 0x74 0x04 0x00>;
		interrupt-names = "irq_dec";
		clocks = <0x08 0xed 0x08 0x1ec 0x08 0x9f 0x08 0x9e>;
		clock-names = "aclk_vcodec\0hclk_vcodec\0clk_cabac\0clk_core";
		resets = <0x08 0x5b 0x08 0x59 0x08 0x5a 0x08 0x58 0x08 0x5d 0x08 0x5c>;
		reset-names = "video_h\0video_a\0niu_h\0niu_a\0video_cabac\0video_core";
		iommus = <0xa4>;
		rockchip,srv = <0xa3>;
		rockchip,taskqueue-node = <0x01>;
		rockchip,resetgroup-node = <0x01>;
		power-domains = <0x1c 0x20>;
		status = "okay";
		phandle = <0x125>;
	};

	iommu@ff660480 {
		compatible = "rockchip,iommu";
		reg = <0x00 0xff660480 0x00 0x40 0x00 0xff6604c0 0x00 0x40>;
		interrupts = <0x00 0x75 0x04 0x00>;
		interrupt-names = "vdec_mmu";
		clocks = <0x08 0xed 0x08 0x1ec>;
		clock-names = "aclk\0iface";
		power-domains = <0x1c 0x20>;
		#iommu-cells = <0x00>;
		status = "okay";
		phandle = <0xa4>;
	};

	iep@ff670000 {
		compatible = "rockchip,iep";
		iommu_enabled = <0x01>;
		iommus = <0xa5>;
		reg = <0x00 0xff670000 0x00 0x800>;
		interrupts = <0x00 0x2a 0x04 0x00>;
		clocks = <0x08 0xe1 0x08 0x1dd>;
		clock-names = "aclk_iep\0hclk_iep";
		power-domains = <0x1c 0x22>;
		allocator = <0x01>;
		version = <0x02>;
		status = "okay";
		phandle = <0x126>;
	};

	iommu@ff670800 {
		compatible = "rockchip,iommu";
		reg = <0x00 0xff670800 0x00 0x40>;
		interrupts = <0x00 0x2a 0x04 0x00>;
		interrupt-names = "iep_mmu";
		clocks = <0x08 0xe1 0x08 0x1dd>;
		clock-names = "aclk\0iface";
		power-domains = <0x1c 0x22>;
		#iommu-cells = <0x00>;
		status = "okay";
		phandle = <0xa5>;
	};

	rga@ff680000 {
		compatible = "rockchip,rga2";
		reg = <0x00 0xff680000 0x00 0x1000>;
		interrupts = <0x00 0x37 0x04 0x00>;
		clocks = <0x08 0xdc 0x08 0x1e5 0x08 0x6d>;
		clock-names = "aclk_rga\0hclk_rga\0clk_rga";
		resets = <0x08 0x6a 0x08 0x67 0x08 0x69>;
		reset-names = "core\0axi\0ahb";
		power-domains = <0x1c 0x21>;
		dev_mode = <0x01>;
		status = "okay";
		phandle = <0x127>;
	};

	efuse@ff690000 {
		compatible = "rockchip,rk3399-efuse";
		reg = <0x00 0xff690000 0x00 0x80>;
		#address-cells = <0x01>;
		#size-cells = <0x01>;
		clocks = <0x08 0x17d>;
		clock-names = "pclk_efuse";
		phandle = <0x128>;

		specification-serial-number@6 {
			reg = <0x06 0x01>;
			bits = <0x00 0x05>;
			phandle = <0x129>;
		};

		cpu-id@7 {
			reg = <0x07 0x10>;
			phandle = <0x12a>;
		};

		cpu-leakage@17 {
			reg = <0x17 0x01>;
			phandle = <0x12b>;
		};

		gpu-leakage@18 {
			reg = <0x18 0x01>;
			phandle = <0x12c>;
		};

		center-leakage@19 {
			reg = <0x19 0x01>;
			phandle = <0x12d>;
		};

		cpu-leakage@1a {
			reg = <0x1a 0x01>;
			phandle = <0x12e>;
		};

		logic-leakage@1b {
			reg = <0x1b 0x01>;
			phandle = <0x12f>;
		};

		wafer-info@1c {
			reg = <0x1c 0x01>;
			phandle = <0x130>;
		};

		cpu-performance@1e {
			reg = <0x1e 0x01>;
			bits = <0x03 0x03>;
			phandle = <0x131>;
		};

		gpu-performance@1e {
			reg = <0x1e 0x01>;
			bits = <0x06 0x02>;
			phandle = <0x132>;
		};

		customer-demand@22 {
			reg = <0x22 0x01>;
			bits = <0x04 0x04>;
			phandle = <0x133>;
		};
	};

	pmu-clock-controller@ff750000 {
		compatible = "rockchip,rk3399-pmucru";
		reg = <0x00 0xff750000 0x00 0x1000>;
		rockchip,grf = <0x9d>;
		#clock-cells = <0x01>;
		#reset-cells = <0x01>;
		assigned-clocks = <0x85 0x01>;
		assigned-clock-rates = <0x284af100>;
		phandle = <0x85>;
	};

	clock-controller@ff760000 {
		compatible = "rockchip,rk3399-cru";
		reg = <0x00 0xff760000 0x00 0x1000>;
		rockchip,grf = <0x1d>;
		#clock-cells = <0x01>;
		#reset-cells = <0x01>;
		assigned-clocks = <0x08 0xc0 0x08 0xc2 0x08 0x1c2 0x08 0x4c 0x08 0xf0 0x08 0xcd 0x08 0x1cd 0x08 0x9f 0x08 0x9e 0x08 0xf4 0x08 0xbe 0x08 0xc9 0x08 0x186 0x08 0xd5 0x08 0x88 0x08 0x87 0x08 0x08 0x08 0x09 0x08 0x06 0x08 0xd0 0x08 0x05 0x08 0xc0 0x08 0x1c0 0x08 0x140 0x08 0xc2 0x08 0x1c1 0x08 0x142 0x08 0x1c2 0x08 0x143 0x08 0x41 0x08 0x42 0x08 0x43 0x08 0x44 0x08 0x45 0x08 0x46 0x08 0x47 0x08 0x48 0x08 0x49 0x08 0x4a 0x08 0x4b 0x08 0xfa 0x08 0xe5 0x08 0xe6 0x08 0x6b 0x08 0x6c 0x08 0x16a 0x08 0xde 0x08 0xe3 0x08 0x1cd 0x08 0x85 0x08 0x86 0x08 0x4e 0x08 0xf0 0x08 0xcd 0x08 0xe1 0x08 0xdc 0x08 0x6d 0x08 0xed 0x08 0xeb 0x08 0x178 0x08 0xd5 0x08 0x9f 0x08 0x9e 0x08 0xf4 0x08 0xbe 0x08 0xc9 0x08 0x186 0x08 0x88 0x08 0x87 0x08 0xd9 0x08 0x1d9 0x08 0xdb 0x08 0x1db>;
		assigned-clock-rates = <0x47868c0 0x2faf080 0x2faf080 0x2faf080 0x2faf080 0x5f5e100 0x2faf080 0x8f0d180 0x8f0d180 0x8f0d180 0x2faf080 0x8f0d180 0x2faf080 0x5f5e100 0x47868c0 0x47868c0 0x30a32c00 0x30a32c00 0x23c34600 0xbebc200 0x2faf0800 0x8f0d180 0x47868c0 0x23c3460 0x11e1a300 0x5f5e100 0x2faf080 0x5f5e100 0x2faf080 0x5f5e100 0x5f5e100 0x5f5e100 0x5f5e100 0x5f5e100 0x5f5e100 0x2faf080 0x2faf080 0x2faf080 0x2faf080 0x2faf080 0xbebc200 0x17d78400 0x17d78400 0x5f5e100 0x5f5e100 0x5f5e100 0x17d78400 0x17d78400 0xbebc200 0x5f5e100 0xbebc200 0xbebc200 0x5f5e100 0x17d78400 0x17d78400 0x17d78400 0x17d78400 0x11e1a300 0x17d78400 0xbebc200 0x17d78400 0x11e1a300 0x11e1a300 0x11e1a300 0x11e1a300 0x23c34600 0x5f5e100 0x8f0d180 0x8f0d180 0x17d78400 0x5f5e100 0x17d78400 0x5f5e100>;
		phandle = <0x08>;
	};

	syscon@ff770000 {
		compatible = "rockchip,rk3399-grf\0syscon\0simple-mfd";
		reg = <0x00 0xff770000 0x00 0x10000>;
		#address-cells = <0x01>;
		#size-cells = <0x01>;
		phandle = <0x1d>;

		io-domains {
			compatible = "rockchip,rk3399-io-voltage-domain";
			status = "okay";
			bt656-supply = <0x84>;
			audio-supply = <0xa6>;
			sdmmc-supply = <0x2a>;
			gpio1830-supply = <0x84>;
			phandle = <0x134>;
		};

		mipi-dphy-rx0 {
			compatible = "rockchip,rk3399-mipi-dphy";
			clocks = <0x08 0x77 0x08 0xa5 0x08 0x16f>;
			clock-names = "dphy-ref\0dphy-cfg\0grf";
			power-domains = <0x1c 0x0f>;
			#phy-cells = <0x00>;
			status = "disabled";
			phandle = <0x135>;
		};

		usb2-phy@e450 {
			compatible = "rockchip,rk3399-usb2phy";
			reg = <0xe450 0x10>;
			clocks = <0x08 0x7b>;
			clock-names = "phyclk";
			#clock-cells = <0x00>;
			clock-output-names = "clk_usbphy0_480m";
			status = "okay";
			wakeup-source;
			phandle = <0x30>;

			host-port {
				#phy-cells = <0x00>;
				interrupts = <0x00 0x1b 0x04 0x00>;
				interrupt-names = "linestate";
				status = "okay";
				phy-supply = <0xa7>;
				phandle = <0x31>;
			};

			otg-port {
				#phy-cells = <0x00>;
				interrupts = <0x00 0x67 0x04 0x00 0x00 0x68 0x04 0x00 0x00 0x6a 0x04 0x00>;
				interrupt-names = "otg-bvalid\0otg-id\0linestate";
				status = "okay";
				phandle = <0x34>;
			};
		};

		usb2-phy@e460 {
			compatible = "rockchip,rk3399-usb2phy";
			reg = <0xe460 0x10>;
			clocks = <0x08 0x7c>;
			clock-names = "phyclk";
			#clock-cells = <0x00>;
			clock-output-names = "clk_usbphy1_480m";
			status = "okay";
			wakeup-source;
			phandle = <0x32>;

			host-port {
				#phy-cells = <0x00>;
				interrupts = <0x00 0x1f 0x04 0x00>;
				interrupt-names = "linestate";
				status = "okay";
				phy-supply = <0xa7>;
				phandle = <0x33>;
			};

			otg-port {
				#phy-cells = <0x00>;
				interrupts = <0x00 0x6c 0x04 0x00 0x00 0x6d 0x04 0x00 0x00 0x6f 0x04 0x00>;
				interrupt-names = "otg-bvalid\0otg-id\0linestate";
				status = "okay";
				phandle = <0x36>;
			};
		};

		phy@f780 {
			compatible = "rockchip,rk3399-emmc-phy";
			reg = <0xf780 0x24>;
			clocks = <0xa8>;
			clock-names = "emmcclk";
			#phy-cells = <0x00>;
			status = "okay";
			phandle = <0x2f>;
		};

		pcie-phy {
			compatible = "rockchip,rk3399-pcie-phy";
			clocks = <0x08 0x8a>;
			clock-names = "refclk";
			#phy-cells = <0x01>;
			resets = <0x08 0x87>;
			drive-impedance-ohm = <0x32>;
			reset-names = "phy";
			status = "okay";
			phandle = <0x19>;
		};

		pvtm {
			compatible = "rockchip,rk3399-pvtm";
			#address-cells = <0x01>;
			#size-cells = <0x00>;
			status = "okay";
			phandle = <0x136>;

			pvtm@0 {
				reg = <0x00>;
				clocks = <0x08 0x73>;
				clock-names = "clk";
				resets = <0x08 0x1f>;
				reset-names = "rst";
			};

			pvtm@1 {
				reg = <0x01>;
				clocks = <0x08 0x74>;
				clock-names = "clk";
				resets = <0x08 0x2f>;
				reset-names = "rst";
			};

			pvtm@2 {
				reg = <0x02>;
				clocks = <0x08 0x76>;
				clock-names = "clk";
				resets = <0x08 0x4f>;
				reset-names = "rst";
			};

			pvtm@3 {
				reg = <0x03>;
				clocks = <0x08 0x75>;
				clock-names = "clk";
				resets = <0x08 0x123>;
				reset-names = "rst";
			};
		};
	};

	phy@ff7c0000 {
		compatible = "rockchip,rk3399-typec-phy";
		reg = <0x00 0xff7c0000 0x00 0x40000>;
		clocks = <0x08 0x7e 0x08 0x7d>;
		clock-names = "tcpdcore\0tcpdphy-ref";
		assigned-clocks = <0x08 0x7e>;
		assigned-clock-rates = <0x2faf080>;
		power-domains = <0x1c 0x08>;
		resets = <0x08 0x95 0x08 0x94 0x08 0x14c>;
		reset-names = "uphy\0uphy-pipe\0uphy-tcphy";
		rockchip,grf = <0x1d>;
		status = "okay";
		extcon = <0x39>;
		phandle = <0x137>;

		dp-port {
			#phy-cells = <0x00>;
			status = "okay";
			phandle = <0x38>;
		};

		usb3-port {
			#phy-cells = <0x00>;
			phandle = <0x35>;
		};
	};

	phy@ff800000 {
		compatible = "rockchip,rk3399-typec-phy";
		reg = <0x00 0xff800000 0x00 0x40000>;
		clocks = <0x08 0x80 0x08 0x7f>;
		clock-names = "tcpdcore\0tcpdphy-ref";
		assigned-clocks = <0x08 0x80>;
		assigned-clock-rates = <0x2faf080>;
		power-domains = <0x1c 0x09>;
		resets = <0x08 0x9d 0x08 0x9c 0x08 0x14d>;
		reset-names = "uphy\0uphy-pipe\0uphy-tcphy";
		rockchip,grf = <0x1d>;
		status = "okay";
		phandle = <0x138>;

		dp-port {
			#phy-cells = <0x00>;
			phandle = <0x139>;
		};

		usb3-port {
			#phy-cells = <0x00>;
			phandle = <0x37>;
		};
	};

	watchdog@ff848000 {
		compatible = "snps,dw-wdt";
		reg = <0x00 0xff848000 0x00 0x100>;
		clocks = <0x08 0x17c>;
		interrupts = <0x00 0x78 0x04 0x00>;
	};

	rktimer@ff850000 {
		compatible = "rockchip,rk3399-timer";
		reg = <0x00 0xff850000 0x00 0x1000>;
		interrupts = <0x00 0x51 0x04 0x00>;
		clocks = <0x08 0x168 0x08 0x5a>;
		clock-names = "pclk\0timer";
		phandle = <0x13a>;
	};

	spdif@ff870000 {
		compatible = "rockchip,rk3399-spdif";
		reg = <0x00 0xff870000 0x00 0x1000>;
		interrupts = <0x00 0x42 0x04 0x00>;
		dmas = <0x5f 0x07>;
		dma-names = "tx";
		clock-names = "mclk\0hclk";
		clocks = <0x08 0x55 0x08 0x1d7>;
		pinctrl-names = "default";
		pinctrl-0 = <0xa9>;
		power-domains = <0x1c 0x1c>;
		#sound-dai-cells = <0x00>;
		status = "okay";
		assigned-clocks = <0x08 0xb1>;
		assigned-clock-parents = <0x08 0x05>;
		phandle = <0xd8>;
	};

	i2s@ff880000 {
		compatible = "rockchip,rk3399-i2s\0rockchip,rk3066-i2s";
		reg = <0x00 0xff880000 0x00 0x1000>;
		rockchip,grf = <0x1d>;
		interrupts = <0x00 0x27 0x04 0x00>;
		dmas = <0x5f 0x00 0x5f 0x01>;
		dma-names = "tx\0rx";
		clock-names = "i2s_clk\0i2s_hclk";
		clocks = <0x08 0x56 0x08 0x1d4>;
		resets = <0x08 0xe0 0x08 0xc2>;
		reset-names = "reset-m\0reset-h";
		pinctrl-names = "default";
		pinctrl-0 = <0xaa>;
		power-domains = <0x1c 0x1c>;
		#sound-dai-cells = <0x00>;
		status = "okay";
		assigned-clocks = <0x08 0xae>;
		assigned-clock-parents = <0x08 0x05>;
		phandle = <0xdd>;
	};

	i2s@ff890000 {
		compatible = "rockchip,rk3399-i2s\0rockchip,rk3066-i2s";
		reg = <0x00 0xff890000 0x00 0x1000>;
		interrupts = <0x00 0x28 0x04 0x00>;
		dmas = <0x5f 0x02 0x5f 0x03>;
		dma-names = "tx\0rx";
		clock-names = "i2s_clk\0i2s_hclk";
		clocks = <0x08 0x57 0x08 0x1d5>;
		resets = <0x08 0xe1 0x08 0xc3>;
		reset-names = "reset-m\0reset-h";
		pinctrl-names = "default";
		pinctrl-0 = <0xab>;
		power-domains = <0x1c 0x1c>;
		#sound-dai-cells = <0x00>;
		status = "okay";
		assigned-clocks = <0x08 0xaf>;
		assigned-clock-parents = <0x08 0x05>;
		phandle = <0x13b>;
	};

	i2s@ff8a0000 {
		compatible = "rockchip,rk3399-i2s\0rockchip,rk3066-i2s";
		reg = <0x00 0xff8a0000 0x00 0x1000>;
		interrupts = <0x00 0x29 0x04 0x00>;
		dmas = <0x5f 0x04>;
		dma-names = "tx";
		clock-names = "i2s_clk\0i2s_hclk";
		clocks = <0x08 0x58 0x08 0x1d6>;
		resets = <0x08 0xe2 0x08 0xc4>;
		reset-names = "reset-m\0reset-h";
		power-domains = <0x1c 0x1c>;
		#sound-dai-cells = <0x00>;
		status = "okay";
		assigned-clocks = <0x08 0xb0>;
		assigned-clock-parents = <0x08 0x05>;
		phandle = <0xbd>;
	};

	rng@ff8b8000 {
		compatible = "rockchip,cryptov1-rng";
		reg = <0x00 0xff8b8000 0x00 0x1000>;
		clocks = <0x08 0x86 0x08 0x1d3>;
		clock-names = "clk_crypto\0hclk_crypto";
		assigned-clocks = <0x08 0x86 0x08 0x1d3>;
		assigned-clock-rates = <0x8f0d180 0x5f5e100>;
		status = "disabled";
		phandle = <0x13c>;
	};

	vop@ff8f0000 {
		compatible = "rockchip,rk3399-vop-lit";
		reg = <0x00 0xff8f0000 0x00 0x600 0x00 0xff8f1c00 0x00 0x200 0x00 0xff8f2000 0x00 0x400>;
		reg-names = "regs\0cabc_lut\0gamma_lut";
		interrupts = <0x00 0x77 0x04 0x00>;
		clocks = <0x08 0xdb 0x08 0xb5 0x08 0x1db 0x08 0xb7>;
		clock-names = "aclk_vop\0dclk_vop\0hclk_vop\0dclk_source";
		iommus = <0xac>;
		power-domains = <0x1c 0x12>;
		resets = <0x08 0x113 0x08 0x117 0x08 0x119>;
		reset-names = "axi\0ahb\0dclk";
		status = "okay";
		assigned-clocks = <0x08 0xb7>;
		assigned-clock-parents = <0x08 0x04>;
		phandle = <0x13d>;

		port {
			#address-cells = <0x01>;
			#size-cells = <0x00>;
			phandle = <0x10>;

			endpoint@0 {
				reg = <0x00>;
				remote-endpoint = <0xad>;
				phandle = <0x13>;
			};

			endpoint@1 {
				reg = <0x01>;
				remote-endpoint = <0xae>;
				phandle = <0x14>;
			};

			endpoint@2 {
				reg = <0x02>;
				remote-endpoint = <0xaf>;
				phandle = <0xc1>;
			};

			endpoint@3 {
				reg = <0x03>;
				remote-endpoint = <0xb0>;
				phandle = <0xc4>;
			};

			endpoint@4 {
				reg = <0x04>;
				remote-endpoint = <0xb1>;
				phandle = <0x3b>;
			};
		};
	};

	voppwm@ff8f01a0 {
		compatible = "rockchip,vop-pwm";
		reg = <0x00 0xff8f01a0 0x00 0x10>;
		#pwm-cells = <0x03>;
		pinctrl-names = "active";
		pinctrl-0 = <0xb2>;
		clocks = <0x08 0x6c>;
		clock-names = "pwm";
		status = "disabled";
		phandle = <0x13e>;
	};

	iommu@ff8f3f00 {
		compatible = "rockchip,iommu";
		reg = <0x00 0xff8f3f00 0x00 0x100>;
		interrupts = <0x00 0x77 0x04 0x00>;
		interrupt-names = "vopl_mmu";
		clocks = <0x08 0xdb 0x08 0x1db>;
		clock-names = "aclk\0iface";
		power-domains = <0x1c 0x12>;
		#iommu-cells = <0x00>;
		rockchip,disable-device-link-resume;
		status = "okay";
		phandle = <0xac>;
	};

	vop@ff900000 {
		compatible = "rockchip,rk3399-vop-big";
		reg = <0x00 0xff900000 0x00 0x600 0x00 0xff901c00 0x00 0x200 0x00 0xff902000 0x00 0x1000>;
		reg-names = "regs\0cabc_lut\0gamma_lut";
		interrupts = <0x00 0x76 0x04 0x00>;
		clocks = <0x08 0xd9 0x08 0xb4 0x08 0x1d9 0x08 0xb6>;
		clock-names = "aclk_vop\0dclk_vop\0hclk_vop\0dclk_source";
		iommus = <0xb3>;
		power-domains = <0x1c 0x11>;
		resets = <0x08 0x112 0x08 0x116 0x08 0x118>;
		reset-names = "axi\0ahb\0dclk";
		status = "okay";
		assigned-clocks = <0x08 0xb6>;
		assigned-clock-parents = <0x08 0x07>;
		phandle = <0x13f>;

		port {
			#address-cells = <0x01>;
			#size-cells = <0x00>;
			phandle = <0x0f>;

			endpoint@0 {
				reg = <0x00>;
				remote-endpoint = <0xb4>;
				phandle = <0xc5>;
			};

			endpoint@1 {
				reg = <0x01>;
				remote-endpoint = <0xb5>;
				phandle = <0xc2>;
			};

			endpoint@2 {
				reg = <0x02>;
				remote-endpoint = <0xb6>;
				phandle = <0x12>;
			};

			endpoint@3 {
				reg = <0x03>;
				remote-endpoint = <0xb7>;
				phandle = <0xc3>;
			};

			endpoint@4 {
				reg = <0x04>;
				remote-endpoint = <0xb8>;
				phandle = <0x3a>;
			};
		};
	};

	voppwm@ff9001a0 {
		compatible = "rockchip,vop-pwm";
		reg = <0x00 0xff9001a0 0x00 0x10>;
		#pwm-cells = <0x03>;
		pinctrl-names = "active";
		pinctrl-0 = <0xb9>;
		clocks = <0x08 0x6b>;
		clock-names = "pwm";
		status = "disabled";
		phandle = <0x140>;
	};

	iommu@ff903f00 {
		compatible = "rockchip,iommu";
		reg = <0x00 0xff903f00 0x00 0x100>;
		interrupts = <0x00 0x76 0x04 0x00>;
		interrupt-names = "vopb_mmu";
		clocks = <0x08 0xd9 0x08 0x1d9>;
		clock-names = "aclk\0iface";
		power-domains = <0x1c 0x11>;
		#iommu-cells = <0x00>;
		rockchip,disable-device-link-resume;
		status = "okay";
		phandle = <0xb3>;
	};

	rkisp1@ff910000 {
		compatible = "rockchip,rk3399-rkisp1";
		reg = <0x00 0xff910000 0x00 0x4000>;
		interrupts = <0x00 0x2b 0x04 0x00>;
		interrupt-names = "isp_irq";
		clocks = <0x08 0x6e 0x08 0xe5 0x08 0x1df 0x08 0xe9 0x08 0x1e3>;
		clock-names = "clk_isp\0aclk_isp\0hclk_isp\0aclk_isp_wrap\0hclk_isp_wrap";
		devfreq = <0xba>;
		power-domains = <0x1c 0x13>;
		iommus = <0xbb>;
		status = "disabled";
		phandle = <0x141>;
	};

	iommu@ff914000 {
		compatible = "rockchip,iommu";
		reg = <0x00 0xff914000 0x00 0x100 0x00 0xff915000 0x00 0x100>;
		interrupts = <0x00 0x2b 0x04 0x00>;
		interrupt-names = "isp0_mmu";
		clocks = <0x08 0xe9 0x08 0x1e3>;
		clock-names = "aclk\0iface";
		#iommu-cells = <0x00>;
		power-domains = <0x1c 0x13>;
		rockchip,disable-mmu-reset;
		status = "okay";
		phandle = <0xbb>;
	};

	rkisp1@ff920000 {
		compatible = "rockchip,rk3399-rkisp1";
		reg = <0x00 0xff920000 0x00 0x4000>;
		interrupts = <0x00 0x2c 0x04 0x00>;
		interrupt-names = "isp_irq";
		clocks = <0x08 0x6f 0x08 0xe6 0x08 0x1e0 0x08 0xea 0x08 0x1e4 0x08 0x17b>;
		clock-names = "clk_isp\0aclk_isp\0hclk_isp\0aclk_isp_wrap\0hclk_isp_wrap\0pclk_isp_wrap";
		devfreq = <0xba>;
		power-domains = <0x1c 0x14>;
		iommus = <0xbc>;
		status = "disabled";
		phandle = <0x142>;
	};

	iommu@ff924000 {
		compatible = "rockchip,iommu";
		reg = <0x00 0xff924000 0x00 0x100 0x00 0xff925000 0x00 0x100>;
		interrupts = <0x00 0x2c 0x04 0x00>;
		interrupt-names = "isp1_mmu";
		clocks = <0x08 0xea 0x08 0x1e4>;
		clock-names = "aclk\0iface";
		#iommu-cells = <0x00>;
		power-domains = <0x1c 0x14>;
		rockchip,disable-mmu-reset;
		status = "okay";
		phandle = <0xbc>;
	};

	hdmi-sound {
		compatible = "rockchip,hdmi";
		simple-audio-card,format = "i2s";
		simple-audio-card,mclk-fs = <0x100>;
		simple-audio-card,name = "hdmi-sound";
		status = "okay";
		rockchip,mclk-fs = <0x100>;
		rockchip,card-name = "rockchip-hdmi0";
		rockchip,cpu = <0xbd>;
		rockchip,codec = <0xbe>;
		rockchip,jack-det;
		phandle = <0x143>;

		simple-audio-card,cpu {
			sound-dai = <0xbd>;
		};

		simple-audio-card,codec {
			sound-dai = <0xbe>;
		};
	};

	hdmi@ff940000 {
		compatible = "rockchip,rk3399-dw-hdmi";
		reg = <0x00 0xff940000 0x00 0x20000>;
		interrupts = <0x00 0x17 0x04 0x00>;
		clocks = <0x08 0x174 0x08 0x71 0x08 0x70 0x08 0x16f 0x08 0x07>;
		clock-names = "iahb\0isfr\0cec\0grf\0vpll";
		power-domains = <0x1c 0x15>;
		reg-io-width = <0x04>;
		rockchip,grf = <0x1d>;
		#sound-dai-cells = <0x00>;
		pinctrl-names = "default";
		pinctrl-0 = <0xbf 0xc0>;
		status = "okay";
		#address-cells = <0x01>;
		#size-cells = <0x00>;
		phandle = <0xbe>;

		ports {

			port {
				#address-cells = <0x01>;
				#size-cells = <0x00>;
				phandle = <0x144>;

				endpoint@0 {
					reg = <0x00>;
					remote-endpoint = <0x12>;
					status = "okay";
					phandle = <0xb6>;
				};

				endpoint@1 {
					reg = <0x01>;
					remote-endpoint = <0xc1>;
					status = "disabled";
					phandle = <0xaf>;
				};
			};
		};
	};

	dsi@ff960000 {
		compatible = "rockchip,rk3399-mipi-dsi\0snps,dw-mipi-dsi";
		reg = <0x00 0xff960000 0x00 0x8000>;
		interrupts = <0x00 0x2d 0x04 0x00>;
		clocks = <0x08 0xa2 0x08 0x170 0x08 0xa3 0x08 0x16f>;
		clock-names = "ref\0pclk\0phy_cfg\0grf";
		power-domains = <0x1c 0x0f>;
		resets = <0x08 0xfb>;
		reset-names = "apb";
		rockchip,grf = <0x1d>;
		#address-cells = <0x01>;
		#size-cells = <0x00>;
		status = "disabled";
		phandle = <0x145>;

		ports {
			#address-cells = <0x01>;
			#size-cells = <0x00>;

			port@0 {
				reg = <0x00>;
				#address-cells = <0x01>;
				#size-cells = <0x00>;

				endpoint@0 {
					reg = <0x00>;
					remote-endpoint = <0xc2>;
					phandle = <0xb5>;
				};

				endpoint@1 {
					reg = <0x01>;
					remote-endpoint = <0x13>;
					phandle = <0xad>;
				};
			};
		};
	};

	dsi@ff968000 {
		compatible = "rockchip,rk3399-mipi-dsi\0snps,dw-mipi-dsi";
		reg = <0x00 0xff968000 0x00 0x8000>;
		interrupts = <0x00 0x2e 0x04 0x00>;
		clocks = <0x08 0xa2 0x08 0x171 0x08 0xa4 0x08 0x16f>;
		clock-names = "ref\0pclk\0phy_cfg\0grf";
		power-domains = <0x1c 0x0f>;
		resets = <0x08 0xfc>;
		reset-names = "apb";
		rockchip,grf = <0x1d>;
		#address-cells = <0x01>;
		#size-cells = <0x00>;
		status = "disabled";
		phandle = <0x146>;

		ports {
			#address-cells = <0x01>;
			#size-cells = <0x00>;

			port@0 {
				reg = <0x00>;
				#address-cells = <0x01>;
				#size-cells = <0x00>;

				endpoint@0 {
					reg = <0x00>;
					remote-endpoint = <0xc3>;
					phandle = <0xb7>;
				};

				endpoint@1 {
					reg = <0x01>;
					remote-endpoint = <0xc4>;
					phandle = <0xb0>;
				};
			};
		};
	};

	mipi-dphy-tx1rx1@ff968000 {
		compatible = "rockchip,rk3399-mipi-dphy";
		reg = <0x00 0xff968000 0x00 0x8000>;
		clocks = <0x08 0x77 0x08 0xa4 0x08 0x16f 0x08 0x171>;
		clock-names = "dphy-ref\0dphy-cfg\0grf\0pclk_mipi_dsi";
		rockchip,grf = <0x1d>;
		power-domains = <0x1c 0x0f>;
		status = "disabled";
		phandle = <0x147>;
	};

	edp@ff970000 {
		compatible = "rockchip,rk3399-edp";
		reg = <0x00 0xff970000 0x00 0x8000>;
		interrupts = <0x00 0x0a 0x04 0x00>;
		clocks = <0x08 0x16a 0x08 0x16c 0x08 0x16f>;
		clock-names = "dp\0pclk\0grf";
		power-domains = <0x1c 0x19>;
		resets = <0x08 0x11d>;
		reset-names = "dp";
		rockchip,grf = <0x1d>;
		status = "disabled";
		phandle = <0x148>;

		ports {
			#address-cells = <0x01>;
			#size-cells = <0x00>;

			port@0 {
				reg = <0x00>;
				#address-cells = <0x01>;
				#size-cells = <0x00>;
				phandle = <0x149>;

				endpoint@0 {
					reg = <0x00>;
					remote-endpoint = <0xc5>;
					phandle = <0xb4>;
				};

				endpoint@1 {
					reg = <0x01>;
					remote-endpoint = <0x14>;
					phandle = <0xae>;
				};
			};
		};
	};

	gpu@ff9a0000 {
		compatible = "arm,malit860\0arm,malit86x\0arm,malit8xx\0arm,mali-midgard\0rockchip,rk3399-mali\0arm,mali-t860";
		reg = <0x00 0xff9a0000 0x00 0x10000>;
		interrupts = <0x00 0x14 0x04 0x00 0x00 0x15 0x04 0x00 0x00 0x13 0x04 0x00>;
		interrupt-names = "job\0mmu\0gpu";
		clocks = <0x08 0xd0>;
		clock-names = "clk_mali";
		#cooling-cells = <0x02>;
		power-domains = <0x1c 0x23>;
		power-off-delay-ms = <0xc8>;
		upthreshold = <0x28>;
		downdifferential = <0x0a>;
		status = "okay";
		operating-points-v2 = <0xc6>;
		mali-supply = <0xc7>;
		phandle = <0x66>;

		power_model {
			compatible = "arm,mali-simple-power-model";
			static-coefficient = <0x64578>;
			dynamic-coefficient = <0x2dd>;
			ts = <0x7d00 0x125c 0xffffffb0 0x02>;
			thermal-zone = "gpu-thermal";
			phandle = <0x14a>;
		};
	};

	nocp-cci-msch0@ffa86000 {
		compatible = "rockchip,rk3399-nocp";
		reg = <0x00 0xffa86000 0x00 0x400>;
		phandle = <0x14b>;
	};

	nocp-gpu-msch0@ffa86400 {
		compatible = "rockchip,rk3399-nocp";
		reg = <0x00 0xffa86400 0x00 0x400>;
		phandle = <0x14c>;
	};

	nocp-hp-msch0@ffa86800 {
		compatible = "rockchip,rk3399-nocp";
		reg = <0x00 0xffa86800 0x00 0x400>;
		phandle = <0x14d>;
	};

	nocp-lp-msch0@ffa86c00 {
		compatible = "rockchip,rk3399-nocp";
		reg = <0x00 0xffa86c00 0x00 0x400>;
		phandle = <0x14e>;
	};

	nocp-video-msch0@ffa87000 {
		compatible = "rockchip,rk3399-nocp";
		reg = <0x00 0xffa87000 0x00 0x400>;
		phandle = <0x14f>;
	};

	nocp-vio0-msch0@ffa87400 {
		compatible = "rockchip,rk3399-nocp";
		reg = <0x00 0xffa87400 0x00 0x400>;
		phandle = <0x150>;
	};

	nocp-vio1-msch0@ffa87800 {
		compatible = "rockchip,rk3399-nocp";
		reg = <0x00 0xffa87800 0x00 0x400>;
		phandle = <0x151>;
	};

	nocp-cci-msch1@ffa8e000 {
		compatible = "rockchip,rk3399-nocp";
		reg = <0x00 0xffa8e000 0x00 0x400>;
		phandle = <0x152>;
	};

	nocp-gpu-msch1@ffa8e400 {
		compatible = "rockchip,rk3399-nocp";
		reg = <0x00 0xffa8e400 0x00 0x400>;
		phandle = <0x153>;
	};

	nocp-hp-msch1@ffa8e800 {
		compatible = "rockchip,rk3399-nocp";
		reg = <0x00 0xffa8e800 0x00 0x400>;
		phandle = <0x154>;
	};

	nocp-lp-msch1@ffa8ec00 {
		compatible = "rockchip,rk3399-nocp";
		reg = <0x00 0xffa8ec00 0x00 0x400>;
		phandle = <0x155>;
	};

	nocp-video-msch1@ffa8f000 {
		compatible = "rockchip,rk3399-nocp";
		reg = <0x00 0xffa8f000 0x00 0x400>;
		phandle = <0x156>;
	};

	nocp-vio0-msch1@ffa8f400 {
		compatible = "rockchip,rk3399-nocp";
		reg = <0x00 0xffa8f400 0x00 0x400>;
		phandle = <0x157>;
	};

	nocp-vio1-msch1@ffa8f800 {
		compatible = "rockchip,rk3399-nocp";
		reg = <0x00 0xffa8f800 0x00 0x400>;
		phandle = <0x158>;
	};

	rockchip-system-monitor {
		compatible = "rockchip,system-monitor";
		rockchip,thermal-zone = "soc-thermal";
		rockchip,polling-delay = <0xc8>;
		phandle = <0x159>;
	};

	pinctrl {
		compatible = "rockchip,rk3399-pinctrl";
		rockchip,grf = <0x1d>;
		rockchip,pmu = <0x9d>;
		#address-cells = <0x02>;
		#size-cells = <0x02>;
		ranges;
		phandle = <0x15a>;

		gpio0@ff720000 {
			compatible = "rockchip,gpio-bank";
			reg = <0x00 0xff720000 0x00 0x100>;
			clocks = <0x85 0x17>;
			interrupts = <0x00 0x0e 0x04 0x00>;
			gpio-controller;
			#gpio-cells = <0x02>;
			interrupt-controller;
			#interrupt-cells = <0x02>;
			phandle = <0x27>;
		};

		gpio1@ff730000 {
			compatible = "rockchip,gpio-bank";
			reg = <0x00 0xff730000 0x00 0x100>;
			clocks = <0x85 0x18>;
			interrupts = <0x00 0x0f 0x04 0x00>;
			gpio-controller;
			#gpio-cells = <0x02>;
			interrupt-controller;
			#interrupt-cells = <0x02>;
			phandle = <0x1a>;
		};

		gpio2@ff780000 {
			compatible = "rockchip,gpio-bank";
			reg = <0x00 0xff780000 0x00 0x100>;
			clocks = <0x08 0x150>;
			interrupts = <0x00 0x10 0x04 0x00>;
			gpio-controller;
			#gpio-cells = <0x02>;
			interrupt-controller;
			#interrupt-cells = <0x02>;
			phandle = <0x47>;
		};

		gpio3@ff788000 {
			compatible = "rockchip,gpio-bank";
			reg = <0x00 0xff788000 0x00 0x100>;
			clocks = <0x08 0x151>;
			interrupts = <0x00 0x11 0x04 0x00>;
			gpio-controller;
			#gpio-cells = <0x02>;
			interrupt-controller;
			#interrupt-cells = <0x02>;
			phandle = <0x1f>;
		};

		gpio4@ff790000 {
			compatible = "rockchip,gpio-bank";
			reg = <0x00 0xff790000 0x00 0x100>;
			clocks = <0x08 0x152>;
			interrupts = <0x00 0x12 0x04 0x00>;
			gpio-controller;
			#gpio-cells = <0x02>;
			interrupt-controller;
			#interrupt-cells = <0x02>;
			phandle = <0xda>;
		};

		pcfg-pull-up {
			bias-pull-up;
			phandle = <0xcc>;
		};

		pcfg-pull-down {
			bias-pull-down;
			phandle = <0xd1>;
		};

		pcfg-pull-none {
			bias-disable;
			phandle = <0xc8>;
		};

		pcfg-pull-none-12ma {
			bias-disable;
			drive-strength = <0x0c>;
			phandle = <0xcb>;
		};

		pcfg-pull-none-13ma {
			bias-disable;
			drive-strength = <0x0d>;
			phandle = <0xc9>;
		};

		pcfg-pull-none-18ma {
			bias-disable;
			drive-strength = <0x12>;
			phandle = <0xd0>;
		};

		pcfg-pull-none-20ma {
			bias-disable;
			drive-strength = <0x14>;
			phandle = <0xce>;
		};

		pcfg-pull-up-2ma {
			bias-pull-up;
			drive-strength = <0x02>;
			phandle = <0x15b>;
		};

		pcfg-pull-up-8ma {
			bias-pull-up;
			drive-strength = <0x08>;
			phandle = <0xcf>;
		};

		pcfg-pull-up-18ma {
			bias-pull-up;
			drive-strength = <0x12>;
			phandle = <0x15c>;
		};

		pcfg-pull-up-20ma {
			bias-pull-up;
			drive-strength = <0x14>;
			phandle = <0xcd>;
		};

		pcfg-pull-down-4ma {
			bias-pull-down;
			drive-strength = <0x04>;
			phandle = <0x15d>;
		};

		pcfg-pull-down-8ma {
			bias-pull-down;
			drive-strength = <0x08>;
			phandle = <0x15e>;
		};

		pcfg-pull-down-12ma {
			bias-pull-down;
			drive-strength = <0x0c>;
			phandle = <0x15f>;
		};

		pcfg-pull-down-18ma {
			bias-pull-down;
			drive-strength = <0x12>;
			phandle = <0x160>;
		};

		pcfg-pull-down-20ma {
			bias-pull-down;
			drive-strength = <0x14>;
			phandle = <0x161>;
		};

		pcfg-output-high {
			output-high;
			phandle = <0x162>;
		};

		pcfg-output-low {
			output-low;
			phandle = <0xca>;
		};

		clock {

			clk-32k {
				rockchip,pins = <0x00 0x00 0x02 0xc8>;
				phandle = <0x163>;
			};
		};

		edp {

			edp-hpd {
				rockchip,pins = <0x04 0x17 0x02 0xc8>;
				phandle = <0x164>;
			};
		};

		gmac {

			rgmii-pins {
				rockchip,pins = <0x03 0x11 0x01 0xc9 0x03 0x0e 0x01 0xc8 0x03 0x0d 0x01 0xc8 0x03 0x0c 0x01 0xc9 0x03 0x0b 0x01 0xc8 0x03 0x09 0x01 0xc8 0x03 0x08 0x01 0xc8 0x03 0x07 0x01 0xc8 0x03 0x06 0x01 0xc8 0x03 0x05 0x01 0xc9 0x03 0x04 0x01 0xc9 0x03 0x03 0x01 0xc8 0x03 0x02 0x01 0xc8 0x03 0x01 0x01 0xc9 0x03 0x00 0x01 0xc9>;
				phandle = <0x21>;
			};

			rmii-pins {
				rockchip,pins = <0x03 0x0d 0x01 0xc8 0x03 0x0c 0x01 0xc9 0x03 0x0b 0x01 0xc8 0x03 0x0a 0x01 0xc8 0x03 0x09 0x01 0xc8 0x03 0x08 0x01 0xc8 0x03 0x07 0x01 0xc8 0x03 0x06 0x01 0xc8 0x03 0x05 0x01 0xc9 0x03 0x04 0x01 0xc9>;
				phandle = <0x165>;
			};

			rgmii-sleep-pins {
				rockchip,pins = <0x03 0x0f 0x00 0xca>;
				phandle = <0x22>;
			};
		};

		i2c0 {

			i2c0-xfer {
				rockchip,pins = <0x01 0x0f 0x02 0xc8 0x01 0x10 0x02 0xc8>;
				phandle = <0x8b>;
			};
		};

		i2c1 {

			i2c1-xfer {
				rockchip,pins = <0x04 0x02 0x01 0xc8 0x04 0x01 0x01 0xc8>;
				phandle = <0x3d>;
			};
		};

		i2c2 {

			i2c2-xfer {
				rockchip,pins = <0x02 0x01 0x02 0xcb 0x02 0x00 0x02 0xcb>;
				phandle = <0x3e>;
			};
		};

		i2c3 {

			i2c3-xfer {
				rockchip,pins = <0x04 0x11 0x01 0xc8 0x04 0x10 0x01 0xc8>;
				phandle = <0x3f>;
			};

			i2c3_gpio {
				rockchip,pins = <0x04 0x11 0x00 0xc8 0x04 0x10 0x00 0xc8>;
				phandle = <0x166>;
			};
		};

		i2c4 {

			i2c4-xfer {
				rockchip,pins = <0x01 0x0c 0x01 0xc8 0x01 0x0b 0x01 0xc8>;
				phandle = <0x97>;
			};
		};

		i2c5 {

			i2c5-xfer {
				rockchip,pins = <0x03 0x0b 0x02 0xc8 0x03 0x0a 0x02 0xc8>;
				phandle = <0x40>;
			};
		};

		i2c6 {

			i2c6-xfer {
				rockchip,pins = <0x02 0x0a 0x02 0xc8 0x02 0x09 0x02 0xc8>;
				phandle = <0x41>;
			};
		};

		i2c7 {

			i2c7-xfer {
				rockchip,pins = <0x02 0x08 0x02 0xc8 0x02 0x07 0x02 0xc8>;
				phandle = <0x42>;
			};
		};

		i2c8 {

			i2c8-xfer {
				rockchip,pins = <0x01 0x15 0x01 0xc8 0x01 0x14 0x01 0xc8>;
				phandle = <0x98>;
			};
		};

		i2s0 {

			i2s0-2ch-bus {
				rockchip,pins = <0x03 0x18 0x01 0xc8 0x03 0x19 0x01 0xc8 0x03 0x1a 0x01 0xc8 0x03 0x1b 0x01 0xc8 0x03 0x1f 0x01 0xc8 0x04 0x00 0x01 0xc8>;
				phandle = <0x167>;
			};

			i2s0-8ch-bus {
				rockchip,pins = <0x03 0x18 0x01 0xc8 0x03 0x1a 0x01 0xc8 0x03 0x1b 0x01 0xc8 0x03 0x1f 0x01 0xc8>;
				phandle = <0xaa>;
			};

			i2s-8ch-mclk {
				rockchip,pins = <0x04 0x00 0x01 0xc8>;
				phandle = <0x94>;
			};
		};

		i2s1 {

			i2s1-2ch-bus {
				rockchip,pins = <0x04 0x03 0x01 0xc8 0x04 0x04 0x01 0xc8 0x04 0x05 0x01 0xc8 0x04 0x06 0x01 0xc8 0x04 0x07 0x01 0xc8>;
				phandle = <0xab>;
			};
		};

		sdio0 {

			sdio0-bus1 {
				rockchip,pins = <0x02 0x14 0x01 0xcc>;
				phandle = <0x168>;
			};

			sdio0-bus4 {
				rockchip,pins = <0x02 0x14 0x01 0xcd 0x02 0x15 0x01 0xcd 0x02 0x16 0x01 0xcd 0x02 0x17 0x01 0xcd>;
				phandle = <0x24>;
			};

			sdio0-cmd {
				rockchip,pins = <0x02 0x18 0x01 0xcd>;
				phandle = <0x25>;
			};

			sdio0-clk {
				rockchip,pins = <0x02 0x19 0x01 0xce>;
				phandle = <0x26>;
			};

			sdio0-cd {
				rockchip,pins = <0x02 0x1a 0x01 0xcc>;
				phandle = <0x169>;
			};

			sdio0-pwr {
				rockchip,pins = <0x02 0x1b 0x01 0xcc>;
				phandle = <0x16a>;
			};

			sdio0-bkpwr {
				rockchip,pins = <0x02 0x1c 0x01 0xcc>;
				phandle = <0x16b>;
			};

			sdio0-wp {
				rockchip,pins = <0x00 0x03 0x01 0xcc>;
				phandle = <0x16c>;
			};

			sdio0-int {
				rockchip,pins = <0x00 0x04 0x01 0xcc>;
				phandle = <0x16d>;
			};
		};

		sdmmc {

			sdmmc-bus1 {
				rockchip,pins = <0x04 0x08 0x01 0xcf>;
				phandle = <0x16e>;
			};

			sdmmc-bus4 {
				rockchip,pins = <0x04 0x08 0x01 0xcf 0x04 0x09 0x01 0xcf 0x04 0x0a 0x01 0xcf 0x04 0x0b 0x01 0xcf>;
				phandle = <0x2e>;
			};

			sdmmc-clk {
				rockchip,pins = <0x04 0x0c 0x01 0xd0>;
				phandle = <0x2b>;
			};

			sdmmc-cmd {
				rockchip,pins = <0x04 0x0d 0x01 0xcf>;
				phandle = <0x2c>;
			};

			sdmmc-cd {
				rockchip,pins = <0x00 0x07 0x01 0xcc>;
				phandle = <0x2d>;
			};

			sdmmc-wp {
				rockchip,pins = <0x00 0x08 0x01 0xcc>;
				phandle = <0x16f>;
			};
		};

		suspend {

			ap-pwroff {
				rockchip,pins = <0x01 0x05 0x01 0xc8>;
				phandle = <0x170>;
			};

			ddrio-pwroff {
				rockchip,pins = <0x00 0x01 0x01 0xc8>;
				phandle = <0x171>;
			};
		};

		spdif {

			spdif-bus {
				rockchip,pins = <0x04 0x15 0x01 0xc8>;
				phandle = <0xa9>;
			};

			spdif-bus-1 {
				rockchip,pins = <0x03 0x10 0x03 0xc8>;
				phandle = <0x172>;
			};
		};

		spi0 {

			spi0-clk {
				rockchip,pins = <0x03 0x06 0x02 0xcc>;
				phandle = <0x4f>;
			};

			spi0-cs0 {
				rockchip,pins = <0x03 0x07 0x02 0xcc>;
				phandle = <0x52>;
			};

			spi0-cs1 {
				rockchip,pins = <0x03 0x08 0x02 0xcc>;
				phandle = <0x173>;
			};

			spi0-tx {
				rockchip,pins = <0x03 0x05 0x02 0xcc>;
				phandle = <0x50>;
			};

			spi0-rx {
				rockchip,pins = <0x03 0x04 0x02 0xcc>;
				phandle = <0x51>;
			};
		};

		spi1 {

			spi1-clk {
				rockchip,pins = <0x01 0x09 0x02 0xcc>;
				phandle = <0x53>;
			};

			spi1-cs0 {
				rockchip,pins = <0x01 0x0a 0x02 0xcc>;
				phandle = <0x56>;
			};

			spi1-rx {
				rockchip,pins = <0x01 0x07 0x02 0xcc>;
				phandle = <0x55>;
			};

			spi1-tx {
				rockchip,pins = <0x01 0x08 0x02 0xcc>;
				phandle = <0x54>;
			};
		};

		spi2 {

			spi2-clk {
				rockchip,pins = <0x02 0x0b 0x01 0xcc>;
				phandle = <0x57>;
			};

			spi2-cs0 {
				rockchip,pins = <0x02 0x0c 0x01 0xcc>;
				phandle = <0x5a>;
			};

			spi2-rx {
				rockchip,pins = <0x02 0x09 0x01 0xcc>;
				phandle = <0x59>;
			};

			spi2-tx {
				rockchip,pins = <0x02 0x0a 0x01 0xcc>;
				phandle = <0x58>;
			};
		};

		spi3 {

			spi3-clk {
				rockchip,pins = <0x01 0x11 0x01 0xcc>;
				phandle = <0x86>;
			};

			spi3-cs0 {
				rockchip,pins = <0x01 0x12 0x01 0xcc>;
				phandle = <0x89>;
			};

			spi3-rx {
				rockchip,pins = <0x01 0x0f 0x01 0xcc>;
				phandle = <0x88>;
			};

			spi3-tx {
				rockchip,pins = <0x01 0x10 0x01 0xcc>;
				phandle = <0x87>;
			};
		};

		spi4 {

			spi4-clk {
				rockchip,pins = <0x03 0x02 0x02 0xcc>;
				phandle = <0x5b>;
			};

			spi4-cs0 {
				rockchip,pins = <0x03 0x03 0x02 0xcc>;
				phandle = <0x5e>;
			};

			spi4-rx {
				rockchip,pins = <0x03 0x00 0x02 0xcc>;
				phandle = <0x5d>;
			};

			spi4-tx {
				rockchip,pins = <0x03 0x01 0x02 0xcc>;
				phandle = <0x5c>;
			};
		};

		spi5 {

			spi5-clk {
				rockchip,pins = <0x02 0x16 0x02 0xcc>;
				phandle = <0x60>;
			};

			spi5-cs0 {
				rockchip,pins = <0x02 0x17 0x02 0xcc>;
				phandle = <0x63>;
			};

			spi5-rx {
				rockchip,pins = <0x02 0x14 0x02 0xcc>;
				phandle = <0x62>;
			};

			spi5-tx {
				rockchip,pins = <0x02 0x15 0x02 0xcc>;
				phandle = <0x61>;
			};
		};

		testclk {

			test-clkout0 {
				rockchip,pins = <0x00 0x00 0x01 0xc8>;
				phandle = <0x174>;
			};

			test-clkout1 {
				rockchip,pins = <0x02 0x19 0x02 0xc8>;
				phandle = <0x175>;
			};

			test-clkout2 {
				rockchip,pins = <0x00 0x08 0x03 0xc8>;
				phandle = <0x176>;
			};
		};

		tsadc {

			otp-pin {
				rockchip,pins = <0x01 0x06 0x00 0xc8>;
				phandle = <0x69>;
			};

			otp-out {
				rockchip,pins = <0x01 0x06 0x01 0xc8>;
				phandle = <0x6a>;
			};
		};

		uart0 {

			uart0-xfer {
				rockchip,pins = <0x02 0x10 0x01 0xcc 0x02 0x11 0x01 0xcc>;
				phandle = <0x43>;
			};

			uart0-cts {
				rockchip,pins = <0x02 0x12 0x01 0xc8>;
				phandle = <0x44>;
			};

			uart0-rts {
				rockchip,pins = <0x02 0x13 0x01 0xc8>;
				phandle = <0x45>;
			};
		};

		uart1 {

			uart1-xfer {
				rockchip,pins = <0x03 0x0c 0x02 0xcc 0x03 0x0d 0x02 0xcc>;
				phandle = <0x4b>;
			};
		};

		uart2a {

			uart2a-xfer {
				rockchip,pins = <0x04 0x08 0x02 0xcc 0x04 0x09 0x02 0xcc>;
				phandle = <0x177>;
			};
		};

		uart2b {

			uart2b-xfer {
				rockchip,pins = <0x04 0x10 0x02 0xcc 0x04 0x11 0x02 0xcc>;
				phandle = <0x178>;
			};
		};

		uart2c {

			uart2c-xfer {
				rockchip,pins = <0x04 0x13 0x01 0xcc 0x04 0x14 0x01 0xcc>;
				phandle = <0x4c>;
			};
		};

		uart3 {

			uart3-xfer {
				rockchip,pins = <0x03 0x0e 0x02 0xcc 0x03 0x0f 0x02 0xcc>;
				phandle = <0x4d>;
			};

			uart3-cts {
				rockchip,pins = <0x03 0x10 0x02 0xc8>;
				phandle = <0x179>;
			};

			uart3-rts {
				rockchip,pins = <0x03 0x11 0x02 0xc8>;
				phandle = <0x17a>;
			};
		};

		uart4 {

			uart4-xfer {
				rockchip,pins = <0x01 0x07 0x01 0xcc 0x01 0x08 0x01 0xcc>;
				phandle = <0x8a>;
			};
		};

		uarthdcp {

			uarthdcp-xfer {
				rockchip,pins = <0x04 0x15 0x02 0xcc 0x04 0x16 0x02 0xcc>;
				phandle = <0x17b>;
			};
		};

		pwm0 {

			pwm0-pin {
				rockchip,pins = <0x04 0x12 0x01 0xc8>;
				phandle = <0x99>;
			};

			pwm0-pin-pull-down {
				rockchip,pins = <0x04 0x12 0x01 0xd1>;
				phandle = <0x17c>;
			};

			vop0-pwm-pin {
				rockchip,pins = <0x04 0x12 0x02 0xc8>;
				phandle = <0xb9>;
			};

			vop1-pwm-pin {
				rockchip,pins = <0x04 0x12 0x03 0xc8>;
				phandle = <0xb2>;
			};
		};

		pwm1 {

			pwm1-pin {
				rockchip,pins = <0x04 0x16 0x01 0xc8>;
				phandle = <0x9a>;
			};

			pwm1-pin-pull-down {
				rockchip,pins = <0x04 0x16 0x01 0xd1>;
				phandle = <0x17d>;
			};
		};

		pwm2 {

			pwm2-pin {
				rockchip,pins = <0x01 0x13 0x01 0xc8>;
				phandle = <0x9b>;
			};

			pwm2-pin-pull-down {
				rockchip,pins = <0x01 0x13 0x01 0xd1>;
				phandle = <0x17e>;
			};
		};

		pwm3a {

			pwm3a-pin {
				rockchip,pins = <0x00 0x06 0x01 0xc8>;
				phandle = <0x9c>;
			};

			pwm3a-pin-pull-down {
				rockchip,pins = <0x00 0x06 0x01 0xd1>;
				phandle = <0x17f>;
			};
		};

		pwm3b {

			pwm3b-pin {
				rockchip,pins = <0x01 0x0e 0x01 0xc8>;
				phandle = <0x180>;
			};

			pwm3b-pin-pull-down {
				rockchip,pins = <0x01 0x0e 0x01 0xd1>;
				phandle = <0x181>;
			};
		};

		hdmi {

			hdmi-i2c-xfer {
				rockchip,pins = <0x04 0x11 0x03 0xc8 0x04 0x10 0x03 0xc8>;
				phandle = <0xbf>;
			};

			hdmi-cec {
				rockchip,pins = <0x04 0x17 0x01 0xc8>;
				phandle = <0xc0>;
			};
		};

		pcie {

			pci-clkreqn-cpm {
				rockchip,pins = <0x02 0x1a 0x00 0xc8>;
				phandle = <0x182>;
			};

			pci-clkreqnb-cpm {
				rockchip,pins = <0x04 0x18 0x00 0xc8>;
				phandle = <0x1b>;
			};

			pcie-drv {
				rockchip,pins = <0x03 0x19 0x00 0xc8>;
				phandle = <0xd7>;
			};
		};

		isp {

			cif-clkout {
				rockchip,pins = <0x02 0x0b 0x03 0xc8>;
				phandle = <0x183>;
			};

			isp-dvp-d0d7 {
				rockchip,pins = <0x04 0x1b 0x00 0xc8 0x02 0x0b 0x03 0xc8 0x02 0x00 0x03 0xc8 0x02 0x01 0x03 0xc8 0x02 0x02 0x03 0xc8 0x02 0x03 0x03 0xc8 0x02 0x04 0x03 0xc8 0x02 0x05 0x03 0xc8 0x02 0x06 0x03 0xc8 0x02 0x07 0x03 0xc8 0x02 0x08 0x03 0xc8 0x02 0x09 0x03 0xc8 0x02 0x0a 0x03 0xc8>;
				phandle = <0x184>;
			};

			isp-shutter {
				rockchip,pins = <0x01 0x01 0x01 0xc8 0x01 0x00 0x01 0xc8>;
				phandle = <0x185>;
			};

			isp-flash-trigger {
				rockchip,pins = <0x01 0x03 0x01 0xc8>;
				phandle = <0x186>;
			};

			isp-flash-trigger-as-gpio {
				rockchip,pins = <0x00 0x11 0x00 0xc8>;
				phandle = <0x187>;
			};
		};

		cam_pins {

			cam0-default-pins {
				rockchip,pins = <0x04 0x1b 0x00 0xc8 0x02 0x0b 0x03 0xc8>;
				phandle = <0x188>;
			};

			cam0-sleep-pins {
				rockchip,pins = <0x04 0x1b 0x03 0xc8 0x02 0x0b 0x00 0xc8>;
				phandle = <0x189>;
			};
		};

		bt {

			bt-enable-h {
				rockchip,pins = <0x00 0x09 0x00 0xc8>;
				phandle = <0x4a>;
			};

			bt-host-wake-l {
				rockchip,pins = <0x00 0x04 0x00 0xc8>;
				phandle = <0x48>;
			};

			bt-wake-l {
				rockchip,pins = <0x02 0x1b 0x00 0xc8>;
				phandle = <0x49>;
			};
		};

		wifi {

			wifi-enable-h {
				rockchip,pins = <0x00 0x0a 0x00 0xc8>;
				phandle = <0xe0>;
			};

			wifi-host-wake-l {
				rockchip,pins = <0x00 0x03 0x00 0xc8>;
				phandle = <0x28>;
			};
		};

		hpd {

			hpd-en {
				rockchip,pins = <0x04 0x19 0x00 0xc8>;
				phandle = <0xdb>;
			};
		};

		pmic {

			pmic-int-l {
				rockchip,pins = <0x01 0x15 0x00 0xcc>;
				phandle = <0x8c>;
			};

			vsel1-gpio {
				rockchip,pins = <0x01 0x11 0x00 0xd1>;
				phandle = <0x95>;
			};

			vsel2-gpio {
				rockchip,pins = <0x01 0x0e 0x00 0xd1>;
				phandle = <0x96>;
			};

			soc-slppin-gpio {
				rockchip,pins = <0x01 0x05 0x00 0xca>;
				phandle = <0x8f>;
			};

			soc-slppin-slp {
				rockchip,pins = <0x01 0x05 0x01 0xd1>;
				phandle = <0x8d>;
			};

			soc-slppin-rst {
				rockchip,pins = <0x01 0x05 0x02 0xc8>;
				phandle = <0x18a>;
			};
		};

		vbus_host {

			vcc5v0-host-en {
				rockchip,pins = <0x03 0x1e 0x00 0xcc>;
				phandle = <0xd4>;
			};
		};

		vbus_typec {

			vbus-typec-en {
				rockchip,pins = <0x01 0x03 0x00 0xcc>;
				phandle = <0xd6>;
			};
		};
	};

	rockchip-suspend {
		compatible = "rockchip,pm-rk3399";
		status = "okay";
		rockchip,sleep-debug-en = <0x01>;
		rockchip,virtual-poweroff = <0x00>;
		rockchip,sleep-mode-config = <0x5e>;
		rockchip,wakeup-config = <0x4884>;
		rockchip,pwm-regulator-config = <0x04>;
		rockchip,power-ctrl = <0x1a 0x11 0x00 0x1a 0x0e 0x00 0x27 0x03 0x00>;
		phandle = <0x18b>;
	};

	reserved-memory {
		#address-cells = <0x02>;
		#size-cells = <0x02>;
		ranges;

		drm-logo@00000000 {
			compatible = "rockchip,drm-logo";
			reg = <0x00 0x00 0x00 0x00>;
			phandle = <0x11>;
		};

		region@110000 {
			reg = <0x00 0x110000 0x00 0xf0000>;
			reg-names = "ramoops_mem";
			phandle = <0xd2>;
		};
	};

	ramoops {
		compatible = "ramoops";
		record-size = <0x00 0x40000>;
		console-size = <0x00 0x80000>;
		ftrace-size = <0x00 0x00>;
		pmsg-size = <0x00 0x00>;
		memory-region = <0xd2>;
		phandle = <0x18c>;
	};

	fiq-debugger {
		compatible = "rockchip,fiq-debugger";
		rockchip,serial-id = <0x02>;
		rockchip,wake-irq = <0x00>;
		rockchip,irq-mode-enable = <0x01>;
		rockchip,baudrate = <0x16e360>;
		interrupts = <0x00 0x96 0x04 0x00>;
		pinctrl-names = "default";
		pinctrl-0 = <0x4c>;
		status = "okay";
		rockchip,signal-irq = <0xb6>;
		phandle = <0x18d>;
	};

	cif_isp@ff910000 {
		compatible = "rockchip,rk3399-cif-isp";
		rockchip,grf = <0x1d>;
		reg = <0x00 0xff910000 0x00 0x4000 0x00 0xff968000 0x00 0x8000>;
		reg-names = "register\0dsihost-register";
		clocks = <0x08 0xe7 0x08 0xe9 0x08 0x1e1 0x08 0x1e3 0x08 0x6e 0x08 0xa5 0x08 0x89 0x08 0x89 0x08 0x77>;
		clock-names = "aclk_isp0_noc\0aclk_isp0_wrapper\0hclk_isp0_noc\0hclk_isp0_wrapper\0clk_isp0\0pclk_dphyrx\0clk_cif_out\0clk_cif_pll\0pclk_dphy_ref";
		interrupts = <0x00 0x2b 0x04 0x00>;
		interrupt-names = "cif_isp10_irq";
		power-domains = <0x1c 0x13>;
		rockchip,isp,iommu-enable = <0x01>;
		iommus = <0xbb>;
		status = "disabled";
		phandle = <0x18e>;
	};

	cif_isp@ff920000 {
		compatible = "rockchip,rk3399-cif-isp";
		rockchip,grf = <0x1d>;
		reg = <0x00 0xff920000 0x00 0x4000 0x00 0xff968000 0x00 0x8000>;
		reg-names = "register\0dsihost-register";
		clocks = <0x08 0xe8 0x08 0xea 0x08 0x1e2 0x08 0x1e4 0x08 0x6f 0x08 0x17b 0x08 0xa4 0x08 0x171 0x08 0x78 0x08 0x89 0x08 0x89 0x08 0x77>;
		clock-names = "aclk_isp1_noc\0aclk_isp1_wrapper\0hclk_isp1_noc\0hclk_isp1_wrapper\0clk_isp1\0pclkin_isp1\0pclk_dphytxrx\0pclk_mipi_dsi\0mipi_dphy_cfg\0clk_cif_out\0clk_cif_pll\0pclk_dphy_ref";
		interrupts = <0x00 0x2c 0x04 0x00>;
		interrupt-names = "cif_isp10_irq";
		power-domains = <0x1c 0x14>;
		rockchip,isp,iommu-enable = <0x01>;
		iommus = <0xbc>;
		status = "disabled";
		phandle = <0x18f>;
	};

	opp-table-0 {
		compatible = "operating-points-v2";
		opp-shared;
		phandle = <0x0b>;

		opp00 {
			opp-hz = <0x00 0x18519600>;
			opp-microvolt = <0xd59f8 0xd59f8 0x1312d0>;
			clock-latency-ns = <0x9c40>;
		};

		opp01 {
			opp-hz = <0x00 0x23c34600>;
			opp-microvolt = <0xd59f8 0xd59f8 0x1312d0>;
		};

		opp02 {
			opp-hz = <0x00 0x30a32c00>;
			opp-microvolt = <0xdbba0 0xdbba0 0x1312d0>;
		};

		opp03 {
			opp-hz = <0x00 0x3c14dc00>;
			opp-microvolt = <0xee098 0xee098 0x1312d0>;
		};
	};

	opp-table-1 {
		compatible = "operating-points-v2";
		opp-shared;
		phandle = <0x0d>;

		opp00 {
			opp-hz = <0x00 0x18519600>;
			opp-microvolt = <0xd59f8 0xd59f8 0x1312d0>;
			clock-latency-ns = <0x9c40>;
		};

		opp01 {
			opp-hz = <0x00 0x23c34600>;
			opp-microvolt = <0xd59f8 0xd59f8 0x1312d0>;
		};

		opp02 {
			opp-hz = <0x00 0x30a32c00>;
			opp-microvolt = <0xd59f8 0xd59f8 0x1312d0>;
		};

		opp03 {
			opp-hz = <0x00 0x3c14dc00>;
			opp-microvolt = <0xe1d48 0xe1d48 0x1312d0>;
		};

		opp04 {
			opp-hz = <0x00 0x47868c00>;
			opp-microvolt = <0xf4240 0xf4240 0x1312d0>;
		};

		opp05 {
			opp-hz = <0x00 0x54667200>;
			opp-microvolt = <0x106738 0x106738 0x1312d0>;
		};

		opp06 {
			opp-hz = <0x00 0x5a1f4a00>;
			opp-microvolt = <0x118c30 0x118c30 0x1312d0>;
		};
	};

	opp-table-2 {
		compatible = "operating-points-v2";
		phandle = <0xc6>;

		opp00 {
			opp-hz = <0x00 0xbebc200>;
			opp-microvolt = <0xd59f8 0xd59f8 0x118c30>;
		};

		opp01 {
			opp-hz = <0x00 0x11e1a300>;
			opp-microvolt = <0xd59f8 0xd59f8 0x118c30>;
		};

		opp02 {
			opp-hz = <0x00 0x17d78400>;
			opp-microvolt = <0xd59f8 0xd59f8 0x118c30>;
		};

		opp03 {
			opp-hz = <0x00 0x23c34600>;
			opp-microvolt = <0xee098 0xee098 0x118c30>;
		};
	};

	opp-table3 {
		compatible = "operating-points-v2";
		phandle = <0xa0>;

		opp-200000000 {
			opp-hz = <0x00 0xbebc200>;
			opp-microvolt = <0xdbba0>;
			status = "disabled";
		};

		opp-300000000 {
			opp-hz = <0x00 0x11e1a300>;
			opp-microvolt = <0xdbba0>;
			status = "disabled";
		};

		opp-328000000 {
			opp-hz = <0x00 0x138ce200>;
			opp-microvolt = <0xdbba0>;
		};

		opp-400000000 {
			opp-hz = <0x00 0x17d78400>;
			opp-microvolt = <0xdbba0>;
			status = "disabled";
		};

		opp-416000000 {
			opp-hz = <0x00 0x18cba800>;
			opp-microvolt = <0xdbba0>;
		};

		opp-528000000 {
			opp-hz = <0x00 0x1f78a400>;
			opp-microvolt = <0xdbba0>;
			status = "disabled";
		};

		opp-600000000 {
			opp-hz = <0x00 0x23c34600>;
			opp-microvolt = <0xdbba0>;
			status = "disabled";
		};

		opp-666000000 {
			opp-hz = <0x00 0x27b25a80>;
			opp-microvolt = <0xdbba0>;
		};
	};

	pwm-fan {
		compatible = "pwm-fan";
		#cooling-cells = <0x02>;
		cooling-levels = <0x00 0x40 0x80 0xc0 0xff>;
		pwms = <0xd3 0x00 0x9c40 0x00>;
		phandle = <0x67>;
	};

	vcc5v0-sys {
		compatible = "regulator-fixed";
		regulator-name = "vcc5v0_sys";
		regulator-always-on;
		regulator-boot-on;
		regulator-min-microvolt = <0x4c4b40>;
		regulator-max-microvolt = <0x4c4b40>;
		phandle = <0x92>;
	};

	vbus-host {
		compatible = "regulator-fixed";
		enable-active-high;
		gpio = <0x1f 0x1e 0x00>;
		pinctrl-names = "default";
		pinctrl-0 = <0xd4>;
		regulator-name = "vbus_host";
		regulator-always-on;
		regulator-boot-on;
		vin-supply = <0xd5>;
		phandle = <0xa7>;
	};

	vbus-typec {
		compatible = "regulator-fixed";
		enable-active-high;
		gpio = <0x1a 0x03 0x00>;
		pinctrl-names = "default";
		pinctrl-0 = <0xd6>;
		regulator-name = "vbus_typec";
		regulator-always-on;
		regulator-boot-on;
		vin-supply = <0x92>;
		phandle = <0x190>;
	};

	vcc-phy-regulator {
		compatible = "regulator-fixed";
		regulator-name = "vcc_phy";
		regulator-always-on;
		regulator-boot-on;
		phandle = <0x1e>;
	};

	vcc3v3-pcie-regulator {
		compatible = "regulator-fixed";
		enable-active-high;
		gpio = <0x1f 0x19 0x00>;
		pinctrl-names = "default";
		pinctrl-0 = <0xd7>;
		regulator-boot-on;
		regulator-always-on;
		regulator-name = "vcc3v3_pcie";
		vin-supply = <0x92>;
		phandle = <0x191>;
	};

	external-gmac-clock {
		compatible = "fixed-clock";
		clock-frequency = <0x7735940>;
		clock-output-names = "clkin_gmac";
		#clock-cells = <0x00>;
		phandle = <0x20>;
	};

	dp0-sound {
		status = "okay";
		compatible = "rockchip,hdmi";
		rockchip,card-name = "rockchip-hdmi1";
		rockchip,mclk-fs = <0x200>;
		rockchip,cpu = <0xd8>;
		rockchip,codec = <0xd9 0x01>;
		rockchip,jack-det;
		phandle = <0x192>;
	};

	vcc3v3-dp {
		compatible = "regulator-fixed";
		regulator-name = "vcc3v3_dp";
		regulator-always-on;
		regulator-boot-on;
		regulator-min-microvolt = <0x325aa0>;
		regulator-max-microvolt = <0x325aa0>;
		vin-supply = <0x92>;
		phandle = <0xdc>;
	};

	virtual-pd {
		compatible = "linux,extcon-pd-virtual";
		vpd,init-flip = <0x00>;
		vpd,init-ss = <0x01>;
		vpd,init-mode = <0x02>;
		hpd-gpios = <0xda 0x19 0x01>;
		pinctrl-names = "default";
		pinctrl-0 = <0xdb>;
		dp-pwr-supply = <0xdc>;
		phandle = <0x39>;
	};

	rk809-sound {
		compatible = "rockchip,multicodecs-card";
		rockchip,card-name = "rockchip-rk809";
		rockchip,format = "i2s";
		rockchip,mclk-fs = <0x100>;
		rockchip,cpu = <0xdd>;
		rockchip,codec = <0xde>;
		io-channels = <0xdf 0x02>;
		io-channel-names = "adc-detect";
		keyup-threshold-microvolt = <0x1b7740>;
		poll-interval = <0x64>;
		rockchip,audio-routing = "Speaker\0Speaker Power";
		phandle = <0x193>;

		play-pause-key {
			label = "playpause";
			linux,code = <0xa4>;
			press-threshold-microvolt = <0x7d0>;
		};
	};

	sdio-pwrseq {
		compatible = "mmc-pwrseq-simple";
		clocks = <0x46 0x01>;
		clock-names = "ext_clock";
		pinctrl-names = "default";
		pinctrl-0 = <0xe0>;
		reset-gpios = <0x27 0x0a 0x01>;
		phandle = <0x23>;
	};

	gpio-leds {
		compatible = "gpio-leds";
		status = "okay";

		user-led1 {
			gpios = <0x1f 0x1c 0x01>;
			linux,default-trigger = "default-on";
			default-state = "on";
		};

		user-led2 {
			gpios = <0x1f 0x1d 0x00>;
			linux,default-trigger = "heartbeat";
			default-state = "on";
		};
	};

	__symbols__ {
		ddr_timing = "/ddr_timing";
		cpu_l0 = "/cpus/cpu@0";
		cpu_l1 = "/cpus/cpu@1";
		cpu_l2 = "/cpus/cpu@2";
		cpu_l3 = "/cpus/cpu@3";
		cpu_b0 = "/cpus/cpu@100";
		cpu_b1 = "/cpus/cpu@101";
		CPU_SLEEP = "/cpus/idle-states/cpu-sleep";
		CLUSTER_SLEEP = "/cpus/idle-states/cluster-sleep";
		display_subsystem = "/display-subsystem";
		route_hdmi = "/display-subsystem/route/route-hdmi";
		route_dsi = "/display-subsystem/route/route-dsi";
		route_edp = "/display-subsystem/route/route-edp";
		xin24m = "/xin24m";
		dummy_cpll = "/dummy_cpll";
		dummy_vpll = "/dummy_vpll";
		amba = "/bus";
		dmac_bus = "/bus/dma-controller@ff6d0000";
		dmac_peri = "/bus/dma-controller@ff6e0000";
		pcie0 = "/pcie@f8000000";
		pcie0_intc = "/pcie@f8000000/interrupt-controller";
		gmac = "/ethernet@fe300000";
		sdio0 = "/mmc@fe310000";
		brcmf = "/mmc@fe310000/wifi@1";
		sdmmc = "/mmc@fe320000";
		sdhci = "/sdhci@fe330000";
		usb_host0_ehci = "/usb@fe380000";
		usb_host0_ohci = "/usb@fe3a0000";
		usb_host1_ehci = "/usb@fe3c0000";
		usb_host1_ohci = "/usb@fe3e0000";
		usbdrd3_0 = "/usb@fe800000";
		usbdrd_dwc3_0 = "/usb@fe800000/usb@fe800000";
		usbdrd3_1 = "/usb@fe900000";
		usbdrd_dwc3_1 = "/usb@fe900000/usb@fe900000";
		cdn_dp = "/dp@fec00000";
		dp_in = "/dp@fec00000/ports/port";
		dp_in_vopb = "/dp@fec00000/ports/port/endpoint@0";
		dp_in_vopl = "/dp@fec00000/ports/port/endpoint@1";
		gic = "/interrupt-controller@fee00000";
		its = "/interrupt-controller@fee00000/interrupt-controller@fee20000";
		ppi_cluster0 = "/interrupt-controller@fee00000/ppi-partitions/interrupt-partition-0";
		ppi_cluster1 = "/interrupt-controller@fee00000/ppi-partitions/interrupt-partition-1";
		saradc = "/saradc@ff100000";
		i2c1 = "/i2c@ff110000";
		i2c2 = "/i2c@ff120000";
		i2c3 = "/i2c@ff130000";
		i2c5 = "/i2c@ff140000";
		i2c6 = "/i2c@ff150000";
		i2c7 = "/i2c@ff160000";
		uart0 = "/serial@ff180000";
		uart1 = "/serial@ff190000";
		uart2 = "/serial@ff1a0000";
		uart3 = "/serial@ff1b0000";
		spi0 = "/spi@ff1c0000";
		spi1 = "/spi@ff1d0000";
		spiflash = "/spi@ff1d0000/spi-flash@0";
		spi2 = "/spi@ff1e0000";
		spi4 = "/spi@ff1f0000";
		spi5 = "/spi@ff200000";
		thermal_zones = "/thermal-zones";
		soc_thermal = "/thermal-zones/cpu-thermal";
		cpu_thermal = "/thermal-zones/cpu-thermal";
		threshold = "/thermal-zones/cpu-thermal/trips/cpu_alert0";
		cpu_alert0 = "/thermal-zones/cpu-thermal/trips/cpu_alert0";
		target = "/thermal-zones/cpu-thermal/trips/cpu_alert1";
		cpu_alert1 = "/thermal-zones/cpu-thermal/trips/cpu_alert1";
		soc_crit = "/thermal-zones/cpu-thermal/trips/cpu_crit";
		cpu_crit = "/thermal-zones/cpu-thermal/trips/cpu_crit";
		gpu_thermal = "/thermal-zones/gpu-thermal";
		tsadc = "/tsadc@ff260000";
		qos_emmc = "/qos@ffa58000";
		qos_gmac = "/qos@ffa5c000";
		qos_pcie = "/qos@ffa60080";
		qos_usb_host0 = "/qos@ffa60100";
		qos_usb_host1 = "/qos@ffa60180";
		qos_usb_otg0 = "/qos@ffa70000";
		qos_usb_otg1 = "/qos@ffa70080";
		qos_sd = "/qos@ffa74000";
		qos_sdioaudio = "/qos@ffa76000";
		qos_hdcp = "/qos@ffa90000";
		qos_iep = "/qos@ffa98000";
		qos_isp0_m0 = "/qos@ffaa0000";
		qos_isp0_m1 = "/qos@ffaa0080";
		qos_isp1_m0 = "/qos@ffaa8000";
		qos_isp1_m1 = "/qos@ffaa8080";
		qos_rga_r = "/qos@ffab0000";
		qos_rga_w = "/qos@ffab0080";
		qos_video_m0 = "/qos@ffab8000";
		qos_video_m1_r = "/qos@ffac0000";
		qos_video_m1_w = "/qos@ffac0080";
		qos_vop_big_r = "/qos@ffac8000";
		qos_vop_big_w = "/qos@ffac8080";
		qos_vop_little = "/qos@ffad0000";
		qos_perihp = "/qos@ffad8080";
		qos_gpu = "/qos@ffae0000";
		pmu = "/power-management@ff310000";
		power = "/power-management@ff310000/power-controller";
		pmugrf = "/syscon@ff320000";
		pmu_io_domains = "/syscon@ff320000/io-domains";
		reboot_mode = "/syscon@ff320000/reboot-mode";
		pmu_pvtm = "/syscon@ff320000/pmu-pvtm";
		spi3 = "/spi@ff350000";
		uart4 = "/serial@ff370000";
		i2c0 = "/i2c@ff3c0000";
		rk809 = "/i2c@ff3c0000/pmic@20";
		pinctrl_rk8xx = "/i2c@ff3c0000/pmic@20/pinctrl_rk8xx";
		rk809_slppin_null = "/i2c@ff3c0000/pmic@20/pinctrl_rk8xx/rk809_slppin_null";
		rk809_slppin_slp = "/i2c@ff3c0000/pmic@20/pinctrl_rk8xx/rk809_slppin_slp";
		rk809_slppin_pwrdn = "/i2c@ff3c0000/pmic@20/pinctrl_rk8xx/rk809_slppin_pwrdn";
		rk809_slppin_rst = "/i2c@ff3c0000/pmic@20/pinctrl_rk8xx/rk809_slppin_rst";
		vdd_log = "/i2c@ff3c0000/pmic@20/regulators/DCDC_REG1";
		vdd_cpu_l = "/i2c@ff3c0000/pmic@20/regulators/DCDC_REG2";
		vcc_ddr = "/i2c@ff3c0000/pmic@20/regulators/DCDC_REG3";
		vcc3v3_sys = "/i2c@ff3c0000/pmic@20/regulators/DCDC_REG4";
		vcc_buck5 = "/i2c@ff3c0000/pmic@20/regulators/DCDC_REG5";
		vcca_0v9 = "/i2c@ff3c0000/pmic@20/regulators/LDO_REG1";
		vcc_1v8 = "/i2c@ff3c0000/pmic@20/regulators/LDO_REG2";
		vcc0v9_soc = "/i2c@ff3c0000/pmic@20/regulators/LDO_REG3";
		vcca_1v8 = "/i2c@ff3c0000/pmic@20/regulators/LDO_REG4";
		vcc_mipi = "/i2c@ff3c0000/pmic@20/regulators/LDO_REG5";
		vcc_1v5 = "/i2c@ff3c0000/pmic@20/regulators/LDO_REG6";
		vcc_3v0 = "/i2c@ff3c0000/pmic@20/regulators/LDO_REG7";
		vccio_sd = "/i2c@ff3c0000/pmic@20/regulators/LDO_REG8";
		vcc_cam = "/i2c@ff3c0000/pmic@20/regulators/LDO_REG9";
		vcc5v0_usb2 = "/i2c@ff3c0000/pmic@20/regulators/SWITCH_REG1";
		lcd_3v3 = "/i2c@ff3c0000/pmic@20/regulators/SWITCH_REG2";
		rk809_codec = "/i2c@ff3c0000/pmic@20/codec";
		vdd_cpu_b = "/i2c@ff3c0000/syr827@40";
		vdd_gpu = "/i2c@ff3c0000/syr828@41";
		eeprom = "/i2c@ff3c0000/at24c04@50";
		i2c4 = "/i2c@ff3d0000";
		i2c8 = "/i2c@ff3e0000";
		pwm0 = "/pwm@ff420000";
		pwm1 = "/pwm@ff420010";
		pwm2 = "/pwm@ff420020";
		pwm3 = "/pwm@ff420030";
		dfi = "/dfi@ff630000";
		dmc = "/dmc";
		mpp_srv = "/mpp-srv";
		vpu = "/video-codec@ff650000";
		vepu = "/vepu@ff650000";
		vdpu = "/vdpu@ff650400";
		vpu_mmu = "/iommu@ff650800";
		vdec = "/video-codec@ff660000";
		rkvdec = "/rkvdec@ff660000";
		vdec_mmu = "/iommu@ff660480";
		iep = "/iep@ff670000";
		iep_mmu = "/iommu@ff670800";
		rga = "/rga@ff680000";
		efuse0 = "/efuse@ff690000";
		specification_serial_number = "/efuse@ff690000/specification-serial-number@6";
		cpu_id = "/efuse@ff690000/cpu-id@7";
		cpub_leakage = "/efuse@ff690000/cpu-leakage@17";
		gpu_leakage = "/efuse@ff690000/gpu-leakage@18";
		center_leakage = "/efuse@ff690000/center-leakage@19";
		cpul_leakage = "/efuse@ff690000/cpu-leakage@1a";
		logic_leakage = "/efuse@ff690000/logic-leakage@1b";
		wafer_info = "/efuse@ff690000/wafer-info@1c";
		cpu_performance = "/efuse@ff690000/cpu-performance@1e";
		gpu_performance = "/efuse@ff690000/gpu-performance@1e";
		customer_demand = "/efuse@ff690000/customer-demand@22";
		pmucru = "/pmu-clock-controller@ff750000";
		cru = "/clock-controller@ff760000";
		grf = "/syscon@ff770000";
		io_domains = "/syscon@ff770000/io-domains";
		mipi_dphy_rx0 = "/syscon@ff770000/mipi-dphy-rx0";
		u2phy0 = "/syscon@ff770000/usb2-phy@e450";
		u2phy0_host = "/syscon@ff770000/usb2-phy@e450/host-port";
		u2phy0_otg = "/syscon@ff770000/usb2-phy@e450/otg-port";
		u2phy1 = "/syscon@ff770000/usb2-phy@e460";
		u2phy1_host = "/syscon@ff770000/usb2-phy@e460/host-port";
		u2phy1_otg = "/syscon@ff770000/usb2-phy@e460/otg-port";
		emmc_phy = "/syscon@ff770000/phy@f780";
		pcie_phy = "/syscon@ff770000/pcie-phy";
		pvtm = "/syscon@ff770000/pvtm";
		tcphy0 = "/phy@ff7c0000";
		tcphy0_dp = "/phy@ff7c0000/dp-port";
		tcphy0_usb3 = "/phy@ff7c0000/usb3-port";
		tcphy1 = "/phy@ff800000";
		tcphy1_dp = "/phy@ff800000/dp-port";
		tcphy1_usb3 = "/phy@ff800000/usb3-port";
		rktimer = "/rktimer@ff850000";
		spdif = "/spdif@ff870000";
		i2s0 = "/i2s@ff880000";
		i2s1 = "/i2s@ff890000";
		i2s2 = "/i2s@ff8a0000";
		rng = "/rng@ff8b8000";
		vopl = "/vop@ff8f0000";
		vopl_out = "/vop@ff8f0000/port";
		vopl_out_dsi = "/vop@ff8f0000/port/endpoint@0";
		vopl_out_edp = "/vop@ff8f0000/port/endpoint@1";
		vopl_out_hdmi = "/vop@ff8f0000/port/endpoint@2";
		vopl_out_dsi1 = "/vop@ff8f0000/port/endpoint@3";
		vopl_out_dp = "/vop@ff8f0000/port/endpoint@4";
		vop1_pwm = "/voppwm@ff8f01a0";
		vopl_mmu = "/iommu@ff8f3f00";
		vopb = "/vop@ff900000";
		vopb_out = "/vop@ff900000/port";
		vopb_out_edp = "/vop@ff900000/port/endpoint@0";
		vopb_out_dsi = "/vop@ff900000/port/endpoint@1";
		vopb_out_hdmi = "/vop@ff900000/port/endpoint@2";
		vopb_out_dsi1 = "/vop@ff900000/port/endpoint@3";
		vopb_out_dp = "/vop@ff900000/port/endpoint@4";
		vop0_pwm = "/voppwm@ff9001a0";
		vopb_mmu = "/iommu@ff903f00";
		rkisp1_0 = "/rkisp1@ff910000";
		isp0_mmu = "/iommu@ff914000";
		rkisp1_1 = "/rkisp1@ff920000";
		isp1_mmu = "/iommu@ff924000";
		hdmi_sound = "/hdmi-sound";
		hdmi = "/hdmi@ff940000";
		hdmi_in = "/hdmi@ff940000/ports/port";
		hdmi_in_vopb = "/hdmi@ff940000/ports/port/endpoint@0";
		hdmi_in_vopl = "/hdmi@ff940000/ports/port/endpoint@1";
		dsi = "/dsi@ff960000";
		mipi_dsi = "/dsi@ff960000";
		dsi_in_vopb = "/dsi@ff960000/ports/port@0/endpoint@0";
		dsi_in_vopl = "/dsi@ff960000/ports/port@0/endpoint@1";
		dsi1 = "/dsi@ff968000";
		mipi_dsi1 = "/dsi@ff968000";
		dsi1_in_vopb = "/dsi@ff968000/ports/port@0/endpoint@0";
		dsi1_in_vopl = "/dsi@ff968000/ports/port@0/endpoint@1";
		mipi_dphy_tx1rx1 = "/mipi-dphy-tx1rx1@ff968000";
		edp = "/edp@ff970000";
		edp_in = "/edp@ff970000/ports/port@0";
		edp_in_vopb = "/edp@ff970000/ports/port@0/endpoint@0";
		edp_in_vopl = "/edp@ff970000/ports/port@0/endpoint@1";
		gpu = "/gpu@ff9a0000";
		gpu_power_model = "/gpu@ff9a0000/power_model";
		nocp_cci_msch0 = "/nocp-cci-msch0@ffa86000";
		nocp_gpu_msch0 = "/nocp-gpu-msch0@ffa86400";
		nocp_hp_msch0 = "/nocp-hp-msch0@ffa86800";
		nocp_lp_msch0 = "/nocp-lp-msch0@ffa86c00";
		nocp_video_msch0 = "/nocp-video-msch0@ffa87000";
		nocp_vio0_msch0 = "/nocp-vio0-msch0@ffa87400";
		nocp_vio1_msch0 = "/nocp-vio1-msch0@ffa87800";
		nocp_cci_msch1 = "/nocp-cci-msch1@ffa8e000";
		nocp_gpu_msch1 = "/nocp-gpu-msch1@ffa8e400";
		nocp_hp_msch1 = "/nocp-hp-msch1@ffa8e800";
		nocp_lp_msch1 = "/nocp-lp-msch1@ffa8ec00";
		nocp_video_msch1 = "/nocp-video-msch1@ffa8f000";
		nocp_vio0_msch1 = "/nocp-vio0-msch1@ffa8f400";
		nocp_vio1_msch1 = "/nocp-vio1-msch1@ffa8f800";
		rockchip_system_monitor = "/rockchip-system-monitor";
		pinctrl = "/pinctrl";
		gpio0 = "/pinctrl/gpio0@ff720000";
		gpio1 = "/pinctrl/gpio1@ff730000";
		gpio2 = "/pinctrl/gpio2@ff780000";
		gpio3 = "/pinctrl/gpio3@ff788000";
		gpio4 = "/pinctrl/gpio4@ff790000";
		pcfg_pull_up = "/pinctrl/pcfg-pull-up";
		pcfg_pull_down = "/pinctrl/pcfg-pull-down";
		pcfg_pull_none = "/pinctrl/pcfg-pull-none";
		pcfg_pull_none_12ma = "/pinctrl/pcfg-pull-none-12ma";
		pcfg_pull_none_13ma = "/pinctrl/pcfg-pull-none-13ma";
		pcfg_pull_none_18ma = "/pinctrl/pcfg-pull-none-18ma";
		pcfg_pull_none_20ma = "/pinctrl/pcfg-pull-none-20ma";
		pcfg_pull_up_2ma = "/pinctrl/pcfg-pull-up-2ma";
		pcfg_pull_up_8ma = "/pinctrl/pcfg-pull-up-8ma";
		pcfg_pull_up_18ma = "/pinctrl/pcfg-pull-up-18ma";
		pcfg_pull_up_20ma = "/pinctrl/pcfg-pull-up-20ma";
		pcfg_pull_down_4ma = "/pinctrl/pcfg-pull-down-4ma";
		pcfg_pull_down_8ma = "/pinctrl/pcfg-pull-down-8ma";
		pcfg_pull_down_12ma = "/pinctrl/pcfg-pull-down-12ma";
		pcfg_pull_down_18ma = "/pinctrl/pcfg-pull-down-18ma";
		pcfg_pull_down_20ma = "/pinctrl/pcfg-pull-down-20ma";
		pcfg_output_high = "/pinctrl/pcfg-output-high";
		pcfg_output_low = "/pinctrl/pcfg-output-low";
		clk_32k = "/pinctrl/clock/clk-32k";
		edp_hpd = "/pinctrl/edp/edp-hpd";
		rgmii_pins = "/pinctrl/gmac/rgmii-pins";
		rmii_pins = "/pinctrl/gmac/rmii-pins";
		rgmii_sleep_pins = "/pinctrl/gmac/rgmii-sleep-pins";
		i2c0_xfer = "/pinctrl/i2c0/i2c0-xfer";
		i2c1_xfer = "/pinctrl/i2c1/i2c1-xfer";
		i2c2_xfer = "/pinctrl/i2c2/i2c2-xfer";
		i2c3_xfer = "/pinctrl/i2c3/i2c3-xfer";
		i2c3_gpio = "/pinctrl/i2c3/i2c3_gpio";
		i2c4_xfer = "/pinctrl/i2c4/i2c4-xfer";
		i2c5_xfer = "/pinctrl/i2c5/i2c5-xfer";
		i2c6_xfer = "/pinctrl/i2c6/i2c6-xfer";
		i2c7_xfer = "/pinctrl/i2c7/i2c7-xfer";
		i2c8_xfer = "/pinctrl/i2c8/i2c8-xfer";
		i2s0_2ch_bus = "/pinctrl/i2s0/i2s0-2ch-bus";
		i2s0_8ch_bus = "/pinctrl/i2s0/i2s0-8ch-bus";
		i2s_8ch_mclk = "/pinctrl/i2s0/i2s-8ch-mclk";
		i2s1_2ch_bus = "/pinctrl/i2s1/i2s1-2ch-bus";
		sdio0_bus1 = "/pinctrl/sdio0/sdio0-bus1";
		sdio0_bus4 = "/pinctrl/sdio0/sdio0-bus4";
		sdio0_cmd = "/pinctrl/sdio0/sdio0-cmd";
		sdio0_clk = "/pinctrl/sdio0/sdio0-clk";
		sdio0_cd = "/pinctrl/sdio0/sdio0-cd";
		sdio0_pwr = "/pinctrl/sdio0/sdio0-pwr";
		sdio0_bkpwr = "/pinctrl/sdio0/sdio0-bkpwr";
		sdio0_wp = "/pinctrl/sdio0/sdio0-wp";
		sdio0_int = "/pinctrl/sdio0/sdio0-int";
		sdmmc_bus1 = "/pinctrl/sdmmc/sdmmc-bus1";
		sdmmc_bus4 = "/pinctrl/sdmmc/sdmmc-bus4";
		sdmmc_clk = "/pinctrl/sdmmc/sdmmc-clk";
		sdmmc_cmd = "/pinctrl/sdmmc/sdmmc-cmd";
		sdmmc_cd = "/pinctrl/sdmmc/sdmmc-cd";
		sdmmc_wp = "/pinctrl/sdmmc/sdmmc-wp";
		ap_pwroff = "/pinctrl/suspend/ap-pwroff";
		ddrio_pwroff = "/pinctrl/suspend/ddrio-pwroff";
		spdif_bus = "/pinctrl/spdif/spdif-bus";
		spdif_bus_1 = "/pinctrl/spdif/spdif-bus-1";
		spi0_clk = "/pinctrl/spi0/spi0-clk";
		spi0_cs0 = "/pinctrl/spi0/spi0-cs0";
		spi0_cs1 = "/pinctrl/spi0/spi0-cs1";
		spi0_tx = "/pinctrl/spi0/spi0-tx";
		spi0_rx = "/pinctrl/spi0/spi0-rx";
		spi1_clk = "/pinctrl/spi1/spi1-clk";
		spi1_cs0 = "/pinctrl/spi1/spi1-cs0";
		spi1_rx = "/pinctrl/spi1/spi1-rx";
		spi1_tx = "/pinctrl/spi1/spi1-tx";
		spi2_clk = "/pinctrl/spi2/spi2-clk";
		spi2_cs0 = "/pinctrl/spi2/spi2-cs0";
		spi2_rx = "/pinctrl/spi2/spi2-rx";
		spi2_tx = "/pinctrl/spi2/spi2-tx";
		spi3_clk = "/pinctrl/spi3/spi3-clk";
		spi3_cs0 = "/pinctrl/spi3/spi3-cs0";
		spi3_rx = "/pinctrl/spi3/spi3-rx";
		spi3_tx = "/pinctrl/spi3/spi3-tx";
		spi4_clk = "/pinctrl/spi4/spi4-clk";
		spi4_cs0 = "/pinctrl/spi4/spi4-cs0";
		spi4_rx = "/pinctrl/spi4/spi4-rx";
		spi4_tx = "/pinctrl/spi4/spi4-tx";
		spi5_clk = "/pinctrl/spi5/spi5-clk";
		spi5_cs0 = "/pinctrl/spi5/spi5-cs0";
		spi5_rx = "/pinctrl/spi5/spi5-rx";
		spi5_tx = "/pinctrl/spi5/spi5-tx";
		test_clkout0 = "/pinctrl/testclk/test-clkout0";
		test_clkout1 = "/pinctrl/testclk/test-clkout1";
		test_clkout2 = "/pinctrl/testclk/test-clkout2";
		otp_pin = "/pinctrl/tsadc/otp-pin";
		otp_out = "/pinctrl/tsadc/otp-out";
		uart0_xfer = "/pinctrl/uart0/uart0-xfer";
		uart0_cts = "/pinctrl/uart0/uart0-cts";
		uart0_rts = "/pinctrl/uart0/uart0-rts";
		uart1_xfer = "/pinctrl/uart1/uart1-xfer";
		uart2a_xfer = "/pinctrl/uart2a/uart2a-xfer";
		uart2b_xfer = "/pinctrl/uart2b/uart2b-xfer";
		uart2c_xfer = "/pinctrl/uart2c/uart2c-xfer";
		uart3_xfer = "/pinctrl/uart3/uart3-xfer";
		uart3_cts = "/pinctrl/uart3/uart3-cts";
		uart3_rts = "/pinctrl/uart3/uart3-rts";
		uart4_xfer = "/pinctrl/uart4/uart4-xfer";
		uarthdcp_xfer = "/pinctrl/uarthdcp/uarthdcp-xfer";
		pwm0_pin = "/pinctrl/pwm0/pwm0-pin";
		pwm0_pin_pull_down = "/pinctrl/pwm0/pwm0-pin-pull-down";
		vop0_pwm_pin = "/pinctrl/pwm0/vop0-pwm-pin";
		vop1_pwm_pin = "/pinctrl/pwm0/vop1-pwm-pin";
		pwm1_pin = "/pinctrl/pwm1/pwm1-pin";
		pwm1_pin_pull_down = "/pinctrl/pwm1/pwm1-pin-pull-down";
		pwm2_pin = "/pinctrl/pwm2/pwm2-pin";
		pwm2_pin_pull_down = "/pinctrl/pwm2/pwm2-pin-pull-down";
		pwm3a_pin = "/pinctrl/pwm3a/pwm3a-pin";
		pwm3a_pin_pull_down = "/pinctrl/pwm3a/pwm3a-pin-pull-down";
		pwm3b_pin = "/pinctrl/pwm3b/pwm3b-pin";
		pwm3b_pin_pull_down = "/pinctrl/pwm3b/pwm3b-pin-pull-down";
		hdmi_i2c_xfer = "/pinctrl/hdmi/hdmi-i2c-xfer";
		hdmi_cec = "/pinctrl/hdmi/hdmi-cec";
		pcie_clkreqn_cpm = "/pinctrl/pcie/pci-clkreqn-cpm";
		pcie_clkreqnb_cpm = "/pinctrl/pcie/pci-clkreqnb-cpm";
		pcie_drv = "/pinctrl/pcie/pcie-drv";
		cif_clkout = "/pinctrl/isp/cif-clkout";
		isp_dvp_d0d7 = "/pinctrl/isp/isp-dvp-d0d7";
		isp_shutter = "/pinctrl/isp/isp-shutter";
		isp_flash_trigger = "/pinctrl/isp/isp-flash-trigger";
		isp_flash_trigger_as_gpio = "/pinctrl/isp/isp-flash-trigger-as-gpio";
		cam0_default_pins = "/pinctrl/cam_pins/cam0-default-pins";
		cam0_sleep_pins = "/pinctrl/cam_pins/cam0-sleep-pins";
		bt_enable_h = "/pinctrl/bt/bt-enable-h";
		bt_host_wake_l = "/pinctrl/bt/bt-host-wake-l";
		bt_wake_l = "/pinctrl/bt/bt-wake-l";
		wifi_enable_h = "/pinctrl/wifi/wifi-enable-h";
		wifi_host_wake_l = "/pinctrl/wifi/wifi-host-wake-l";
		hpd_en = "/pinctrl/hpd/hpd-en";
		pmic_int_l = "/pinctrl/pmic/pmic-int-l";
		vsel1_gpio = "/pinctrl/pmic/vsel1-gpio";
		vsel2_gpio = "/pinctrl/pmic/vsel2-gpio";
		soc_slppin_gpio = "/pinctrl/pmic/soc-slppin-gpio";
		soc_slppin_slp = "/pinctrl/pmic/soc-slppin-slp";
		soc_slppin_rst = "/pinctrl/pmic/soc-slppin-rst";
		vcc5v0_host_en = "/pinctrl/vbus_host/vcc5v0-host-en";
		vbus_typec_en = "/pinctrl/vbus_typec/vbus-typec-en";
		rockchip_suspend = "/rockchip-suspend";
		drm_logo = "/reserved-memory/drm-logo@00000000";
		ramoops_mem = "/reserved-memory/region@110000";
		ramoops = "/ramoops";
		fiq_debugger = "/fiq-debugger";
		cif_isp0 = "/cif_isp@ff910000";
		cif_isp1 = "/cif_isp@ff920000";
		cluster0_opp = "/opp-table-0";
		cluster1_opp = "/opp-table-1";
		gpu_opp_table = "/opp-table-2";
		dmc_opp_table = "/opp-table3";
		fan0 = "/pwm-fan";
		vcc5v0_sys = "/vcc5v0-sys";
		vbus_host = "/vbus-host";
		vbus_typec = "/vbus-typec";
		vcc_phy = "/vcc-phy-regulator";
		vcc3v3_pcie = "/vcc3v3-pcie-regulator";
		clkin_gmac = "/external-gmac-clock";
		dp0_sound = "/dp0-sound";
		vcc3v3_dp = "/vcc3v3-dp";
		virtual_pd = "/virtual-pd";
		rk809_sound = "/rk809-sound";
		sdio_pwrseq = "/sdio-pwrseq";
	};
};
